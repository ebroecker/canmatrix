VERSION "created by canmatrix"

NS_ :

BS_:

BU_:

BO_ 2024 OBD2: 8 Vector__XXX
 SG_ MAF_air_flow_rate m16 : 31|16@0+ (0.01,0) [0|0] "grams/sec" Vector__XXX
 SG_ Throttle_position m17 : 31|8@0+ (0.392156862745098,0) [0|0] "%" Vector__XXX
 SG_ Engine_RPM m12 : 31|16@0+ (0.25,0) [0|0] "" Vector__XXX
 SG_ Engine_coolant_temperature m5 : 31|8@0+ (1,-40) [0|0] "°C" Vector__XXX
 SG_ ParameterID_Service01 m1M : 23|8@0+ (1,0) [0|0] "" Vector__XXX
 SG_ ParameterID_Service02 m2 : 23|8@0+ (1,0) [0|0] "" Vector__XXX
 SG_ DTC_caused_freeze_frame m2 : 31|16@0+ (1,0) [0|0] "" Vector__XXX
 SG_ Vehicle_speed m13 : 31|8@0+ (1,0) [0|0] "" Vector__XXX
 SG_ Fuel_System_Status m3 : 31|16@0+ (1,0) [0|0] "" Vector__XXX
 SG_ Freeze_DTC m2 : 31|16@0+ (1,0) [0|0] "" Vector__XXX
 SG_ PID_Monitor_status m1 : 31|32@0+ (1,0) [0|0] "" Vector__XXX
 SG_ PIDs_supported m0 : 31|32@0+ (1,0) [0|0] "" Vector__XXX
 SG_ service M : 11|4@0+ (1,0) [0|0] "" Vector__XXX
 SG_ response : 15|4@0+ (1,0) [0|0] "" Vector__XXX
 SG_ length : 7|8@0+ (1,0) [0|0] "" Vector__XXX

CM_ SG_ 2024 DTC_caused_freeze_frame "DTC that caused freeze frame to be stored. ";
CM_ SG_ 2024 PID_Monitor_status "Monitor status since DTCs cleared. (Includes malfunction indicator lamp (MIL) status and number of DTCs.) ";
BA_DEF_ BO_  "VFrameFormat" ENUM  "StandardCAN","ExtendedCAN","StandardCAN_FD","ExtendedCAN_FD","J1939PG";
BA_DEF_  "ProtocolType" STRING ;
BA_DEF_DEF_  "VFrameFormat" "";
BA_DEF_DEF_  "ProtocolType" "";
BA_ "ProtocolType" "J1939";
BA_ "VFrameFormat" BO_ 2024 0;
VAL_ 2024 ParameterID_Service01 16 "MAF air flow rate" 17 "Throttle position" 12 "Engine RPM" 5 "Engine coolant temperature " 13 "Vehicle speed" 3 "Fuel system status" 2 "Freeze DTC " 1 "Monitor status since DTCs cleared. (Includes malfunction indicator lamp (MIL) status and number of DTCs.) " 0 "PIDs supported" ;
VAL_ 2024 service 10 "Permanent Diagnostic Trouble Codes (DTCs) (Cleared DTCs) " 9 "Request vehicle information " 8 "Control operation of on-board component/system " 7 "Show pending Diagnostic Trouble Codes (detected during current or last driving cycle) " 6 "Test results, other component/system monitoring (Test results, oxygen sensor monitoring for CAN only) " 5 "Test results, oxygen sensor monitoring (non CAN only) " 4 "Clear Diagnostic Trouble Codes and stored values" 3 "Show stored Diagnostic Trouble Codes " 2 "Show freeze frame data " 1 "Show current data " ;

SG_MUL_VAL_ 2024 MAF_air_flow_rate ParameterID_Service01 16-16;
SG_MUL_VAL_ 2024 Throttle_position ParameterID_Service01 17-17;
SG_MUL_VAL_ 2024 Engine_RPM ParameterID_Service01 12-12;
SG_MUL_VAL_ 2024 Engine_coolant_temperature ParameterID_Service01 5-5;
SG_MUL_VAL_ 2024 ParameterID_Service01 service 1-1;
SG_MUL_VAL_ 2024 ParameterID_Service02 service 2-2;
SG_MUL_VAL_ 2024 DTC_caused_freeze_frame service 2-2;
SG_MUL_VAL_ 2024 Vehicle_speed ParameterID_Service01 13-13;
SG_MUL_VAL_ 2024 Fuel_System_Status ParameterID_Service01 3-3;
SG_MUL_VAL_ 2024 Freeze_DTC ParameterID_Service01 2-2;
SG_MUL_VAL_ 2024 PID_Monitor_status ParameterID_Service01 1-1;
SG_MUL_VAL_ 2024 PIDs_supported ParameterID_Service01 0-0;
