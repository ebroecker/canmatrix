VERSION "created by canmatrix"

NS_ :

BS_:

BU_:

BO_ 1 Diag_Reqest: 8 Vector__XXX
 SG_ service_id : 0|8@1- (1,0) [-128|127] "" Vector__XXX
 SG_ service_10 m16 : 8|8@1- (1,0) [0|0] "" Vector__XXX
 SG_ service_22 m34 : 8|8@1- (1,0) [0|0] "" Vector__XXX
 SG_ service_11 m17 : 8|8@1- (1,0) [0|0] "" Vector__XXX
 SG_ service_27 m39 : 8|8@1- (1,0) [0|0] "" Vector__XXX
 SG_ service_28 m40 : 8|8@1- (1,0) [0|0] "" Vector__XXX
 SG_ service_3e m62 : 8|8@1- (1,0) [0|0] "" Vector__XXX
 SG_ service_85 m133 : 8|8@1- (1,0) [0|0] "" Vector__XXX
 SG_ service_2e m46 : 8|16@1- (1,0) [0|0] "" Vector__XXX
 SG_ service_2a m42 : 8|8@1- (1,0) [0|0] "" Vector__XXX
 SG_ service_2c m44 : 8|8@1- (1,0) [0|0] "" Vector__XXX
 SG_ service_19 m25 : 8|8@1- (1,0) [0|0] "" Vector__XXX
 SG_ service_14 m20 : 8|0@1- (1,0) [0|0] "" Vector__XXX
 SG_ service_2f m47 : 8|16@1- (1,0) [0|0] "" Vector__XXX
 SG_ service_31 m49 : 8|8@1- (1,0) [0|0] "" Vector__XXX
 SG_ service_34 m52 : 8|0@1- (1,0) [0|0] "" Vector__XXX
 SG_ service_36 m54 : 8|0@1- (1,0) [0|0] "" Vector__XXX
 SG_ service_37 m55 : 8|0@1- (1,0) [0|0] "" Vector__XXX
 SG_ service_01 m1 : 8|8@1- (1,0) [0|0] "" Vector__XXX
 SG_ service_02 m2 : 8|8@1- (1,0) [0|0] "" Vector__XXX
 SG_ service_03 m3 : 8|0@1- (1,0) [0|0] "" Vector__XXX
 SG_ service_07 m7 : 8|0@1- (1,0) [0|0] "" Vector__XXX
 SG_ service_04 m4 : 8|0@1- (1,0) [0|0] "" Vector__XXX
 SG_ service_09 m9 : 8|8@1- (1,0) [0|0] "" Vector__XXX
 SG_ service_08 m8 : 8|8@1- (1,0) [0|0] "" Vector__XXX
 SG_ service_06 m6 : 8|8@1- (1,0) [0|0] "" Vector__XXX

BO_ 2 Diag_Response: 8 Vector__XXX
 SG_ service_id : 0|8@1- (1,0) [-128|127] "" Vector__XXX
 SG_ service_10 m80 : 8|8@1- (1,0) [0|0] "" Vector__XXX
 SG_ service_22 m98 : 8|8@1- (1,0) [0|0] "" Vector__XXX
 SG_ service_11 m81 : 8|8@1- (1,0) [0|0] "" Vector__XXX
 SG_ service_27 m103 : 8|8@1- (1,0) [0|0] "" Vector__XXX
 SG_ service_28 m104 : 8|8@1- (1,0) [0|0] "" Vector__XXX
 SG_ service_3e m126 : 8|8@1- (1,0) [0|0] "" Vector__XXX
 SG_ service_85 m197 : 8|8@1- (1,0) [0|0] "" Vector__XXX
 SG_ service_2e m110 : 8|16@1- (1,0) [0|0] "" Vector__XXX
 SG_ service_2a m106 : 8|8@1- (1,0) [0|0] "" Vector__XXX
 SG_ service_2c m108 : 8|8@1- (1,0) [0|0] "" Vector__XXX
 SG_ service_19 m89 : 8|8@1- (1,0) [0|0] "" Vector__XXX
 SG_ service_14 m84 : 8|0@1- (1,0) [0|0] "" Vector__XXX
 SG_ service_2f m111 : 8|16@1- (1,0) [0|0] "" Vector__XXX
 SG_ service_31 m113 : 8|8@1- (1,0) [0|0] "" Vector__XXX
 SG_ service_34 m116 : 8|0@1- (1,0) [0|0] "" Vector__XXX
 SG_ service_36 m118 : 8|0@1- (1,0) [0|0] "" Vector__XXX
 SG_ service_37 m119 : 8|0@1- (1,0) [0|0] "" Vector__XXX
 SG_ service_01 m65 : 8|8@1- (1,0) [0|0] "" Vector__XXX
 SG_ service_02 m66 : 8|8@1- (1,0) [0|0] "" Vector__XXX
 SG_ service_03 m67 : 8|0@1- (1,0) [0|0] "" Vector__XXX
 SG_ service_07 m71 : 8|0@1- (1,0) [0|0] "" Vector__XXX
 SG_ service_04 m68 : 8|0@1- (1,0) [0|0] "" Vector__XXX
 SG_ service_09 m73 : 8|8@1- (1,0) [0|0] "" Vector__XXX
 SG_ service_08 m72 : 8|8@1- (1,0) [0|0] "" Vector__XXX
 SG_ service_06 m70 : 8|8@1- (1,0) [0|0] "" Vector__XXX
 SG_ service_7f m127 : 8|8@1- (1,0) [0|0] "" Vector__XXX

VAL_ 1 service_10 1 "RQ_Default_Start" 2 "RQ_Programming_Start" 3 "RQ_ExtendedDiagnostic_Start" 129 "RQ_Default_Start_NoResponse" 130 "RQ_Programming_Start_NoResponse" 131 "RQ_ExtendedDiagnostic_Start_NoResponse";
VAL_ 1 service_22 242 "RQ_F201_Periodic_Identifier_ReadOnce" 243 "RQ_F301_Periodic_Identifier_Read" 4096 "RQ_Regime_motore_Read" 4097 "RQ_Livello_Carburante_Read" 4098 "RQ_Velocita_vettura_Read" 4099 "RQ_Temp_acqua_motore_Read" 4100 "RQ_Tensione_Batteria_a_monte_rele_principale_Read" 4104 "RQ_ECU_time_stamps_RAM_Read" 4105 "RQ_ECU_time_stamps_from_KeyOn_RAM_Read" 6160 "RQ_Correction_of_ET_actuation_due_to_SIC_strategy_SIC_Read" 6161 "RQ_Auto_adaptive_map_propagating_correction_factor_AFCD_UEGO_Read" 6162 "RQ_Number_of_learning_process_done_for_the_asymmetry_correction_in_Read" 6163 "RQ_Corrective_values_in_the_4x20_Table_to_be_added_to_the_measured_Read" 6164 "RQ_Map_of_points_of_QloadwAdapt_m_that_has_been_directly_adapted_du_Read" 6298 "RQ_EGR_DC_motor_duty_cycle_command_Read" 6299 "RQ_EGR_DC_motor_required_position_Read" 6300 "RQ_EGR_motor_meas_pos_Read" 6301 "RQ_EGR_DC_motor_control_status_Read" 6302 "RQ_EGR_last_offset_learnt_Read" 6307 "RQ_DPF_flow_resistance_Read" 6309 "RQ_Number_of_consecutive_interrupted_regeneration_by_Key_OFF_Read" 6310 "RQ_Driven_distance_since_DPF_lamp_ON_Read" 6311 "RQ_EGR_cooler_bypass_status_Read" 6312 "RQ_Mission_profile_in_Engine_Life_Read" 6313 "RQ_Mission_profile_during_regenation_Read" 6314 "RQ_Mission_profile_since_last_regeneration_Read" 6315 "RQ_Lambda_heater_duty_cycle_Read" 6316 "RQ_UEGO_temperature_Read" 6318 "RQ_Stato_condiz_mot_1_Read" 6319 "RQ_Stato_condiz_mot_2_Read" 6320 "RQ_CAN_comm_status_Read" 6337 "RQ_Anticipo_iniezione_carburante_PILOT_Read" 6338 "RQ_Anticipo_iniezione_carburante_PRE_Read" 6339 "RQ_Advance_of_POST_3_injection_fuel_1_Read" 6341 "RQ_Anticipo_iniezione_carburante_POST_Read" 6343 "RQ_Advance_of_POST_2_injection_fuel_Read" 6344 "RQ_Advance_of_POST_3_injection_fuel_Read" 6345 "RQ_Quantita_carburante_iniezione_PILOT_Read" 6346 "RQ_Quantity_of_PRE_injected_fuel_Read" 6347 "RQ_Quantita_carburante_iniezione_PRE_Read" 6349 "RQ_Quant_carb_pilot_1_1_Read" 6350 "RQ_Quantita_carburante_richiesta_Read" 6352 "RQ_Quant_carb_tot_in_Read" 6353 "RQ_Quantity_of_POST_3_injected_fuel_Read" 6354 "RQ_Quantity_of_POST_4_injected_fuel_Read" 6355 "RQ_Durata_iniezione_PILOT_Read" 6356 "RQ_Durata_iniezione_PRE_Read" 6357 "RQ_Time_of_POST_2_injection_fuel_Read" 6359 "RQ_Durata_iniezione_POST_Read" 6361 "RQ_Time_of_POST_3_injection_fuel_Read" 6362 "RQ_Time_of_POST_4_injection_fuel_Read" 6363 "RQ_Stato_iniezione_Read" 6366 "RQ_Sensore_temperatura_gas_esausti_all_ingresso_del_DPF_Read" 6367 "RQ_Tensione_sensore_Gas_di_scarico_monte_DPF_Read" 6368 "RQ_Tensione_sonda_Lamda_Read" 6369 "RQ_Presenza_Lambda_filtro_particolato_Read" 6370 "RQ_Pressione_differenziale_DPF_Read" 6371 "RQ_Tensione_sensore_pressione_differenziale_Read" 6372 "RQ_Percentuale_di_intasamento_trappola_soot_mass_Read" 6373 "RQ_Stato_DPF_Read" 6374 "RQ_Oil_life_Lamp_status_1_Read" 6375 "RQ_Stato_richiesta_rigenerazione_filtro_particolato_Read" 6380 "RQ_Risultato_rigenerazione_forzata_Read" 6381 "RQ_Controllo_titolo_sonda_lambda_Read" 6383 "RQ_Stato_olio_esausto_Read" 6399 "RQ_Water_in_fuel_level_sensor_signal_Read" 6400 "RQ_Temperatura_Carburante_Read" 6401 "RQ_ADC_sensore_temperatura_carburante_Read" 6404 "RQ_Duty_cycle_reg_CP1_H_Read" 6408 "RQ_Stato_gestione_candelette_preriscaldo_Read" 6409 "RQ_Stato_Warm_Up_Read" 6411 "RQ_Glow_plug_low_voltage_command_Read" 6429 "RQ_Durata_del_Power_Latch_Read" 6430 "RQ_Stato_motore_Read" 6431 "RQ_Stato_lampada_MIL_Read" 6432 "RQ_Stato_veicolo_Read" 6433 "RQ_Stato_Chiave_Read" 6435 "RQ_Stato_Pedali_Read" 6436 "RQ_Posizione_pedale_acceleratore_Read" 6437 "RQ_ADC_ped_accel_1_Read" 6438 "RQ_ADC_ped_accel_2_Read" 6439 "RQ_Stato_leva_cruise_Read" 6440 "RQ_Stato_cruise_control_Read" 6441 "RQ_Stato_irreversibile_shut_OFF_cruise_control_Read" 6442 "RQ_Stato_reversibile_shut_OFF_cruise_Read" 6443 "RQ_Velocita_obiettivo_cruise_Read" 6444 "RQ_Stato_segnale_L_terminal_alternatore_Read" 6445 "RQ_Marcia_inserita_Read" 6446 "RQ_Riconoscimento_tipo_di_trasmissione_Read" 6447 "RQ_Pressione_impianto_condizionatore_Read" 6448 "RQ_Stato_attivazione_condizionatore_Read" 6449 "RQ_Stato_ventole_raffreddamento_Read" 6451 "RQ_Stato_limit_coppia_Read" 6452 "RQ_ADC_temperatura_acqua_motore_Read" 6453 "RQ_Temp_aria_P_turbo_Read" 6454 "RQ_ADC_temperatura_aria_sovralimentazione_sensore_pressione_turbo_Read" 6458 "RQ_Attuatore_V_G_T_press_Boost_Read" 6460 "RQ_Massa_aria_mis_HFM7_Read" 6461 "RQ_Massa_aria_obiettivo_HFM6_Read" 6463 "RQ_Temp_aria_asp_HFM7_Read" 6465 "RQ_Comando_pompa_carb_Read" 6466 "RQ_Consumo_carburante_Read" 6468 "RQ_TVA_DC_Motor_duty_cycle_command_Read" 6469 "RQ_TVA_DC_Motor_duty_cycle_status_Read" 6470 "RQ_Pressione_rail_obiettivo_Read" 6471 "RQ_Pressione_rail_misurata_Read" 6472 "RQ_ADC_pressione_carburante_rail_sensore_Read" 6475 "RQ_Stato_controllo_EGR_Read" 6476 "RQ_Fail_Status_Read" 6477 "RQ_Stato_switch_P_olio_Read" 6480 "RQ_Tens_alim_iniettori_Read" 6481 "RQ_Tensione_alimentazione_gruppo_sensori_1_Read" 6482 "RQ_Tensione_alimentazione_gruppo_sensori_2_Read" 6483 "RQ_Tensione_alimentazione_gruppo_sensori_3_Read" 6485 "RQ_V_alim_valle_main_r_Read" 6486 "RQ_Pressione_atmosferica_Read" 6487 "RQ_ADC_Pressione_atmosferica_Read" 6488 "RQ_Periodo_segnale_massa_aria_debimetro_Read" 6489 "RQ_Pressione_turbo_obiettivo_Read" 6490 "RQ_Pressione_turbo_misurata_Read" 6491 "RQ_ADC_Pressione_turbo_Read" 6493 "RQ_Stato_lampada_pre_riscaldo_Read" 6494 "RQ_Stato_lampada_massima_temperatura_h2O_Read" 6495 "RQ_Stato_lampada_Pressione_Degrado_olio_Read" 6497 "RQ_Stato_lampada_cruise_control_Read" 6498 "RQ_Duty_Cycle_segnale_temperatura_aria_aspirata_HFM6_Read" 6499 "RQ_Stato_Boost_Read" 6500 "RQ_TVA_motor_req_pos_Read" 6501 "RQ_TVA_motor_meas_pos_Read" 6502 "RQ_TVA_DC_motor_last_offset_learnt_Read" 6503 "RQ_Stato_sincronizzazione_Read" 6504 "RQ_UEGO_reference_voltage_Read" 6506 "RQ_Carburante_richiesto_dalla_pompa_ad_ogni_giro_Read" 6507 "RQ_Quantita_carburante_open_loop_Read" 6508 "RQ_Controllo_degli_integral_term_pressione_rail_Read" 6574 "RQ_DBV4_opening_counter_Read" 6575 "RQ_DBV4_cumulative_opening_time_Read" 6912 "RQ_Stato_Stop_Start_Read" 6913 "RQ_Engine_Stop_Start_Status_Read" 6914 "RQ_Status_message_S_S_received_by_ECM_Read" 6915 "RQ_Crank_management_Read" 6917 "RQ_Neutral_Position_acquired_value_EEprom_after_procedure_Read" 6918 "RQ_Neutral_Position_Istantaneous_value_Read" 6919 "RQ_Numbers_of_Automatic_Stop_Read" 6920 "RQ_Numbers_of_Automatic_Start_required_by_EBCM_or_by_ECM_Driver_Read" 6921 "RQ_Numbers_of_first_cranking_key_cranking_Read" 6922 "RQ_Cumulative_Automatic_Engine_Stop_duration_Read" 6923 "RQ_Feedback_Vsensing_state_Read" 6924 "RQ_Irreversible_S_S_functionality_deactivation_Read" 6925 "RQ_Temporary_S_S_functionality_deactivation_Read" 6926 "RQ_Number_of_failed_automatic_crank_by_S_S_Read" 6927 "RQ_Total_number_of_engine_start_up_Read" 7136 "RQ_Rpm_increasing_for_PTC_or_HWS_activation_Read" 8192 "RQ_Immobilizer_status_Read" 8193 "RQ_Odometer_Read" 8194 "RQ_Odometer_content_to_the_last_F_ROM_updating_Read" 8195 "RQ_Number_of_FlashRom_re_writings_F_ROM_Read" 8196 "RQ_Numero_di_eventi_di_fuorigiri_Read" 8197 "RQ_Valore_massimo_di_fuori_giri_raggiunto_Read" 8198 "RQ_Contature_Maximum_speed_exceeding_time_counter_Read" 8199 "RQ_Odometer_value_at_last_over_speed_Read" 8200 "RQ_ECU_time_stamps_EEPROM_Read" 8201 "RQ_ECU_time_stamps_from_KeyOn_EEPROM_Read" 8202 "RQ_KeyOn_counter_EEPROM_Read" 8203 "RQ_ECU_Time_first_DTC_detection_EEPROM_Read" 8204 "RQ_ECU_Time_Stamps_from_KeyOn_first_DTC_detection_EEPROM_Read" 8207 "RQ_KeyOn_Counter_Status_EEPROM_Read" 8208 "RQ_ProgrammingStatus_EEPROM_FLASH_Read" 8514 "RQ_Circonferenza_ruote_Read" 14336 "RQ_Correzione_carburante_cilindro_1_Read" 14337 "RQ_Correzione_carburante_cilindro_2_Read" 14338 "RQ_Correzione_carburante_cilindro_3_Read" 14339 "RQ_Correzione_carburante_cilindro_4_Read" 14342 "RQ_Distanza_percorsa_dall_ultima_sostituzione_DPF_Read" 14343 "RQ_Distanza_percorsa_dall_ultima_rigenerazione_spontanea_Read" 14344 "RQ_Valore_medio_della_temperatura_media_tra_le_ultime_5_rigenerazio_Read" 14345 "RQ_Valore_medio_della_distanza_percorsa_tra_le_ultime_5_rigenerazio_Read" 14346 "RQ_Valore_medio_della_durata_tra_le_ultime_5_rigenerazioni_Read" 14347 "RQ_Percentuale_relativa_del_tempo_della_rigenerazione_Read" 14348 "RQ_Numero_di_procedure_di_reset_automatiche_reset_Oil_Life_eseguite_Read" 14349 "RQ_Numero_di_procedure_di_reset_Oil_Life_eseguite_con_procedura_man_Read" 14350 "RQ_Odometro_ultima_procedura_di_reset_Oil_Life_eseguita_con_strumen_Read" 14351 "RQ_Valore_odometro_all_ultima_procedura_di_reset_Oil_life_eseguit_1_Read" 14352 "RQ_Rimanenza_olio_motore_espressa_in_distanza_Read" 14353 "RQ_Valore_odometro_all_inizio_indicazione_richiesta_cambio_olio_Read" 14355 "RQ_Current_value_of_engine_oil_remaing_life_expressed_as_remainin_1_Read" 14356 "RQ_Odometro_sostituzione_CCM_Read" 14360 "RQ_Informazione_cambio_olio_dovuto_all_algoritmo_Distanza_Read" 14362 "RQ_Rimanenza_olio_motore_informazione_binaria_Read" 14363 "RQ_Rimanenza_olio_da_algoritmo_DPF_Regenerations_Read" 14365 "RQ_Total_number_of_regeneration_Read" 14366 "RQ_Number_of_battery_detach_Read" 14367 "RQ_Counter_of_DPF_regeneration_due_to_flow_resistance_since_the_las_Read" 14377 "RQ_Codice_IMA_iniettore_cilindro_1_Read" 14378 "RQ_Codice_IMA_iniettore_cilindro_2_Read" 14379 "RQ_Codice_IMA_iniettore_cilindro_3_Read" 14380 "RQ_Codice_IMA_iniettore_cilindro_4_Read" 14383 "RQ_Codice_IMA_iniettori_1_4_Read" 14384 "RQ_FPS_Snapshot_event_1_Read" 14385 "RQ_FPS_Snapshot_event_2_Read" 14386 "RQ_FPS_Snapshot_event_3_Read" 14387 "RQ_EEprom_data_for_ECM_substitution_Read" 14388 "RQ_AF_Ratio_Lambda_Read" 14389 "RQ_Counter_of_DPF_regeneration_due_to_flow_resistance_Read" 14392 "RQ_Driven_distance_with_water_in_fuel_lamp_ON_Read" 14393 "RQ_Driven_distance_with_temperature_warning_lamp_ON_Read" 14394 "RQ_Status_of_Self_Learn_functions_ex1922_Read" 16128 "RQ_BOOT_CONFIGURATION_Read" 24704 "RQ_Event_counter_Read" 24706 "RQ_DTCFailureType_Read" 61824 "RQ_BootSoftwareIdentification_Read" 61825 "RQ_ApplicationSoftwareIdentification_Read" 61826 "RQ_ApplicationDataIdentification_Read" 61827 "RQ_BootSoftwareFingerprint_Read" 61828 "RQ_ApplicationSoftwareFingerprint_Read" 61829 "RQ_ApplicationDataFingerprint_Read" 61830 "RQ_ActiveDiagnosticSessionDataIdentifier_Read" 61831 "RQ_VehicleManufacturerSparePartNumber_Read" 61836 "RQ_EcuSerialNumber_Read" 61840 "RQ_VIN_Read" 61842 "RQ_SystemSupplierEcuHardwareNumber_Read" 61843 "RQ_SystemSupplierEcuHardwareVersionNumber_Read" 61844 "RQ_SystemSupplierEcuSoftwareNumber_Read" 61845 "RQ_SystemSupplierEcuSoftwareVersionNumber_Read" 61846 "RQ_ExhaustRegulationOrTypeApprovalNumber_Read" 61856 "RQ_IdentificationCode_Read" 61860 "RQ_SincomAndFactory_Read" 61861 "RQ_ISOCode_Read" 62465 "RQ_PID_01_service_01_Monitor_status_since_DTCs_cleared_Read" 62466 "RQ_Pid_04_service_01_Calculated_LOAD_Value_Read" 62467 "RQ_Pid_05_service_01_Engine_Coolant_Temperature_Read" 62469 "RQ_Pid_0B_service_01_Intake_Manifold_Absolute_Pressure_Read" 62470 "RQ_Pid_0C_service_01_Engine_RPM_Read" 62471 "RQ_Pid_0D_service_01_Vehicle_Speed_Sensor_Read" 62472 "RQ_Pid_0F_service_01_Intake_Air_Temperature_Read" 62473 "RQ_Pid_10_service_01_Air_Flow_Rate_from_Mass_Air_Flow_Sensor_Read" 62474 "RQ_Pid_1C_service_01_OBD_requirement_to_which_vehicle_is_designed_Read" 62476 "RQ_Pid_21_service_01_Distance_travelled_while_MIL_is_activated_Read" 62477 "RQ_Pid_23_service_01_Fuel_Rail_Pressure_Read" 62478 "RQ_Pid_2C_service_01_Commanded_EGR_Read" 62479 "RQ_Pid_2F_service_01_Fuel_Level_Input_Read" 62481 "RQ_Pid_33_service_01_Barometric_Pressure_Read" 62482 "RQ_Pid_41_service_01_Monitor_status_this_driving_cycle_Read" 62483 "RQ_Pid_49_service_01_Accelerator_Pedal_Position_D_Read" 62484 "RQ_Pid_4A_service_01_Accelerator_Pedal_Position_E_Read" 62486 "RQ_Pid_02_service_02_DTC_that_caused_required_freeze_frame_data_s_1_Read" 62487 "RQ_Pid_04_service_02_Calculated_LOAD_Value_Read" 62488 "RQ_Pid_05_service_02_Engine_Coolant_Temperature_Read" 62489 "RQ_Pid_0B_service_02_Intake_Manifold_Absolute_Pressure_Read" 62490 "RQ_Pid_0C_service_02_Engine_RPM_Read" 62491 "RQ_Pid_0D_service_02_Vehicle_speed_Sensor_Read" 62492 "RQ_Pid_0F_service_02_Intake_Air_Temperature_Read" 62493 "RQ_Pid_10_service_02_Air_Flow_Rate_from_Mass_Air_Flow_Sensor_Read" 62494 "RQ_Pid_23_service_02_Fuel_rail_pressure_Read" 63025 "RQ_Pid_31_service_06_Air_flow_mass_drift_EGR_Monitor_Bank_1_OBDMI_1_Read" 63489 "RQ_Pid_01_service_09_MessageCount_VIN_Read" 63490 "RQ_Pid_02_service_09_Vehicle_Identification_Number_VIN_Read" 63491 "RQ_Pid_03_service_09_MessageCount_CALID_Read" 63492 "RQ_Service_08_PID03_MessageCount_CALID_1_Read" 65279 "RQ_DIAnalyzer_support_Infos_DIAnalyzerConfiguration";
VAL_ 1 service_11 1 "RQ_HardReset_Reset" 129 "RQ_HardReset_Reset_NoResponse";
VAL_ 1 service_27 1 "RQ_Level1Seed_Request" 2 "RQ_Level1Key_Send" 5 "RQ_VINRequestSeed_Request" 6 "RQ_VINSendKey_Send" 129 "RQ_Level1Seed_Request_NoResponse" 130 "RQ_Level1Key_Send_NoResponse" 133 "RQ_VINRequestSeed_Request_NoResponse" 134 "RQ_VINSendKey_Send_NoResponse";
VAL_ 1 service_28 0 "RQ_EnableRxAndEnableTx_Ctrl" 1 "RQ_EnableRxAndDisableTx_Ctrl" 128 "RQ_EnableRxAndEnableTx_Ctrl_NoResponse" 129 "RQ_EnableRxAndDisableTx_Ctrl_NoResponse";
VAL_ 1 service_3e 0 "RQ_TesterPresent_Tester_Prresent" 128 "RQ_TesterPresent_Tester_Prresent_NoResponse";
VAL_ 1 service_85 1 "RQ_DtcSettingOn_Ctrl" 2 "RQ_DtcSettingOff_Ctrl" 129 "RQ_DtcSettingOn_Ctrl_NoResponse" 130 "RQ_DtcSettingOff_Ctrl_NoResponse";
VAL_ 1 service_2e 14377 "RQ_Codice_IMA_iniettore_cilindro_1_Write" 14378 "RQ_Codice_IMA_iniettore_cilindro_2_Write" 14379 "RQ_Codice_IMA_iniettore_cilindro_3_Write" 14380 "RQ_Codice_IMA_iniettore_cilindro_4_Write" 14383 "RQ_Codice_IMA_iniettori_1_4_Write" 14387 "RQ_EEprom_data_for_ECM_substitution_Write" 61827 "RQ_BootSoftwareFingerprint_Write" 61828 "RQ_ApplicationSoftwareFingerprint_Write" 61829 "RQ_ApplicationDataFingerprint_Write" 61840 "RQ_VIN_Write" 61860 "RQ_SincomAndFactory_Write";
VAL_ 1 service_2a 1 "RQ_F201_Periodic_Identifier_ReadPeriodicSlow" 2 "RQ_F201_Periodic_Identifier_ReadPeriodicMedium" 3 "RQ_F201_Periodic_Identifier_ReadPeriodicFast" 4 "RQ_F201_Periodic_Identifier_ReadPeriodicStop";
VAL_ 1 service_2c 1 "RQ_F301_Periodic_Identifier_Define" 3 "RQ_Clear_All_Dynamically_Defined_Data_Identifier_ClearAll" 129 "RQ_F301_Periodic_Identifier_Define_NoResponse" 131 "RQ_Clear_All_Dynamically_Defined_Data_Identifier_ClearAll_NoResponse";
VAL_ 1 service_19 2 "RQ_FaultMem_SUBF_02" 4 "RQ_FaultMem_SUBF_04" 6 "RQ_FaultMem_SUBF_06" 7 "RQ_FaultMem_SUBF_07" 8 "RQ_FaultMem_SUBF_08" 9 "RQ_FaultMem_SUBF_09" 12 "RQ_FaultMem_SUBF_0C" 14 "RQ_FaultMem_SUBF_0E" 130 "RQ_FaultMem_SUBF_02_NoResponse" 132 "RQ_FaultMem_SUBF_04_NoResponse" 134 "RQ_FaultMem_SUBF_06_NoResponse" 135 "RQ_FaultMem_SUBF_07_NoResponse" 136 "RQ_FaultMem_SUBF_08_NoResponse" 137 "RQ_FaultMem_SUBF_09_NoResponse" 140 "RQ_FaultMem_SUBF_0C_NoResponse" 142 "RQ_FaultMem_SUBF_0E_NoResponse";
VAL_ 1 service_2f 20480 "RQ_Reset_funzioni_autoapprese_Reset" 20481 "RQ_Comando_rele_compressore_aria_condizionata_Freeze" 20482 "RQ_Stop_generale_tutti_attuatori_ReturnControl" 20501 "RQ_H2O_in_fuel_filter_lamp_Freeze" 20503 "RQ_Comando_lampada_pressione_olio_Freeze" 20504 "RQ_Comando_lampada_massima_temperatura_acqua_Freeze" 20505 "RQ_Comando_lampada_MIL_Freeze" 20513 "RQ_Fuel_pump_rel_Freeze" 20520 "RQ_Sblocco_immobilizer_Control" 20522 "RQ_Comando_lampada_candelette_Freeze" 20523 "RQ_Attuatore_Boost_Freeze" 20524 "RQ_Comando_lampada_cruise_control_Freeze" 20525 "RQ_Reset_parametri_funzione_oil_life_Reset" 20527 "RQ_Comando_regolatore_portata_carburante_CP1_H_Freeze" 20528 "RQ_Comando_lampada_messaggio_trappola_particolato_DPF_Freeze" 20530 "RQ_EGR_cooler_bypass_command_Freeze";
VAL_ 1 service_31 1 "RQ_checkProgrammingDependencies_FlashChecksum_Start" 2 "RQ_Fan_activation_Stop" 3 "RQ_checkProgrammingDependencies_FlashChecksum_ReqResults" 129 "RQ_checkProgrammingDependencies_FlashChecksum_Start_NoResponse" 130 "RQ_Fan_activation_Stop_NoResponse" 131 "RQ_checkProgrammingDependencies_FlashChecksum_ReqResults_NoResponse";
VAL_ 1 service_01 0 "RQ_Supported_PIDs_from_01_to_20_Current_data" 1 "RQ_Stato_sistema_Current_data" 4 "RQ_Calculated_LOAD_value_Current_data" 5 "RQ_Engine_Coolant_Temperature_Current_data" 11 "RQ_Intake_Manifold_Absolute_Pressure_Current_data" 12 "RQ_Giri_motore_Current_data" 13 "RQ_Vehicle_Speed_Sensor_Current_data" 15 "RQ_Intake_Air_Temperature_Current_data" 16 "RQ_Air_Flow_Rate_from_Mass_Air_Current_data" 28 "RQ_OBD_requirements_to_which_vehicle_is_designed_Current_data" 32 "RQ_Supported_PIDs_from_21_to_40_Current_data" 33 "RQ_Distance_Travelled_While_MIL_is_Activated_Current_data" 35 "RQ_Fuel_Rail_Pressure_relative_to_manifold_vacuum_Current_data" 44 "RQ_Commanded_EGR_Current_data" 47 "RQ_Fuel_Level_Input_Current_data" 51 "RQ_Barometric_Pressure_Current_data" 64 "RQ_Supported_PIDs_from_41_to_60_Current_data" 65 "RQ_Monitor_status_this_driving_cycle_Current_data" 73 "RQ_Accelerator_Pedal_Position_D_Current_data" 74 "RQ_Accelerator_Pedal_Position_E_Current_data";
VAL_ 1 service_02 0 "RQ_Supported_PIDs_from_01_to_20_Freeze_Frame_data" 2 "RQ_DTC_that_caused_required_freeze_frame_data_storage_Freeze_Frame_data" 4 "RQ_Calculated_LOAD_value_Freeze_Frame_data" 5 "RQ_Engine_Coolant_Temperature_Freeze_Frame_data" 11 "RQ_Intake_Manifold_Absolute_Pressure_Freeze_Frame_data" 12 "RQ_Giri_motore_Freeze_Frame_data" 13 "RQ_Vehicle_Speed_Sensor_Freeze_Frame_data" 15 "RQ_Intake_Air_Temperature_Freeze_Frame_data" 16 "RQ_Air_Flow_Rate_from_Mass_Air_Freeze_Frame_data" 32 "RQ_Supported_PIDs_from_21_to_40_Freeze_Frame_data" 35 "RQ_Fuel_Rail_Pressure_relative_to_manifold_vacuum_Freeze_Frame_data";
VAL_ 1 service_09 0 "RQ_Supported_PIDs_from_01_to_20_Vehicle_Info" 1 "RQ_MessageCount_VIN_Vehicle_Info" 2 "RQ_Vehicle_Identification_Number_VIN_Vehicle_Info" 3 "RQ_MessageCount_CALID_Vehicle_Info" 4 "RQ_Identificativi_di_calibrazione_Vehicle_Info";
VAL_ 1 service_08 0 "RQ_TID_00_Control";
VAL_ 1 service_06 0 "RQ_Supported_TIDs_from_01_to_20_Test_results" 32 "RQ_Supported_TIDs_from_21_to_40_Test_results" 49 "RQ_Air_flow_mass_drift_EGR_Monitor_Bank_1_OBDMID_31_Test_results";
VAL_ 2 service_10 1 "PR_Default_Start" 2 "PR_Programming_Start" 3 "PR_ExtendedDiagnostic_Start";
VAL_ 2 service_22 242 "PR_F201_Periodic_Identifier_ReadOnce" 243 "PR_F301_Periodic_Identifier_Read" 4096 "PR_Regime_motore_Read" 4097 "PR_Livello_Carburante_Read" 4098 "PR_Velocita_vettura_Read" 4099 "PR_Temp_acqua_motore_Read" 4100 "PR_Tensione_Batteria_a_monte_rele_principale_Read" 4104 "PR_ECU_time_stamps_RAM_Read" 4105 "PR_ECU_time_stamps_from_KeyOn_RAM_Read" 6160 "PR_Correction_of_ET_actuation_due_to_SIC_strategy_SIC_Read" 6161 "PR_Auto_adaptive_map_propagating_correction_factor_AFCD_UEGO_Read" 6162 "PR_Number_of_learning_process_done_for_the_asymmetry_correction_in_Read" 6163 "PR_Corrective_values_in_the_4x20_Table_to_be_added_to_the_measured_Read" 6164 "PR_Map_of_points_of_QloadwAdapt_m_that_has_been_directly_adapted_du_Read" 6298 "PR_EGR_DC_motor_duty_cycle_command_Read" 6299 "PR_EGR_DC_motor_required_position_Read" 6300 "PR_EGR_motor_meas_pos_Read" 6301 "PR_EGR_DC_motor_control_status_Read" 6302 "PR_EGR_last_offset_learnt_Read" 6307 "PR_DPF_flow_resistance_Read" 6309 "PR_Number_of_consecutive_interrupted_regeneration_by_Key_OFF_Read" 6310 "PR_Driven_distance_since_DPF_lamp_ON_Read" 6311 "PR_EGR_cooler_bypass_status_Read" 6312 "PR_Mission_profile_in_Engine_Life_Read" 6313 "PR_Mission_profile_during_regenation_Read" 6314 "PR_Mission_profile_since_last_regeneration_Read" 6315 "PR_Lambda_heater_duty_cycle_Read" 6316 "PR_UEGO_temperature_Read" 6318 "PR_Stato_condiz_mot_1_Read" 6319 "PR_Stato_condiz_mot_2_Read" 6320 "PR_CAN_comm_status_Read" 6337 "PR_Anticipo_iniezione_carburante_PILOT_Read" 6338 "PR_Anticipo_iniezione_carburante_PRE_Read" 6339 "PR_Advance_of_POST_3_injection_fuel_1_Read" 6341 "PR_Anticipo_iniezione_carburante_POST_Read" 6343 "PR_Advance_of_POST_2_injection_fuel_Read" 6344 "PR_Advance_of_POST_3_injection_fuel_Read" 6345 "PR_Quantita_carburante_iniezione_PILOT_Read" 6346 "PR_Quantity_of_PRE_injected_fuel_Read" 6347 "PR_Quantita_carburante_iniezione_PRE_Read" 6349 "PR_Quant_carb_pilot_1_1_Read" 6350 "PR_Quantita_carburante_richiesta_Read" 6352 "PR_Quant_carb_tot_in_Read" 6353 "PR_Quantity_of_POST_3_injected_fuel_Read" 6354 "PR_Quantity_of_POST_4_injected_fuel_Read" 6355 "PR_Durata_iniezione_PILOT_Read" 6356 "PR_Durata_iniezione_PRE_Read" 6357 "PR_Time_of_POST_2_injection_fuel_Read" 6359 "PR_Durata_iniezione_POST_Read" 6361 "PR_Time_of_POST_3_injection_fuel_Read" 6362 "PR_Time_of_POST_4_injection_fuel_Read" 6363 "PR_Stato_iniezione_Read" 6366 "PR_Sensore_temperatura_gas_esausti_all_ingresso_del_DPF_Read" 6367 "PR_Tensione_sensore_Gas_di_scarico_monte_DPF_Read" 6368 "PR_Tensione_sonda_Lamda_Read" 6369 "PR_Presenza_Lambda_filtro_particolato_Read" 6370 "PR_Pressione_differenziale_DPF_Read" 6371 "PR_Tensione_sensore_pressione_differenziale_Read" 6372 "PR_Percentuale_di_intasamento_trappola_soot_mass_Read" 6373 "PR_Stato_DPF_Read" 6374 "PR_Oil_life_Lamp_status_1_Read" 6375 "PR_Stato_richiesta_rigenerazione_filtro_particolato_Read" 6380 "PR_Risultato_rigenerazione_forzata_Read" 6381 "PR_Controllo_titolo_sonda_lambda_Read" 6383 "PR_Stato_olio_esausto_Read" 6399 "PR_Water_in_fuel_level_sensor_signal_Read" 6400 "PR_Temperatura_Carburante_Read" 6401 "PR_ADC_sensore_temperatura_carburante_Read" 6404 "PR_Duty_cycle_reg_CP1_H_Read" 6408 "PR_Stato_gestione_candelette_preriscaldo_Read" 6409 "PR_Stato_Warm_Up_Read" 6411 "PR_Glow_plug_low_voltage_command_Read" 6429 "PR_Durata_del_Power_Latch_Read" 6430 "PR_Stato_motore_Read" 6431 "PR_Stato_lampada_MIL_Read" 6432 "PR_Stato_veicolo_Read" 6433 "PR_Stato_Chiave_Read" 6435 "PR_Stato_Pedali_Read" 6436 "PR_Posizione_pedale_acceleratore_Read" 6437 "PR_ADC_ped_accel_1_Read" 6438 "PR_ADC_ped_accel_2_Read" 6439 "PR_Stato_leva_cruise_Read" 6440 "PR_Stato_cruise_control_Read" 6441 "PR_Stato_irreversibile_shut_OFF_cruise_control_Read" 6442 "PR_Stato_reversibile_shut_OFF_cruise_Read" 6443 "PR_Velocita_obiettivo_cruise_Read" 6444 "PR_Stato_segnale_L_terminal_alternatore_Read" 6445 "PR_Marcia_inserita_Read" 6446 "PR_Riconoscimento_tipo_di_trasmissione_Read" 6447 "PR_Pressione_impianto_condizionatore_Read" 6448 "PR_Stato_attivazione_condizionatore_Read" 6449 "PR_Stato_ventole_raffreddamento_Read" 6451 "PR_Stato_limit_coppia_Read" 6452 "PR_ADC_temperatura_acqua_motore_Read" 6453 "PR_Temp_aria_P_turbo_Read" 6454 "PR_ADC_temperatura_aria_sovralimentazione_sensore_pressione_turbo_Read" 6458 "PR_Attuatore_V_G_T_press_Boost_Read" 6460 "PR_Massa_aria_mis_HFM7_Read" 6461 "PR_Massa_aria_obiettivo_HFM6_Read" 6463 "PR_Temp_aria_asp_HFM7_Read" 6465 "PR_Comando_pompa_carb_Read" 6466 "PR_Consumo_carburante_Read" 6468 "PR_TVA_DC_Motor_duty_cycle_command_Read" 6469 "PR_TVA_DC_Motor_duty_cycle_status_Read" 6470 "PR_Pressione_rail_obiettivo_Read" 6471 "PR_Pressione_rail_misurata_Read" 6472 "PR_ADC_pressione_carburante_rail_sensore_Read" 6475 "PR_Stato_controllo_EGR_Read" 6476 "PR_Fail_Status_Read" 6477 "PR_Stato_switch_P_olio_Read" 6480 "PR_Tens_alim_iniettori_Read" 6481 "PR_Tensione_alimentazione_gruppo_sensori_1_Read" 6482 "PR_Tensione_alimentazione_gruppo_sensori_2_Read" 6483 "PR_Tensione_alimentazione_gruppo_sensori_3_Read" 6485 "PR_V_alim_valle_main_r_Read" 6486 "PR_Pressione_atmosferica_Read" 6487 "PR_ADC_Pressione_atmosferica_Read" 6488 "PR_Periodo_segnale_massa_aria_debimetro_Read" 6489 "PR_Pressione_turbo_obiettivo_Read" 6490 "PR_Pressione_turbo_misurata_Read" 6491 "PR_ADC_Pressione_turbo_Read" 6493 "PR_Stato_lampada_pre_riscaldo_Read" 6494 "PR_Stato_lampada_massima_temperatura_h2O_Read" 6495 "PR_Stato_lampada_Pressione_Degrado_olio_Read" 6497 "PR_Stato_lampada_cruise_control_Read" 6498 "PR_Duty_Cycle_segnale_temperatura_aria_aspirata_HFM6_Read" 6499 "PR_Stato_Boost_Read" 6500 "PR_TVA_motor_req_pos_Read" 6501 "PR_TVA_motor_meas_pos_Read" 6502 "PR_TVA_DC_motor_last_offset_learnt_Read" 6503 "PR_Stato_sincronizzazione_Read" 6504 "PR_UEGO_reference_voltage_Read" 6506 "PR_Carburante_richiesto_dalla_pompa_ad_ogni_giro_Read" 6507 "PR_Quantita_carburante_open_loop_Read" 6508 "PR_Controllo_degli_integral_term_pressione_rail_Read" 6574 "PR_DBV4_opening_counter_Read" 6575 "PR_DBV4_cumulative_opening_time_Read" 6912 "PR_Stato_Stop_Start_Read" 6913 "PR_Engine_Stop_Start_Status_Read" 6914 "PR_Status_message_S_S_received_by_ECM_Read" 6915 "PR_Crank_management_Read" 6917 "PR_Neutral_Position_acquired_value_EEprom_after_procedure_Read" 6918 "PR_Neutral_Position_Istantaneous_value_Read" 6919 "PR_Numbers_of_Automatic_Stop_Read" 6920 "PR_Numbers_of_Automatic_Start_required_by_EBCM_or_by_ECM_Driver_Read" 6921 "PR_Numbers_of_first_cranking_key_cranking_Read" 6922 "PR_Cumulative_Automatic_Engine_Stop_duration_Read" 6923 "PR_Feedback_Vsensing_state_Read" 6924 "PR_Irreversible_S_S_functionality_deactivation_Read" 6925 "PR_Temporary_S_S_functionality_deactivation_Read" 6926 "PR_Number_of_failed_automatic_crank_by_S_S_Read" 6927 "PR_Total_number_of_engine_start_up_Read" 7136 "PR_Rpm_increasing_for_PTC_or_HWS_activation_Read" 8192 "PR_Immobilizer_status_Read" 8193 "PR_Odometer_Read" 8194 "PR_Odometer_content_to_the_last_F_ROM_updating_Read" 8195 "PR_Number_of_FlashRom_re_writings_F_ROM_Read" 8196 "PR_Numero_di_eventi_di_fuorigiri_Read" 8197 "PR_Valore_massimo_di_fuori_giri_raggiunto_Read" 8198 "PR_Contature_Maximum_speed_exceeding_time_counter_Read" 8199 "PR_Odometer_value_at_last_over_speed_Read" 8200 "PR_ECU_time_stamps_EEPROM_Read" 8201 "PR_ECU_time_stamps_from_KeyOn_EEPROM_Read" 8202 "PR_KeyOn_counter_EEPROM_Read" 8203 "PR_ECU_Time_first_DTC_detection_EEPROM_Read" 8204 "PR_ECU_Time_Stamps_from_KeyOn_first_DTC_detection_EEPROM_Read" 8207 "PR_KeyOn_Counter_Status_EEPROM_Read" 8208 "PR_ProgrammingStatus_EEPROM_FLASH_Read" 8514 "PR_Circonferenza_ruote_Read" 14336 "PR_Correzione_carburante_cilindro_1_Read" 14337 "PR_Correzione_carburante_cilindro_2_Read" 14338 "PR_Correzione_carburante_cilindro_3_Read" 14339 "PR_Correzione_carburante_cilindro_4_Read" 14342 "PR_Distanza_percorsa_dall_ultima_sostituzione_DPF_Read" 14343 "PR_Distanza_percorsa_dall_ultima_rigenerazione_spontanea_Read" 14344 "PR_Valore_medio_della_temperatura_media_tra_le_ultime_5_rigenerazio_Read" 14345 "PR_Valore_medio_della_distanza_percorsa_tra_le_ultime_5_rigenerazio_Read" 14346 "PR_Valore_medio_della_durata_tra_le_ultime_5_rigenerazioni_Read" 14347 "PR_Percentuale_relativa_del_tempo_della_rigenerazione_Read" 14348 "PR_Numero_di_procedure_di_reset_automatiche_reset_Oil_Life_eseguite_Read" 14349 "PR_Numero_di_procedure_di_reset_Oil_Life_eseguite_con_procedura_man_Read" 14350 "PR_Odometro_ultima_procedura_di_reset_Oil_Life_eseguita_con_strumen_Read" 14351 "PR_Valore_odometro_all_ultima_procedura_di_reset_Oil_life_eseguit_1_Read" 14352 "PR_Rimanenza_olio_motore_espressa_in_distanza_Read" 14353 "PR_Valore_odometro_all_inizio_indicazione_richiesta_cambio_olio_Read" 14355 "PR_Current_value_of_engine_oil_remaing_life_expressed_as_remainin_1_Read" 14356 "PR_Odometro_sostituzione_CCM_Read" 14360 "PR_Informazione_cambio_olio_dovuto_all_algoritmo_Distanza_Read" 14362 "PR_Rimanenza_olio_motore_informazione_binaria_Read" 14363 "PR_Rimanenza_olio_da_algoritmo_DPF_Regenerations_Read" 14365 "PR_Total_number_of_regeneration_Read" 14366 "PR_Number_of_battery_detach_Read" 14367 "PR_Counter_of_DPF_regeneration_due_to_flow_resistance_since_the_las_Read" 14377 "PR_Codice_IMA_iniettore_cilindro_1_Read" 14378 "PR_Codice_IMA_iniettore_cilindro_2_Read" 14379 "PR_Codice_IMA_iniettore_cilindro_3_Read" 14380 "PR_Codice_IMA_iniettore_cilindro_4_Read" 14383 "PR_Codice_IMA_iniettori_1_4_Read" 14384 "PR_FPS_Snapshot_event_1_Read" 14385 "PR_FPS_Snapshot_event_2_Read" 14386 "PR_FPS_Snapshot_event_3_Read" 14387 "PR_EEprom_data_for_ECM_substitution_Read" 14388 "PR_AF_Ratio_Lambda_Read" 14389 "PR_Counter_of_DPF_regeneration_due_to_flow_resistance_Read" 14392 "PR_Driven_distance_with_water_in_fuel_lamp_ON_Read" 14393 "PR_Driven_distance_with_temperature_warning_lamp_ON_Read" 14394 "PR_Status_of_Self_Learn_functions_ex1922_Read" 16128 "PR_BOOT_CONFIGURATION_Read" 24704 "PR_Event_counter_Read" 24706 "PR_DTCFailureType_Read" 61824 "PR_BootSoftwareIdentification_Read" 61825 "PR_ApplicationSoftwareIdentification_Read" 61826 "PR_ApplicationDataIdentification_Read" 61827 "PR_BootSoftwareFingerprint_Read" 61828 "PR_ApplicationSoftwareFingerprint_Read" 61829 "PR_ApplicationDataFingerprint_Read" 61830 "PR_ActiveDiagnosticSessionDataIdentifier_Read" 61831 "PR_VehicleManufacturerSparePartNumber_Read" 61836 "PR_EcuSerialNumber_Read" 61840 "PR_VIN_Read" 61842 "PR_SystemSupplierEcuHardwareNumber_Read" 61843 "PR_SystemSupplierEcuHardwareVersionNumber_Read" 61844 "PR_SystemSupplierEcuSoftwareNumber_Read" 61845 "PR_SystemSupplierEcuSoftwareVersionNumber_Read" 61846 "PR_ExhaustRegulationOrTypeApprovalNumber_Read" 61856 "PR_IdentificationCode_Read" 61860 "PR_SincomAndFactory_Read" 61861 "PR_ISOCode_Read" 62465 "PR_PID_01_service_01_Monitor_status_since_DTCs_cleared_Read" 62466 "PR_Pid_04_service_01_Calculated_LOAD_Value_Read" 62467 "PR_Pid_05_service_01_Engine_Coolant_Temperature_Read" 62469 "PR_Pid_0B_service_01_Intake_Manifold_Absolute_Pressure_Read" 62470 "PR_Pid_0C_service_01_Engine_RPM_Read" 62471 "PR_Pid_0D_service_01_Vehicle_Speed_Sensor_Read" 62472 "PR_Pid_0F_service_01_Intake_Air_Temperature_Read" 62473 "PR_Pid_10_service_01_Air_Flow_Rate_from_Mass_Air_Flow_Sensor_Read" 62474 "PR_Pid_1C_service_01_OBD_requirement_to_which_vehicle_is_designed_Read" 62476 "PR_Pid_21_service_01_Distance_travelled_while_MIL_is_activated_Read" 62477 "PR_Pid_23_service_01_Fuel_Rail_Pressure_Read" 62478 "PR_Pid_2C_service_01_Commanded_EGR_Read" 62479 "PR_Pid_2F_service_01_Fuel_Level_Input_Read" 62481 "PR_Pid_33_service_01_Barometric_Pressure_Read" 62482 "PR_Pid_41_service_01_Monitor_status_this_driving_cycle_Read" 62483 "PR_Pid_49_service_01_Accelerator_Pedal_Position_D_Read" 62484 "PR_Pid_4A_service_01_Accelerator_Pedal_Position_E_Read" 62486 "PR_Pid_02_service_02_DTC_that_caused_required_freeze_frame_data_s_1_Read" 62487 "PR_Pid_04_service_02_Calculated_LOAD_Value_Read" 62488 "PR_Pid_05_service_02_Engine_Coolant_Temperature_Read" 62489 "PR_Pid_0B_service_02_Intake_Manifold_Absolute_Pressure_Read" 62490 "PR_Pid_0C_service_02_Engine_RPM_Read" 62491 "PR_Pid_0D_service_02_Vehicle_speed_Sensor_Read" 62492 "PR_Pid_0F_service_02_Intake_Air_Temperature_Read" 62493 "PR_Pid_10_service_02_Air_Flow_Rate_from_Mass_Air_Flow_Sensor_Read" 62494 "PR_Pid_23_service_02_Fuel_rail_pressure_Read" 63025 "PR_Pid_31_service_06_Air_flow_mass_drift_EGR_Monitor_Bank_1_OBDMI_1_Read" 63489 "PR_Pid_01_service_09_MessageCount_VIN_Read" 63490 "PR_Pid_02_service_09_Vehicle_Identification_Number_VIN_Read" 63491 "PR_Pid_03_service_09_MessageCount_CALID_Read" 63492 "PR_Service_08_PID03_MessageCount_CALID_1_Read" 65279 "PR_DIAnalyzer_support_Infos_DIAnalyzerConfiguration";
VAL_ 2 service_11 1 "PR_HardReset_Reset";
VAL_ 2 service_27 1 "PR_Level1Seed_Request" 2 "PR_Level1Key_Send" 5 "PR_VINRequestSeed_Request" 6 "PR_VINSendKey_Send";
VAL_ 2 service_28 0 "PR_EnableRxAndEnableTx_Ctrl" 1 "PR_EnableRxAndDisableTx_Ctrl";
VAL_ 2 service_3e 0 "PR_TesterPresent_Tester_Prresent";
VAL_ 2 service_85 1 "PR_DtcSettingOn_Ctrl" 2 "PR_DtcSettingOff_Ctrl";
VAL_ 2 service_2e 14377 "PR_Codice_IMA_iniettore_cilindro_1_Write" 14378 "PR_Codice_IMA_iniettore_cilindro_2_Write" 14379 "PR_Codice_IMA_iniettore_cilindro_3_Write" 14380 "PR_Codice_IMA_iniettore_cilindro_4_Write" 14383 "PR_Codice_IMA_iniettori_1_4_Write" 14387 "PR_EEprom_data_for_ECM_substitution_Write" 61827 "PR_BootSoftwareFingerprint_Write" 61828 "PR_ApplicationSoftwareFingerprint_Write" 61829 "PR_ApplicationDataFingerprint_Write" 61840 "PR_VIN_Write" 61860 "PR_SincomAndFactory_Write";
VAL_ 2 service_2a 0 "PR_F200_Periodic_Identifier_ReadPeriodicFast" 1 "PR_F201_Periodic_Identifier_ReadPeriodicFast" 176 "PR_HFM_Data_ReadPeriodicFast" 177 "PR_HO2S_Data_ReadPeriodicFast" 178 "PR_Dati_Carburante_ReadPeriodicFast" 179 "PR_Dinamica_Veicolo_ReadPeriodicFast";
VAL_ 2 service_2c 1 "PR_F301_Periodic_Identifier_Define" 3 "PR_Clear_All_Dynamically_Defined_Data_Identifier_ClearAll";
VAL_ 2 service_19 2 "PR_FaultMem_SUBF_02" 4 "PR_FaultMem_SUBF_04" 6 "PR_FaultMem_SUBF_06" 7 "PR_FaultMem_SUBF_07" 8 "PR_FaultMem_SUBF_08" 9 "PR_FaultMem_SUBF_09" 12 "PR_FaultMem_SUBF_0C" 14 "PR_FaultMem_SUBF_0E";
VAL_ 2 service_2f 20480 "PR_Reset_funzioni_autoapprese_Reset" 20481 "PR_Comando_rele_compressore_aria_condizionata_Freeze" 20482 "PR_Stop_generale_tutti_attuatori_ReturnControl" 20501 "PR_H2O_in_fuel_filter_lamp_Freeze" 20503 "PR_Comando_lampada_pressione_olio_Freeze" 20504 "PR_Comando_lampada_massima_temperatura_acqua_Freeze" 20505 "PR_Comando_lampada_MIL_Freeze" 20513 "PR_Fuel_pump_rel_Freeze" 20520 "PR_Sblocco_immobilizer_Control" 20522 "PR_Comando_lampada_candelette_Freeze" 20523 "PR_Attuatore_Boost_Freeze" 20524 "PR_Comando_lampada_cruise_control_Freeze" 20525 "PR_Reset_parametri_funzione_oil_life_Reset" 20527 "PR_Comando_regolatore_portata_carburante_CP1_H_Freeze" 20528 "PR_Comando_lampada_messaggio_trappola_particolato_DPF_Freeze" 20530 "PR_EGR_cooler_bypass_command_Freeze";
VAL_ 2 service_31 1 "PR_checkProgrammingDependencies_FlashChecksum_Start" 2 "PR_Fan_activation_Stop" 3 "PR_checkProgrammingDependencies_FlashChecksum_ReqResults";
VAL_ 2 service_01 0 "PR_Supported_PIDs_from_01_to_20_Current_data" 1 "PR_Stato_sistema_Current_data" 4 "PR_Calculated_LOAD_value_Current_data" 5 "PR_Engine_Coolant_Temperature_Current_data" 11 "PR_Intake_Manifold_Absolute_Pressure_Current_data" 12 "PR_Giri_motore_Current_data" 13 "PR_Vehicle_Speed_Sensor_Current_data" 15 "PR_Intake_Air_Temperature_Current_data" 16 "PR_Air_Flow_Rate_from_Mass_Air_Current_data" 28 "PR_OBD_requirements_to_which_vehicle_is_designed_Current_data" 32 "PR_Supported_PIDs_from_21_to_40_Current_data" 33 "PR_Distance_Travelled_While_MIL_is_Activated_Current_data" 35 "PR_Fuel_Rail_Pressure_relative_to_manifold_vacuum_Current_data" 44 "PR_Commanded_EGR_Current_data" 47 "PR_Fuel_Level_Input_Current_data" 51 "PR_Barometric_Pressure_Current_data" 64 "PR_Supported_PIDs_from_41_to_60_Current_data" 65 "PR_Monitor_status_this_driving_cycle_Current_data" 73 "PR_Accelerator_Pedal_Position_D_Current_data" 74 "PR_Accelerator_Pedal_Position_E_Current_data";
VAL_ 2 service_02 0 "PR_Supported_PIDs_from_01_to_20_Freeze_Frame_data" 2 "PR_DTC_that_caused_required_freeze_frame_data_storage_Freeze_Frame_data" 4 "PR_Calculated_LOAD_value_Freeze_Frame_data" 5 "PR_Engine_Coolant_Temperature_Freeze_Frame_data" 11 "PR_Intake_Manifold_Absolute_Pressure_Freeze_Frame_data" 12 "PR_Giri_motore_Freeze_Frame_data" 13 "PR_Vehicle_Speed_Sensor_Freeze_Frame_data" 15 "PR_Intake_Air_Temperature_Freeze_Frame_data" 16 "PR_Air_Flow_Rate_from_Mass_Air_Freeze_Frame_data" 32 "PR_Supported_PIDs_from_21_to_40_Freeze_Frame_data" 35 "PR_Fuel_Rail_Pressure_relative_to_manifold_vacuum_Freeze_Frame_data";
VAL_ 2 service_09 0 "PR_Supported_PIDs_from_01_to_20_Vehicle_Info" 1 "PR_MessageCount_VIN_Vehicle_Info" 2 "PR_Vehicle_Identification_Number_VIN_Vehicle_Info" 3 "PR_MessageCount_CALID_Vehicle_Info" 4 "PR_Identificativi_di_calibrazione_Vehicle_Info";
VAL_ 2 service_08 0 "PR_TID_00_Control";
VAL_ 2 service_06 0 "PR_Supported_TIDs_from_01_to_20_Test_results" 32 "PR_Supported_TIDs_from_21_to_40_Test_results" 49 "PR_Air_flow_mass_drift_EGR_Monitor_Bank_1_OBDMID_31_Test_results";
VAL_ 2 service_7f 4 "NR_Scan_Tool_Fault_Memory_Clear_reset_Faults" 8 "NR_TID_00_Control" 9 "NR_Identificativi_di_calibrazione_Vehicle_Info" 16 "NR_ExtendedDiagnostic_Start" 17 "NR_HardReset_Reset" 20 "NR_FaultMem_Clear" 25 "NR_FaultMem_SUBF_0E" 34 "NR_F301_Periodic_Identifier_Read" 39 "NR_VINSendKey_Send" 40 "NR_EnableRxAndDisableTx_Ctrl" 42 "NR_F201_Periodic_Identifier_ReadPeriodicStop" 44 "NR_Clear_All_Dynamically_Defined_Data_Identifier_ClearAll" 46 "NR_SincomAndFactory_Write" 47 "NR_EGR_cooler_bypass_command_Freeze" 49 "NR_checkProgrammingDependencies_FlashChecksum_ReqResults" 52 "NR_Download_Request" 54 "NR_Download_TransferData" 55 "NR_Download_ReqTransferExit" 62 "NR_TesterPresent_Tester_Prresent" 133 "NR_DtcSettingOff_Ctrl";
