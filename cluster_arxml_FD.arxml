AUTOSAR XML (schema 4-2-2)
package /VectorAutosarExplorerGeneratedObjects/SYSTEM
  system System
package /VectorAutosarExplorerGeneratedObjects/New_CanCluster
  can cluster New_CanCluster: baudrate=250000, protocol-name=CAN, speed=250000
    can physical channel CANChannel: comm-connectors=Connector_New_ECU_b3cb46ba7a69333c
      frame New_Frame: id 0x1, to New_ECU, frame-length=38, can-addressing-mode=STANDARD, can-frame-tx-behavior=CAN-FD
        container i pdu New_Frame: length=38, contained-pdu-triggering=[NewPduTriggering_3290c69bca1b0e65, NewPduTriggering_e829041bafb0fd91], container-timeout=0.01, container-trigger=DEFAULT-TRIGGER, header-type=SHORT-HEADER, rx-accept-contained-i-pdu=ACCEPT-CONFIGURED, threshold-size=0
      pdu triggering NewPduTriggering_3290c69bca1b0e65: pdu=New_Frame_NewPDU, to New_ECU
      pdu triggering NewPduTriggering_e829041bafb0fd91: pdu=New_Frame_NewPDU_1, to New_ECU
package /VectorAutosarExplorerGeneratedObjects/PDUS
  pdu New_Frame_NewPDU: length=8, contained-i-pdu-props={collection-semantics=LAST-IS-BEST, header-id-long-header=0, header-id-short-header=116, trigger=NEVER}
    signal New_Frame_NewPDU_NewSignal: start 7, 8 bit, little-endian, system signal New_Frame_NewPDU_NewSignal_ce47c664f30ddccd, data-type-policy=OVERRIDE, base-type=New_BaseType, to New_ECU
    signal New_Frame_NewPDU_NewSignal_1: start 15, 8 bit, little-endian, system signal New_Frame_NewPDU_NewSignal_1_db5002b5aa178de4, data-type-policy=OVERRIDE, base-type=New_BaseType, to New_ECU
  pdu New_Frame_NewPDU_1: length=8, contained-i-pdu-props={collection-semantics=LAST-IS-BEST, header-id-long-header=0, header-id-short-header=117, trigger=NEVER}
    signal New_Frame_NewPDU_1_NewSignal: start 0, 8 bit, little-endian, system signal New_Frame_NewPDU_1_NewSignal_f5a991f667a43514, data-type-policy=OVERRIDE, base-type=New_BaseType, to New_ECU
    signal New_Frame_NewPDU_1_NewSignal_1: start 8, 8 bit, little-endian, system signal New_Frame_NewPDU_1_NewSignal_1_c176e6f09e457129, data-type-policy=OVERRIDE, base-type=New_BaseType, to New_ECU
package /VectorAutosarExplorerGeneratedObjects/BASE_TYPES
  base type New_BaseType: base-type-size=16, base-type-encoding=NONE
package /VectorAutosarExplorerGeneratedObjects/ECU_INSTANCES
  ecu instance New_ECU: associated-com-i-pdu-group=[PduGroup_ce5483d5f38342929df699b18b858436_Rx, PduGroup_844863dc06fb4b8b96a2858716bf38f2_Rx], diagnostic-address=0
    can communication controller Controller_New_ECU_e5e4e7fd260b1062
    can communication connector Connector_New_ECU_b3cb46ba7a69333c: comm-controller=Controller_New_ECU_e5e4e7fd260b1062
package /VectorAutosarExplorerGeneratedObjects/PDU_GROUP
  i signal i pdu group PduGroup_ce5483d5f38342929df699b18b858436_Rx: communication-direction=IN
  i signal i pdu group PduGroup_844863dc06fb4b8b96a2858716bf38f2_Rx: communication-direction=IN
