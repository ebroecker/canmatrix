VERSION "created by canmatrix"

NS_ :

BS_:

BU_:

BO_ 17 Frame_1: 8 Vector__XXX
 SG_ Signal : 0|8@1- (1,0) [0|0] "" Vector__XXX

VAL_ 17 Signal 0 "zero" 1 "one " 2 "string with \"escaped\" double quotes";
