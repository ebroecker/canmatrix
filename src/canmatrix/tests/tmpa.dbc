VERSION "created by canmatrix"

NS_ :

BS_:

BU_:

BO_ 292 testFrame3: 8 testBU
 SG_ someTestSignal : 7|11@0+ (5,1) [0|500] "" recBU

VAL_ 292 someTestSignal 1 "one";
