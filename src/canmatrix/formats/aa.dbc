VERSION ""

NS_ :

BS_:

BU_:

BO_ 1409 SDO_TX: 8 Vector__XXX
 SG_ CMD_CCS M : 5|3@1+ (1,0) [0|0] "" Vector__XXX
 SG_ Index m2M : 8|24@1+ (1,0) [0|0] "" Vector__XXX
 SG_ Motor_temperature m8229 : 32|8@1+ (1,0) [0|0] "degC" Vector__XXX
 SG_ Controller_temperature m73766 : 32|8@1+ (1,0) [0|0] "" Vector__XXX
 SG_ APP_1_Max_Fw_Velocity m1060865 : 32|32@1- (1,0) [0|0] "" Vector__XXX
 SG_ Torque_regulator_actual m139291 : 32|16@1- (1,0) [0|0] "quants" Vector__XXX
 SG_ Throttle_voltage m73840 : 32|16@1- (1,0) [0|0] "mV" Vector__XXX

BA_DEF_  "BusType" STRING ;
BA_DEF_DEF_  "BusType" "CAN";

SG_MUL_VAL_ 1409 Motor_temperature Index 8229-8229;
SG_MUL_VAL_ 1409 Index CMD_CCS 2-2;
SG_MUL_VAL_ 1409 Controller_temperature Index 73766-73766;
SG_MUL_VAL_ 1409 APP_1_Max_Fw_Velocity Index 1060865-1060865;
SG_MUL_VAL_ 1409 Torque_regulator_actual Index 139291-139291;
SG_MUL_VAL_ 1409 Throttle_voltage Index 73840-73840;
