AUTOSAR XML (schema 4-2-2)
package /VectorAutosarExplorerGeneratedObjects/SYSTEM
  system System
package /VectorAutosarExplorerGeneratedObjects/New_CanCluster
  can cluster New_CanCluster: baudrate=250000, protocol-name=CAN, speed=250000
    can physical channel CANChannel: comm-connectors=Connector_New_ECU_1c8171768535fd8f
      frame New_Frame: id 0x1, to New_ECU, frame-length=8, can-addressing-mode=STANDARD, can-frame-tx-behavior=CAN-FD
        pdu New_Frame_NewPDU: length=8
          signal New_Frame_NewPDU_NewSignal: start 0, 8 bit, big-endian, system signal New_Frame_NewPDU_NewSignal_d3ad4ded3d1f5a52, data-type-policy=OVERRIDE, base-type=New_BaseType, compu {phys=(0+1*raw)/(0+1*raw) for raw 0..255}, range phys 0..25, raw 0..250, transfer-property=PENDING, to New_ECU
          signal New_Frame_NewPDU_NewSignal_1: start 1, 4 bit, big-endian, system signal New_Frame_NewPDU_NewSignal_1_97dba33bf5006571, data-type-policy=OVERRIDE, base-type=New_BaseType, compu {phys=(0+1*raw)/(0+1*raw) for raw 0..16}, transfer-property=PENDING, to New_ECU
          signal New_Frame_NewPDU_NewSignal_2: start 16, 16 bit, little-endian, system signal New_Frame_NewPDU_NewSignal_2_c4d5cde179c23521, data-type-policy=OVERRIDE, base-type=New_BaseType, compu {phys=(0+0.125*raw)/(0+1*raw) for raw 0..65534}, to New_ECU
          signal New_Frame_NewPDU_NewSignal_3: start 32, 12 bit, big-endian, system signal New_Frame_NewPDU_NewSignal_3_545262b7a6cd1260, data-type-policy=OVERRIDE, base-type=New_BaseType, compu {phys=(-400+0.5*raw)/(0+1*raw) for raw 0..4094}, transfer-property=PENDING, to New_ECU
          signal New_Frame_NewPDU_NewSignal_4: start 56, 2 bit, big-endian, system signal New_Frame_NewPDU_NewSignal_4_7c569e4203cfd6a3, data-type-policy=OVERRIDE, base-type=New_BaseType, compu {phys=(0+1*raw)/(0+1*raw) for raw 0}, transfer-property=PENDING, to New_ECU
          signal New_Frame_NewPDU_NewSignal_5: start 2, 1 bit, big-endian, system signal New_Frame_NewPDU_NewSignal_5_0fa1a7a828ef955d, data-type-policy=OVERRIDE, base-type=New_BaseType, compu {phys=(-20000+2*raw)/(0+1*raw) for raw 0..20000}, transfer-property=PENDING, to New_ECU
package /VectorAutosarExplorerGeneratedObjects/ECU_INSTANCES
  ecu instance New_ECU: associated-com-i-pdu-group=PduGroup_3d1efacc48324fb6a458184295d222c5_Rx, diagnostic-address=0
    can communication controller Controller_New_ECU_26c2009afd6ed0f5
    can communication connector Connector_New_ECU_1c8171768535fd8f: comm-controller=Controller_New_ECU_26c2009afd6ed0f5
package /VectorAutosarExplorerGeneratedObjects/BASE_TYPES
  base type New_BaseType: base-type-size=16, base-type-encoding=NONE
package /VectorAutosarExplorerGeneratedObjects/PDU_GROUP
  i signal i pdu group PduGroup_3d1efacc48324fb6a458184295d222c5_Rx: communication-direction=IN
