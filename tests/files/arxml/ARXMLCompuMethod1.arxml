AUTOSAR XML (schema 323)
ar-package:
  compu method New_Frame_NewPDU_NewSignal_Encoding: 0=no trailer detected, 1=trailer detected, phys=raw*42+17 for raw 0
