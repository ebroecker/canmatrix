AUTOSAR XML (schema 323)
package /Cluster
  can cluster CAN
    can physical channel CAN
      frame FRAME_testFrame1_SEC: id 0x123, from testBU, to recBU, frame-length=8, can-addressing-mode=STANDARD  # Multi Line Frame comment
        secured i pdu secPdu: length=64, payload=/PDU/myPayLoad
      frame FRAME_extendedFrame: id 0x12, from testBU, frame-length=8, can-addressing-mode=EXTENDED
        pdu PDU_extendedFrame: length=64
      pdu triggering IPDUTRIGG_testFrame1: pdu=PDU_testFrame1
package /PDU
  payload myPayLoad: i-pdu=/PDU/PDU_testFrame1
  pdu PDU_testFrame1: length=64
    signal someTestSignal: start 3, 11 bit, big-endian, data-type=someTestSignal, to recBU  # Multi Line Signal comment with a-umlaut: ä
    signal Signal: start 20, 3 bit, little-endian, data-type=Signal, to recBU
package /DataType
  integer type someTestSignal: compu {phys=raw*5+1}
  integer type Signal: compu {1=one, 2=two, 3=three, phys=raw}
package /DataType/Unit
  unit someTestSignal: display-name=specialCharUnit°$
  unit Signal: display-name=someUnit
package /ECU
  ecu instance testBU: associated-i-pdu-group=testBU_Tx  # sender ECU
    communication connector CN_testBU
  ecu instance recBU: associated-i-pdu-group=recBU_Rx  # receiver ECU
    communication connector CN_recBU
package /IPDUGroup
  i pdu group testBU_Tx: communication-direction=OUT, i-pdu=[PDU_testFrame1, PDU_extendedFrame]
  i pdu group recBU_Rx: communication-direction=IN, i-pdu=PDU_testFrame1
