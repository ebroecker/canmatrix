VERSION ""

NS_ :

BS_:

BU_: External_Tool IFV SODFR SODFL

BO_ 798 SODFL_DETECTION_121_124: 64 SODFL
 SG_ CAN_FL_DET_RANGE_121 : 7|14@0+ (0.015625,0) [0|255.984375] "m"  IFV
 SG_ CAN_FL_DET_SD_RANGE_121 : 9|6@0+ (0.025,0) [0|1.5] "m"  IFV
 SG_ CAN_FL_DET_RANGE_RATE_121 : 19|14@0+ (0.015625,-128) [-128|127.984375] "m/s"  IFV
 SG_ CAN_FL_DET_SD_RANGE_RATE_121 : 37|6@0+ (0.02,0) [0|1.2] "m/s"  IFV
 SG_ CAN_FL_DET_AZIMUTH_121 : 47|13@0+ (0.0007668,-3.141593) [-3.141593|3.141593] "rad"  IFV
 SG_ CAN_FL_DET_SD_AZIMUTH_121 : 50|6@0+ (0.001745329,0) [0|0.104719755] "rad"  IFV
 SG_ CAN_FL_DET_ELEVATION_121 : 60|7@0+ (0.157449,-9.99812) [-9.99812|9.997903] "deg"  IFV
 SG_ CAN_FL_DET_SD_ELEVATION_121 : 69|6@0+ (0.003490659,0) [0|0.20943951] "rad"  IFV
 SG_ CAN_FL_DET_AMPLITUDE_121 : 79|7@0+ (1,-64) [-64|63] "dBsm"  IFV
 SG_ CAN_FL_DET_VALID_FLAG_121 : 72|1@0+ (1,0) [0|1] ""  IFV
 SG_ CAN_FL_DET_SUPER_RES_121 : 80|1@0+ (1,0) [0|1] ""  IFV
 SG_ CAN_FL_DET_LOW_SNR_FLAG_121 : 81|1@0+ (1,0) [0|1] ""  IFV
 SG_ CAN_FL_DET_MIXER_BIAS_FLAG_121 : 82|1@0+ (1,0) [0|1] ""  IFV
 SG_ CAN_FL_DET_RESERVED_FLAGS_121 : 87|5@0+ (1,0) [0|31] ""  IFV
 SG_ CAN_FL_DET_SNR_121 : 95|8@0+ (0.35156,0) [0|89.6478] "dB"  IFV
 SG_ CAN_FL_DET_MULTI_TARGET_PROB_121 : 99|4@0+ (0.06667,0) [0|1] ""  IFV
 SG_ CAN_FL_DET_CONFID_AZIMUTH_121 : 101|2@0+ (1,0) [0|3] ""  IFV
 SG_ CAN_FL_DET_CONFID_ELEVATION_121 : 103|2@0+ (1,0) [0|3] ""  IFV
 SG_ CAN_FL_DET_EXISTENCE_PROB_121 : 107|4@0+ (1,0) [0|15] ""  IFV
 SG_ CAN_FL_DET_CLASS_121 : 111|4@0+ (1,0) [0|15] ""  IFV
 SG_ CAN_FL_DET_RANGE_122 : 127|14@0+ (0.015625,0) [0|255.984375] "m"  IFV
 SG_ CAN_FL_DET_SD_RANGE_122 : 129|6@0+ (0.025,0) [0|1.5] "m"  IFV
 SG_ CAN_FL_DET_RANGE_RATE_122 : 139|14@0+ (0.015625,-128) [-128|127.984375] "m/s"  IFV
 SG_ CAN_FL_DET_SD_RANGE_RATE_122 : 157|6@0+ (0.02,0) [0|1.2] "m/s"  IFV
 SG_ CAN_FL_DET_AZIMUTH_122 : 167|13@0+ (0.0007668,-3.141593) [-3.141593|3.141593] "rad"  IFV
 SG_ CAN_FL_DET_SD_AZIMUTH_122 : 170|6@0+ (0.001745329,0) [0|0.104719755] "rad"  IFV
 SG_ CAN_FL_DET_ELEVATION_122 : 180|7@0+ (0.157449,-9.99812) [-9.99812|9.997903] "deg"  IFV
 SG_ CAN_FL_DET_SD_ELEVATION_122 : 189|6@0+ (0.003490659,0) [0|0.20943951] "rad"  IFV
 SG_ CAN_FL_DET_AMPLITUDE_122 : 199|7@0+ (1,-64) [-64|63] "dBsm"  IFV
 SG_ CAN_FL_DET_VALID_FLAG_122 : 192|1@0+ (1,0) [0|1] ""  IFV
 SG_ CAN_FL_DET_SUPER_RES_122 : 200|1@0+ (1,0) [0|1] ""  IFV
 SG_ CAN_FL_DET_LOW_SNR_FLAG_122 : 201|1@0+ (1,0) [0|1] ""  IFV
 SG_ CAN_FL_DET_MIXER_BIAS_FLAG_122 : 202|1@0+ (1,0) [0|1] ""  IFV
 SG_ CAN_FL_DET_RESERVED_FLAGS_122 : 207|5@0+ (1,0) [0|31] ""  IFV
 SG_ CAN_FL_DET_SNR_122 : 215|8@0+ (0.35156,0) [0|89.6478] "dB"  IFV
 SG_ CAN_FL_DET_MULTI_TARGET_PROB_122 : 219|4@0+ (0.06667,0) [0|1] ""  IFV
 SG_ CAN_FL_DET_CONFID_AZIMUTH_122 : 221|2@0+ (1,0) [0|3] ""  IFV
 SG_ CAN_FL_DET_CONFID_ELEVATION_122 : 223|2@0+ (1,0) [0|3] ""  IFV
 SG_ CAN_FL_DET_EXISTENCE_PROB_122 : 227|4@0+ (1,0) [0|15] ""  IFV
 SG_ CAN_FL_DET_CLASS_122 : 231|4@0+ (1,0) [0|15] ""  IFV
 SG_ CAN_FL_DET_RANGE_123 : 247|14@0+ (0.015625,0) [0|255.984375] "m"  IFV
 SG_ CAN_FL_DET_SD_RANGE_123 : 249|6@0+ (0.025,0) [0|1.5] "m"  IFV
 SG_ CAN_FL_DET_RANGE_RATE_123 : 259|14@0+ (0.015625,-128) [-128|127.984375] "m/s"  IFV
 SG_ CAN_FL_DET_SD_RANGE_RATE_123 : 277|6@0+ (0.02,0) [0|1.2] "m/s"  IFV
 SG_ CAN_FL_DET_AZIMUTH_123 : 287|13@0+ (0.0007668,-3.141593) [-3.141593|3.141593] "rad"  IFV
 SG_ CAN_FL_DET_SD_AZIMUTH_123 : 290|6@0+ (0.001745329,0) [0|0.104719755] "rad"  IFV
 SG_ CAN_FL_DET_ELEVATION_123 : 300|7@0+ (0.157449,-9.99812) [-9.99812|9.997903] "deg"  IFV
 SG_ CAN_FL_DET_SD_ELEVATION_123 : 309|6@0+ (0.003490659,0) [0|0.20943951] "rad"  IFV
 SG_ CAN_FL_DET_AMPLITUDE_123 : 319|7@0+ (1,-64) [-64|63] "dBsm"  IFV
 SG_ CAN_FL_DET_VALID_FLAG_123 : 312|1@0+ (1,0) [0|1] ""  IFV
 SG_ CAN_FL_DET_SUPER_RES_123 : 320|1@0+ (1,0) [0|1] ""  IFV
 SG_ CAN_FL_DET_LOW_SNR_FLAG_123 : 321|1@0+ (1,0) [0|1] ""  IFV
 SG_ CAN_FL_DET_MIXER_BIAS_FLAG_123 : 322|1@0+ (1,0) [0|1] ""  IFV
 SG_ CAN_FL_DET_RESERVED_FLAGS_123 : 327|5@0+ (1,0) [0|31] ""  IFV
 SG_ CAN_FL_DET_SNR_123 : 335|8@0+ (0.35156,0) [0|89.6478] "dB"  IFV
 SG_ CAN_FL_DET_MULTI_TARGET_PROB_123 : 339|4@0+ (0.06667,0) [0|1] ""  IFV
 SG_ CAN_FL_DET_CONFID_AZIMUTH_123 : 341|2@0+ (1,0) [0|3] ""  IFV
 SG_ CAN_FL_DET_CONFID_ELEVATION_123 : 343|2@0+ (1,0) [0|3] ""  IFV
 SG_ CAN_FL_DET_EXISTENCE_PROB_123 : 347|4@0+ (1,0) [0|15] ""  IFV
 SG_ CAN_FL_DET_CLASS_123 : 351|4@0+ (1,0) [0|15] ""  IFV
 SG_ CAN_FL_DET_RANGE_124 : 367|14@0+ (0.015625,0) [0|255.984375] "m"  IFV
 SG_ CAN_FL_DET_SD_RANGE_124 : 369|6@0+ (0.025,0) [0|1.5] "m"  IFV
 SG_ CAN_FL_DET_RANGE_RATE_124 : 379|14@0+ (0.015625,-128) [-128|127.984375] "m/s"  IFV
 SG_ CAN_FL_DET_SD_RANGE_RATE_124 : 397|6@0+ (0.02,0) [0|1.2] "m/s"  IFV
 SG_ CAN_FL_DET_AZIMUTH_124 : 407|13@0+ (0.0007668,-3.141593) [-3.141593|3.141593] "rad"  IFV
 SG_ CAN_FL_DET_SD_AZIMUTH_124 : 410|6@0+ (0.001745329,0) [0|0.104719755] "rad"  IFV
 SG_ CAN_FL_DET_ELEVATION_124 : 420|7@0+ (0.157449,-9.99812) [-9.99812|9.997903] "deg"  IFV
 SG_ CAN_FL_DET_SD_ELEVATION_124 : 429|6@0+ (0.003490659,0) [0|0.20943951] "rad"  IFV
 SG_ CAN_FL_DET_AMPLITUDE_124 : 439|7@0+ (1,-64) [-64|63] "dBsm"  IFV
 SG_ CAN_FL_DET_VALID_FLAG_124 : 432|1@0+ (1,0) [0|1] ""  IFV
 SG_ CAN_FL_DET_SUPER_RES_124 : 440|1@0+ (1,0) [0|1] ""  IFV
 SG_ CAN_FL_DET_LOW_SNR_FLAG_124 : 441|1@0+ (1,0) [0|1] ""  IFV
 SG_ CAN_FL_DET_MIXER_BIAS_FLAG_124 : 442|1@0+ (1,0) [0|1] ""  IFV
 SG_ CAN_FL_DET_RESERVED_FLAGS_124 : 447|5@0+ (1,0) [0|31] ""  IFV
 SG_ CAN_FL_DET_SNR_124 : 455|8@0+ (0.35156,0) [0|89.6478] "dB"  IFV
 SG_ CAN_FL_DET_MULTI_TARGET_PROB_124 : 459|4@0+ (0.06667,0) [0|1] ""  IFV
 SG_ CAN_FL_DET_CONFID_AZIMUTH_124 : 461|2@0+ (1,0) [0|3] ""  IFV
 SG_ CAN_FL_DET_CONFID_ELEVATION_124 : 463|2@0+ (1,0) [0|3] ""  IFV
 SG_ CAN_FL_DET_EXISTENCE_PROB_124 : 467|4@0+ (1,0) [0|15] ""  IFV
 SG_ CAN_FL_DET_CLASS_124 : 471|4@0+ (1,0) [0|15] ""  IFV

BO_ 799 SODFL_DETECTION_125_128: 64 SODFL
 SG_ CAN_FL_DET_RANGE_125 : 7|14@0+ (0.015625,0) [0|255.984375] "m"  IFV
 SG_ CAN_FL_DET_SD_RANGE_125 : 9|6@0+ (0.025,0) [0|1.5] "m"  IFV
 SG_ CAN_FL_DET_RANGE_RATE_125 : 19|14@0+ (0.015625,-128) [-128|127.984375] "m/s"  IFV
 SG_ CAN_FL_DET_SD_RANGE_RATE_125 : 37|6@0+ (0.02,0) [0|1.2] "m/s"  IFV
 SG_ CAN_FL_DET_AZIMUTH_125 : 47|13@0+ (0.0007668,-3.141593) [-3.141593|3.141593] "rad"  IFV
 SG_ CAN_FL_DET_SD_AZIMUTH_125 : 50|6@0+ (0.001745329,0) [0|0.104719755] "rad"  IFV
 SG_ CAN_FL_DET_ELEVATION_125 : 60|7@0+ (0.157449,-9.99812) [-9.99812|9.997903] "deg"  IFV
 SG_ CAN_FL_DET_SD_ELEVATION_125 : 69|6@0+ (0.003490659,0) [0|0.20943951] "rad"  IFV
 SG_ CAN_FL_DET_AMPLITUDE_125 : 79|7@0+ (1,-64) [-64|63] "dBsm"  IFV
 SG_ CAN_FL_DET_VALID_FLAG_125 : 72|1@0+ (1,0) [0|1] ""  IFV
 SG_ CAN_FL_DET_SUPER_RES_125 : 80|1@0+ (1,0) [0|1] ""  IFV
 SG_ CAN_FL_DET_LOW_SNR_FLAG_125 : 81|1@0+ (1,0) [0|1] ""  IFV
 SG_ CAN_FL_DET_MIXER_BIAS_FLAG_125 : 82|1@0+ (1,0) [0|1] ""  IFV
 SG_ CAN_FL_DET_RESERVED_FLAGS_125 : 87|5@0+ (1,0) [0|31] ""  IFV
 SG_ CAN_FL_DET_SNR_125 : 95|8@0+ (0.35156,0) [0|89.6478] "dB"  IFV
 SG_ CAN_FL_DET_MULTI_TARGET_PROB_125 : 99|4@0+ (0.06667,0) [0|1] ""  IFV
 SG_ CAN_FL_DET_CONFID_AZIMUTH_125 : 101|2@0+ (1,0) [0|3] ""  IFV
 SG_ CAN_FL_DET_CONFID_ELEVATION_125 : 103|2@0+ (1,0) [0|3] ""  IFV
 SG_ CAN_FL_DET_EXISTENCE_PROB_125 : 107|4@0+ (1,0) [0|15] ""  IFV
 SG_ CAN_FL_DET_CLASS_125 : 111|4@0+ (1,0) [0|15] ""  IFV
 SG_ CAN_FL_DET_RANGE_126 : 127|14@0+ (0.015625,0) [0|255.984375] "m"  IFV
 SG_ CAN_FL_DET_SD_RANGE_126 : 129|6@0+ (0.025,0) [0|1.5] "m"  IFV
 SG_ CAN_FL_DET_RANGE_RATE_126 : 139|14@0+ (0.015625,-128) [-128|127.984375] "m/s"  IFV
 SG_ CAN_FL_DET_SD_RANGE_RATE_126 : 157|6@0+ (0.02,0) [0|1.2] "m/s"  IFV
 SG_ CAN_FL_DET_AZIMUTH_126 : 167|13@0+ (0.0007668,-3.141593) [-3.141593|3.141593] "rad"  IFV
 SG_ CAN_FL_DET_SD_AZIMUTH_126 : 170|6@0+ (0.001745329,0) [0|0.104719755] "rad"  IFV
 SG_ CAN_FL_DET_ELEVATION_126 : 180|7@0+ (0.157449,-9.99812) [-9.99812|9.997903] "deg"  IFV
 SG_ CAN_FL_DET_SD_ELEVATION_126 : 189|6@0+ (0.003490659,0) [0|0.20943951] "rad"  IFV
 SG_ CAN_FL_DET_AMPLITUDE_126 : 199|7@0+ (1,-64) [-64|63] "dBsm"  IFV
 SG_ CAN_FL_DET_VALID_FLAG_126 : 192|1@0+ (1,0) [0|1] ""  IFV
 SG_ CAN_FL_DET_SUPER_RES_126 : 200|1@0+ (1,0) [0|1] ""  IFV
 SG_ CAN_FL_DET_LOW_SNR_FLAG_126 : 201|1@0+ (1,0) [0|1] ""  IFV
 SG_ CAN_FL_DET_MIXER_BIAS_FLAG_126 : 202|1@0+ (1,0) [0|1] ""  IFV
 SG_ CAN_FL_DET_RESERVED_FLAGS_126 : 207|5@0+ (1,0) [0|31] ""  IFV
 SG_ CAN_FL_DET_SNR_126 : 215|8@0+ (0.35156,0) [0|89.6478] "dB"  IFV
 SG_ CAN_FL_DET_MULTI_TARGET_PROB_126 : 219|4@0+ (0.06667,0) [0|1] ""  IFV
 SG_ CAN_FL_DET_CONFID_AZIMUTH_126 : 221|2@0+ (1,0) [0|3] ""  IFV
 SG_ CAN_FL_DET_CONFID_ELEVATION_126 : 223|2@0+ (1,0) [0|3] ""  IFV
 SG_ CAN_FL_DET_EXISTENCE_PROB_126 : 227|4@0+ (1,0) [0|15] ""  IFV
 SG_ CAN_FL_DET_CLASS_126 : 231|4@0+ (1,0) [0|15] ""  IFV
 SG_ CAN_FL_DET_RANGE_127 : 247|14@0+ (0.015625,0) [0|255.984375] "m"  IFV
 SG_ CAN_FL_DET_SD_RANGE_127 : 249|6@0+ (0.025,0) [0|1.5] "m"  IFV
 SG_ CAN_FL_DET_RANGE_RATE_127 : 259|14@0+ (0.015625,-128) [-128|127.984375] "m/s"  IFV
 SG_ CAN_FL_DET_SD_RANGE_RATE_127 : 277|6@0+ (0.02,0) [0|1.2] "m/s"  IFV
 SG_ CAN_FL_DET_AZIMUTH_127 : 287|13@0+ (0.0007668,-3.141593) [-3.141593|3.141593] "rad"  IFV
 SG_ CAN_FL_DET_SD_AZIMUTH_127 : 290|6@0+ (0.001745329,0) [0|0.104719755] "rad"  IFV
 SG_ CAN_FL_DET_ELEVATION_127 : 300|7@0+ (0.157449,-9.99812) [-9.99812|9.997903] "deg"  IFV
 SG_ CAN_FL_DET_SD_ELEVATION_127 : 309|6@0+ (0.003490659,0) [0|0.20943951] "rad"  IFV
 SG_ CAN_FL_DET_AMPLITUDE_127 : 319|7@0+ (1,-64) [-64|63] "dBsm"  IFV
 SG_ CAN_FL_DET_VALID_FLAG_127 : 312|1@0+ (1,0) [0|1] ""  IFV
 SG_ CAN_FL_DET_SUPER_RES_127 : 320|1@0+ (1,0) [0|1] ""  IFV
 SG_ CAN_FL_DET_LOW_SNR_FLAG_127 : 321|1@0+ (1,0) [0|1] ""  IFV
 SG_ CAN_FL_DET_MIXER_BIAS_FLAG_127 : 322|1@0+ (1,0) [0|1] ""  IFV
 SG_ CAN_FL_DET_RESERVED_FLAGS_127 : 327|5@0+ (1,0) [0|31] ""  IFV
 SG_ CAN_FL_DET_SNR_127 : 335|8@0+ (0.35156,0) [0|89.6478] "dB"  IFV
 SG_ CAN_FL_DET_MULTI_TARGET_PROB_127 : 339|4@0+ (0.06667,0) [0|1] ""  IFV
 SG_ CAN_FL_DET_CONFID_AZIMUTH_127 : 341|2@0+ (1,0) [0|3] ""  IFV
 SG_ CAN_FL_DET_CONFID_ELEVATION_127 : 343|2@0+ (1,0) [0|3] ""  IFV
 SG_ CAN_FL_DET_EXISTENCE_PROB_127 : 347|4@0+ (1,0) [0|15] ""  IFV
 SG_ CAN_FL_DET_CLASS_127 : 351|4@0+ (1,0) [0|15] ""  IFV
 SG_ CAN_FL_DET_RANGE_128 : 367|14@0+ (0.015625,0) [0|255.984375] "m"  IFV
 SG_ CAN_FL_DET_SD_RANGE_128 : 369|6@0+ (0.025,0) [0|1.5] "m"  IFV
 SG_ CAN_FL_DET_RANGE_RATE_128 : 379|14@0+ (0.015625,-128) [-128|127.984375] "m/s"  IFV
 SG_ CAN_FL_DET_SD_RANGE_RATE_128 : 397|6@0+ (0.02,0) [0|1.2] "m/s"  IFV
 SG_ CAN_FL_DET_AZIMUTH_128 : 407|13@0+ (0.0007668,-3.141593) [-3.141593|3.141593] "rad"  IFV
 SG_ CAN_FL_DET_SD_AZIMUTH_128 : 410|6@0+ (0.001745329,0) [0|0.104719755] "rad"  IFV
 SG_ CAN_FL_DET_ELEVATION_128 : 420|7@0+ (0.157449,-9.99812) [-9.99812|9.997903] "deg"  IFV
 SG_ CAN_FL_DET_SD_ELEVATION_128 : 429|6@0+ (0.003490659,0) [0|0.20943951] "rad"  IFV
 SG_ CAN_FL_DET_AMPLITUDE_128 : 439|7@0+ (1,-64) [-64|63] "dBsm"  IFV
 SG_ CAN_FL_DET_VALID_FLAG_128 : 432|1@0+ (1,0) [0|1] ""  IFV
 SG_ CAN_FL_DET_SUPER_RES_128 : 440|1@0+ (1,0) [0|1] ""  IFV
 SG_ CAN_FL_DET_LOW_SNR_FLAG_128 : 441|1@0+ (1,0) [0|1] ""  IFV
 SG_ CAN_FL_DET_MIXER_BIAS_FLAG_128 : 442|1@0+ (1,0) [0|1] ""  IFV
 SG_ CAN_FL_DET_RESERVED_FLAGS_128 : 447|5@0+ (1,0) [0|31] ""  IFV
 SG_ CAN_FL_DET_SNR_128 : 455|8@0+ (0.35156,0) [0|89.6478] "dB"  IFV
 SG_ CAN_FL_DET_MULTI_TARGET_PROB_128 : 459|4@0+ (0.06667,0) [0|1] ""  IFV
 SG_ CAN_FL_DET_CONFID_AZIMUTH_128 : 461|2@0+ (1,0) [0|3] ""  IFV
 SG_ CAN_FL_DET_CONFID_ELEVATION_128 : 463|2@0+ (1,0) [0|3] ""  IFV
 SG_ CAN_FL_DET_EXISTENCE_PROB_128 : 467|4@0+ (1,0) [0|15] ""  IFV
 SG_ CAN_FL_DET_CLASS_128 : 471|4@0+ (1,0) [0|15] ""  IFV

BO_ 800 SODFL_DETECTION_129_132: 64 SODFL
 SG_ CAN_FL_DET_RANGE_129 : 7|14@0+ (0.015625,0) [0|255.984375] "m"  IFV
 SG_ CAN_FL_DET_SD_RANGE_129 : 9|6@0+ (0.025,0) [0|1.5] "m"  IFV
 SG_ CAN_FL_DET_RANGE_RATE_129 : 19|14@0+ (0.015625,-128) [-128|127.984375] "m/s"  IFV
 SG_ CAN_FL_DET_SD_RANGE_RATE_129 : 37|6@0+ (0.02,0) [0|1.2] "m/s"  IFV
 SG_ CAN_FL_DET_AZIMUTH_129 : 47|13@0+ (0.0007668,-3.141593) [-3.141593|3.141593] "rad"  IFV
 SG_ CAN_FL_DET_SD_AZIMUTH_129 : 50|6@0+ (0.001745329,0) [0|0.104719755] "rad"  IFV
 SG_ CAN_FL_DET_ELEVATION_129 : 60|7@0+ (0.157449,-9.99812) [-9.99812|9.997903] "deg"  IFV
 SG_ CAN_FL_DET_SD_ELEVATION_129 : 69|6@0+ (0.003490659,0) [0|0.20943951] "rad"  IFV
 SG_ CAN_FL_DET_AMPLITUDE_129 : 79|7@0+ (1,-64) [-64|63] "dBsm"  IFV
 SG_ CAN_FL_DET_VALID_FLAG_129 : 72|1@0+ (1,0) [0|1] ""  IFV
 SG_ CAN_FL_DET_SUPER_RES_129 : 80|1@0+ (1,0) [0|1] ""  IFV
 SG_ CAN_FL_DET_LOW_SNR_FLAG_129 : 81|1@0+ (1,0) [0|1] ""  IFV
 SG_ CAN_FL_DET_MIXER_BIAS_FLAG_129 : 82|1@0+ (1,0) [0|1] ""  IFV
 SG_ CAN_FL_DET_RESERVED_FLAGS_129 : 87|5@0+ (1,0) [0|31] ""  IFV
 SG_ CAN_FL_DET_SNR_129 : 95|8@0+ (0.35156,0) [0|89.6478] "dB"  IFV
 SG_ CAN_FL_DET_MULTI_TARGET_PROB_129 : 99|4@0+ (0.06667,0) [0|1] ""  IFV
 SG_ CAN_FL_DET_CONFID_AZIMUTH_129 : 101|2@0+ (1,0) [0|3] ""  IFV
 SG_ CAN_FL_DET_CONFID_ELEVATION_129 : 103|2@0+ (1,0) [0|3] ""  IFV
 SG_ CAN_FL_DET_EXISTENCE_PROB_129 : 107|4@0+ (1,0) [0|15] ""  IFV
 SG_ CAN_FL_DET_CLASS_129 : 111|4@0+ (1,0) [0|15] ""  IFV
 SG_ CAN_FL_DET_RANGE_130 : 127|14@0+ (0.015625,0) [0|255.984375] "m"  IFV
 SG_ CAN_FL_DET_SD_RANGE_130 : 129|6@0+ (0.025,0) [0|1.5] "m"  IFV
 SG_ CAN_FL_DET_RANGE_RATE_130 : 139|14@0+ (0.015625,-128) [-128|127.984375] "m/s"  IFV
 SG_ CAN_FL_DET_SD_RANGE_RATE_130 : 157|6@0+ (0.02,0) [0|1.2] "m/s"  IFV
 SG_ CAN_FL_DET_AZIMUTH_130 : 167|13@0+ (0.0007668,-3.141593) [-3.141593|3.141593] "rad"  IFV
 SG_ CAN_FL_DET_SD_AZIMUTH_130 : 170|6@0+ (0.001745329,0) [0|0.104719755] "rad"  IFV
 SG_ CAN_FL_DET_ELEVATION_130 : 180|7@0+ (0.157449,-9.99812) [-9.99812|9.997903] "deg"  IFV
 SG_ CAN_FL_DET_SD_ELEVATION_130 : 189|6@0+ (0.003490659,0) [0|0.20943951] "rad"  IFV
 SG_ CAN_FL_DET_AMPLITUDE_130 : 199|7@0+ (1,-64) [-64|63] "dBsm"  IFV
 SG_ CAN_FL_DET_VALID_FLAG_130 : 192|1@0+ (1,0) [0|1] ""  IFV
 SG_ CAN_FL_DET_SUPER_RES_130 : 200|1@0+ (1,0) [0|1] ""  IFV
 SG_ CAN_FL_DET_LOW_SNR_FLAG_130 : 201|1@0+ (1,0) [0|1] ""  IFV
 SG_ CAN_FL_DET_MIXER_BIAS_FLAG_130 : 202|1@0+ (1,0) [0|1] ""  IFV
 SG_ CAN_FL_DET_RESERVED_FLAGS_130 : 207|5@0+ (1,0) [0|31] ""  IFV
 SG_ CAN_FL_DET_SNR_130 : 215|8@0+ (0.35156,0) [0|89.6478] "dB"  IFV
 SG_ CAN_FL_DET_MULTI_TARGET_PROB_130 : 219|4@0+ (0.06667,0) [0|1] ""  IFV
 SG_ CAN_FL_DET_CONFID_AZIMUTH_130 : 221|2@0+ (1,0) [0|3] ""  IFV
 SG_ CAN_FL_DET_CONFID_ELEVATION_130 : 223|2@0+ (1,0) [0|3] ""  IFV
 SG_ CAN_FL_DET_EXISTENCE_PROB_130 : 227|4@0+ (1,0) [0|15] ""  IFV
 SG_ CAN_FL_DET_CLASS_130 : 231|4@0+ (1,0) [0|15] ""  IFV
 SG_ CAN_FL_DET_RANGE_131 : 247|14@0+ (0.015625,0) [0|255.984375] "m"  IFV
 SG_ CAN_FL_DET_SD_RANGE_131 : 249|6@0+ (0.025,0) [0|1.5] "m"  IFV
 SG_ CAN_FL_DET_RANGE_RATE_131 : 259|14@0+ (0.015625,-128) [-128|127.984375] "m/s"  IFV
 SG_ CAN_FL_DET_SD_RANGE_RATE_131 : 277|6@0+ (0.02,0) [0|1.2] "m/s"  IFV
 SG_ CAN_FL_DET_AZIMUTH_131 : 287|13@0+ (0.0007668,-3.141593) [-3.141593|3.141593] "rad"  IFV
 SG_ CAN_FL_DET_SD_AZIMUTH_131 : 290|6@0+ (0.001745329,0) [0|0.104719755] "rad"  IFV
 SG_ CAN_FL_DET_ELEVATION_131 : 300|7@0+ (0.157449,-9.99812) [-9.99812|9.997903] "deg"  IFV
 SG_ CAN_FL_DET_SD_ELEVATION_131 : 309|6@0+ (0.003490659,0) [0|0.20943951] "rad"  IFV
 SG_ CAN_FL_DET_AMPLITUDE_131 : 319|7@0+ (1,-64) [-64|63] "dBsm"  IFV
 SG_ CAN_FL_DET_VALID_FLAG_131 : 312|1@0+ (1,0) [0|1] ""  IFV
 SG_ CAN_FL_DET_SUPER_RES_131 : 320|1@0+ (1,0) [0|1] ""  IFV
 SG_ CAN_FL_DET_LOW_SNR_FLAG_131 : 321|1@0+ (1,0) [0|1] ""  IFV
 SG_ CAN_FL_DET_MIXER_BIAS_FLAG_131 : 322|1@0+ (1,0) [0|1] ""  IFV
 SG_ CAN_FL_DET_RESERVED_FLAGS_131 : 327|5@0+ (1,0) [0|31] ""  IFV
 SG_ CAN_FL_DET_SNR_131 : 335|8@0+ (0.35156,0) [0|89.6478] "dB"  IFV
 SG_ CAN_FL_DET_MULTI_TARGET_PROB_131 : 339|4@0+ (0.06667,0) [0|1] ""  IFV
 SG_ CAN_FL_DET_CONFID_AZIMUTH_131 : 341|2@0+ (1,0) [0|3] ""  IFV
 SG_ CAN_FL_DET_CONFID_ELEVATION_131 : 343|2@0+ (1,0) [0|3] ""  IFV
 SG_ CAN_FL_DET_EXISTENCE_PROB_131 : 347|4@0+ (1,0) [0|15] ""  IFV
 SG_ CAN_FL_DET_CLASS_131 : 351|4@0+ (1,0) [0|15] ""  IFV
 SG_ CAN_FL_DET_RANGE_132 : 367|14@0+ (0.015625,0) [0|255.984375] "m"  IFV
 SG_ CAN_FL_DET_SD_RANGE_132 : 369|6@0+ (0.025,0) [0|1.5] "m"  IFV
 SG_ CAN_FL_DET_RANGE_RATE_132 : 379|14@0+ (0.015625,-128) [-128|127.984375] "m/s"  IFV
 SG_ CAN_FL_DET_SD_RANGE_RATE_132 : 397|6@0+ (0.02,0) [0|1.2] "m/s"  IFV
 SG_ CAN_FL_DET_AZIMUTH_132 : 407|13@0+ (0.0007668,-3.141593) [-3.141593|3.141593] "rad"  IFV
 SG_ CAN_FL_DET_SD_AZIMUTH_132 : 410|6@0+ (0.001745329,0) [0|0.104719755] "rad"  IFV
 SG_ CAN_FL_DET_ELEVATION_132 : 420|7@0+ (0.157449,-9.99812) [-9.99812|9.997903] "deg"  IFV
 SG_ CAN_FL_DET_SD_ELEVATION_132 : 429|6@0+ (0.003490659,0) [0|0.20943951] "rad"  IFV
 SG_ CAN_FL_DET_AMPLITUDE_132 : 439|7@0+ (1,-64) [-64|63] "dBsm"  IFV
 SG_ CAN_FL_DET_VALID_FLAG_132 : 432|1@0+ (1,0) [0|1] ""  IFV
 SG_ CAN_FL_DET_SUPER_RES_132 : 440|1@0+ (1,0) [0|1] ""  IFV
 SG_ CAN_FL_DET_LOW_SNR_FLAG_132 : 441|1@0+ (1,0) [0|1] ""  IFV
 SG_ CAN_FL_DET_MIXER_BIAS_FLAG_132 : 442|1@0+ (1,0) [0|1] ""  IFV
 SG_ CAN_FL_DET_RESERVED_FLAGS_132 : 447|5@0+ (1,0) [0|31] ""  IFV
 SG_ CAN_FL_DET_SNR_132 : 455|8@0+ (0.35156,0) [0|89.6478] "dB"  IFV
 SG_ CAN_FL_DET_MULTI_TARGET_PROB_132 : 459|4@0+ (0.06667,0) [0|1] ""  IFV
 SG_ CAN_FL_DET_CONFID_AZIMUTH_132 : 461|2@0+ (1,0) [0|3] ""  IFV
 SG_ CAN_FL_DET_CONFID_ELEVATION_132 : 463|2@0+ (1,0) [0|3] ""  IFV
 SG_ CAN_FL_DET_EXISTENCE_PROB_132 : 467|4@0+ (1,0) [0|15] ""  IFV
 SG_ CAN_FL_DET_CLASS_132 : 471|4@0+ (1,0) [0|15] ""  IFV

BO_ 801 SODFL_DETECTION_133_136: 64 SODFL
 SG_ CAN_FL_DET_RANGE_133 : 7|14@0+ (0.015625,0) [0|255.984375] "m"  IFV
 SG_ CAN_FL_DET_SD_RANGE_133 : 9|6@0+ (0.025,0) [0|1.5] "m"  IFV
 SG_ CAN_FL_DET_RANGE_RATE_133 : 19|14@0+ (0.015625,-128) [-128|127.984375] "m/s"  IFV
 SG_ CAN_FL_DET_SD_RANGE_RATE_133 : 37|6@0+ (0.02,0) [0|1.2] "m/s"  IFV
 SG_ CAN_FL_DET_AZIMUTH_133 : 47|13@0+ (0.0007668,-3.141593) [-3.141593|3.141593] "rad"  IFV
 SG_ CAN_FL_DET_SD_AZIMUTH_133 : 50|6@0+ (0.001745329,0) [0|0.104719755] "rad"  IFV
 SG_ CAN_FL_DET_ELEVATION_133 : 60|7@0+ (0.157449,-9.99812) [-9.99812|9.997903] "deg"  IFV
 SG_ CAN_FL_DET_SD_ELEVATION_133 : 69|6@0+ (0.003490659,0) [0|0.20943951] "rad"  IFV
 SG_ CAN_FL_DET_AMPLITUDE_133 : 79|7@0+ (1,-64) [-64|63] "dBsm"  IFV
 SG_ CAN_FL_DET_VALID_FLAG_133 : 72|1@0+ (1,0) [0|1] ""  IFV
 SG_ CAN_FL_DET_SUPER_RES_133 : 80|1@0+ (1,0) [0|1] ""  IFV
 SG_ CAN_FL_DET_LOW_SNR_FLAG_133 : 81|1@0+ (1,0) [0|1] ""  IFV
 SG_ CAN_FL_DET_MIXER_BIAS_FLAG_133 : 82|1@0+ (1,0) [0|1] ""  IFV
 SG_ CAN_FL_DET_RESERVED_FLAGS_133 : 87|5@0+ (1,0) [0|31] ""  IFV
 SG_ CAN_FL_DET_SNR_133 : 95|8@0+ (0.35156,0) [0|89.6478] "dB"  IFV
 SG_ CAN_FL_DET_MULTI_TARGET_PROB_133 : 99|4@0+ (0.06667,0) [0|1] ""  IFV
 SG_ CAN_FL_DET_CONFID_AZIMUTH_133 : 101|2@0+ (1,0) [0|3] ""  IFV
 SG_ CAN_FL_DET_CONFID_ELEVATION_133 : 103|2@0+ (1,0) [0|3] ""  IFV
 SG_ CAN_FL_DET_EXISTENCE_PROB_133 : 107|4@0+ (1,0) [0|15] ""  IFV
 SG_ CAN_FL_DET_CLASS_133 : 111|4@0+ (1,0) [0|15] ""  IFV
 SG_ CAN_FL_DET_RANGE_134 : 127|14@0+ (0.015625,0) [0|255.984375] "m"  IFV
 SG_ CAN_FL_DET_SD_RANGE_134 : 129|6@0+ (0.025,0) [0|1.5] "m"  IFV
 SG_ CAN_FL_DET_RANGE_RATE_134 : 139|14@0+ (0.015625,-128) [-128|127.984375] "m/s"  IFV
 SG_ CAN_FL_DET_SD_RANGE_RATE_134 : 157|6@0+ (0.02,0) [0|1.2] "m/s"  IFV
 SG_ CAN_FL_DET_AZIMUTH_134 : 167|13@0+ (0.0007668,-3.141593) [-3.141593|3.141593] "rad"  IFV
 SG_ CAN_FL_DET_SD_AZIMUTH_134 : 170|6@0+ (0.001745329,0) [0|0.104719755] "rad"  IFV
 SG_ CAN_FL_DET_ELEVATION_134 : 180|7@0+ (0.157449,-9.99812) [-9.99812|9.997903] "deg"  IFV
 SG_ CAN_FL_DET_SD_ELEVATION_134 : 189|6@0+ (0.003490659,0) [0|0.20943951] "rad"  IFV
 SG_ CAN_FL_DET_AMPLITUDE_134 : 199|7@0+ (1,-64) [-64|63] "dBsm"  IFV
 SG_ CAN_FL_DET_VALID_FLAG_134 : 192|1@0+ (1,0) [0|1] ""  IFV
 SG_ CAN_FL_DET_SUPER_RES_134 : 200|1@0+ (1,0) [0|1] ""  IFV
 SG_ CAN_FL_DET_LOW_SNR_FLAG_134 : 201|1@0+ (1,0) [0|1] ""  IFV
 SG_ CAN_FL_DET_MIXER_BIAS_FLAG_134 : 202|1@0+ (1,0) [0|1] ""  IFV
 SG_ CAN_FL_DET_RESERVED_FLAGS_134 : 207|5@0+ (1,0) [0|31] ""  IFV
 SG_ CAN_FL_DET_SNR_134 : 215|8@0+ (0.35156,0) [0|89.6478] "dB"  IFV
 SG_ CAN_FL_DET_MULTI_TARGET_PROB_134 : 219|4@0+ (0.06667,0) [0|1] ""  IFV
 SG_ CAN_FL_DET_CONFID_AZIMUTH_134 : 221|2@0+ (1,0) [0|3] ""  IFV
 SG_ CAN_FL_DET_CONFID_ELEVATION_134 : 223|2@0+ (1,0) [0|3] ""  IFV
 SG_ CAN_FL_DET_EXISTENCE_PROB_134 : 227|4@0+ (1,0) [0|15] ""  IFV
 SG_ CAN_FL_DET_CLASS_134 : 231|4@0+ (1,0) [0|15] ""  IFV
 SG_ CAN_FL_DET_RANGE_135 : 247|14@0+ (0.015625,0) [0|255.984375] "m"  IFV
 SG_ CAN_FL_DET_SD_RANGE_135 : 249|6@0+ (0.025,0) [0|1.5] "m"  IFV
 SG_ CAN_FL_DET_RANGE_RATE_135 : 259|14@0+ (0.015625,-128) [-128|127.984375] "m/s"  IFV
 SG_ CAN_FL_DET_SD_RANGE_RATE_135 : 277|6@0+ (0.02,0) [0|1.2] "m/s"  IFV
 SG_ CAN_FL_DET_AZIMUTH_135 : 287|13@0+ (0.0007668,-3.141593) [-3.141593|3.141593] "rad"  IFV
 SG_ CAN_FL_DET_SD_AZIMUTH_135 : 290|6@0+ (0.001745329,0) [0|0.104719755] "rad"  IFV
 SG_ CAN_FL_DET_ELEVATION_135 : 300|7@0+ (0.157449,-9.99812) [-9.99812|9.997903] "deg"  IFV
 SG_ CAN_FL_DET_SD_ELEVATION_135 : 309|6@0+ (0.003490659,0) [0|0.20943951] "rad"  IFV
 SG_ CAN_FL_DET_AMPLITUDE_135 : 319|7@0+ (1,-64) [-64|63] "dBsm"  IFV
 SG_ CAN_FL_DET_VALID_FLAG_135 : 312|1@0+ (1,0) [0|1] ""  IFV
 SG_ CAN_FL_DET_SUPER_RES_135 : 320|1@0+ (1,0) [0|1] ""  IFV
 SG_ CAN_FL_DET_LOW_SNR_FLAG_135 : 321|1@0+ (1,0) [0|1] ""  IFV
 SG_ CAN_FL_DET_MIXER_BIAS_FLAG_135 : 322|1@0+ (1,0) [0|1] ""  IFV
 SG_ CAN_FL_DET_RESERVED_FLAGS_135 : 327|5@0+ (1,0) [0|31] ""  IFV
 SG_ CAN_FL_DET_SNR_135 : 335|8@0+ (0.35156,0) [0|89.6478] "dB"  IFV
 SG_ CAN_FL_DET_MULTI_TARGET_PROB_135 : 339|4@0+ (0.06667,0) [0|1] ""  IFV
 SG_ CAN_FL_DET_CONFID_AZIMUTH_135 : 341|2@0+ (1,0) [0|3] ""  IFV
 SG_ CAN_FL_DET_CONFID_ELEVATION_135 : 343|2@0+ (1,0) [0|3] ""  IFV
 SG_ CAN_FL_DET_EXISTENCE_PROB_135 : 347|4@0+ (1,0) [0|15] ""  IFV
 SG_ CAN_FL_DET_CLASS_135 : 351|4@0+ (1,0) [0|15] ""  IFV
 SG_ CAN_FL_DET_RANGE_136 : 367|14@0+ (0.015625,0) [0|255.984375] "m"  IFV
 SG_ CAN_FL_DET_SD_RANGE_136 : 369|6@0+ (0.025,0) [0|1.5] "m"  IFV
 SG_ CAN_FL_DET_RANGE_RATE_136 : 379|14@0+ (0.015625,-128) [-128|127.984375] "m/s"  IFV
 SG_ CAN_FL_DET_SD_RANGE_RATE_136 : 397|6@0+ (0.02,0) [0|1.2] "m/s"  IFV
 SG_ CAN_FL_DET_AZIMUTH_136 : 407|13@0+ (0.0007668,-3.141593) [-3.141593|3.141593] "rad"  IFV
 SG_ CAN_FL_DET_SD_AZIMUTH_136 : 410|6@0+ (0.001745329,0) [0|0.104719755] "rad"  IFV
 SG_ CAN_FL_DET_ELEVATION_136 : 420|7@0+ (0.157449,-9.99812) [-9.99812|9.997903] "deg"  IFV
 SG_ CAN_FL_DET_SD_ELEVATION_136 : 429|6@0+ (0.003490659,0) [0|0.20943951] "rad"  IFV
 SG_ CAN_FL_DET_AMPLITUDE_136 : 439|7@0+ (1,-64) [-64|63] "dBsm"  IFV
 SG_ CAN_FL_DET_VALID_FLAG_136 : 432|1@0+ (1,0) [0|1] ""  IFV
 SG_ CAN_FL_DET_SUPER_RES_136 : 440|1@0+ (1,0) [0|1] ""  IFV
 SG_ CAN_FL_DET_LOW_SNR_FLAG_136 : 441|1@0+ (1,0) [0|1] ""  IFV
 SG_ CAN_FL_DET_MIXER_BIAS_FLAG_136 : 442|1@0+ (1,0) [0|1] ""  IFV
 SG_ CAN_FL_DET_RESERVED_FLAGS_136 : 447|5@0+ (1,0) [0|31] ""  IFV
 SG_ CAN_FL_DET_SNR_136 : 455|8@0+ (0.35156,0) [0|89.6478] "dB"  IFV
 SG_ CAN_FL_DET_MULTI_TARGET_PROB_136 : 459|4@0+ (0.06667,0) [0|1] ""  IFV
 SG_ CAN_FL_DET_CONFID_AZIMUTH_136 : 461|2@0+ (1,0) [0|3] ""  IFV
 SG_ CAN_FL_DET_CONFID_ELEVATION_136 : 463|2@0+ (1,0) [0|3] ""  IFV
 SG_ CAN_FL_DET_EXISTENCE_PROB_136 : 467|4@0+ (1,0) [0|15] ""  IFV
 SG_ CAN_FL_DET_CLASS_136 : 471|4@0+ (1,0) [0|15] ""  IFV

BO_ 802 SODFL_DETECTION_137_140: 64 SODFL
 SG_ CAN_FL_DET_RANGE_137 : 7|14@0+ (0.015625,0) [0|255.984375] "m"  IFV
 SG_ CAN_FL_DET_SD_RANGE_137 : 9|6@0+ (0.025,0) [0|1.5] "m"  IFV
 SG_ CAN_FL_DET_RANGE_RATE_137 : 19|14@0+ (0.015625,-128) [-128|127.984375] "m/s"  IFV
 SG_ CAN_FL_DET_SD_RANGE_RATE_137 : 37|6@0+ (0.02,0) [0|1.2] "m/s"  IFV
 SG_ CAN_FL_DET_AZIMUTH_137 : 47|13@0+ (0.0007668,-3.141593) [-3.141593|3.141593] "rad"  IFV
 SG_ CAN_FL_DET_SD_AZIMUTH_137 : 50|6@0+ (0.001745329,0) [0|0.104719755] "rad"  IFV
 SG_ CAN_FL_DET_ELEVATION_137 : 60|7@0+ (0.157449,-9.99812) [-9.99812|9.997903] "deg"  IFV
 SG_ CAN_FL_DET_SD_ELEVATION_137 : 69|6@0+ (0.003490659,0) [0|0.20943951] "rad"  IFV
 SG_ CAN_FL_DET_AMPLITUDE_137 : 79|7@0+ (1,-64) [-64|63] "dBsm"  IFV
 SG_ CAN_FL_DET_VALID_FLAG_137 : 72|1@0+ (1,0) [0|1] ""  IFV
 SG_ CAN_FL_DET_SUPER_RES_137 : 80|1@0+ (1,0) [0|1] ""  IFV
 SG_ CAN_FL_DET_LOW_SNR_FLAG_137 : 81|1@0+ (1,0) [0|1] ""  IFV
 SG_ CAN_FL_DET_MIXER_BIAS_FLAG_137 : 82|1@0+ (1,0) [0|1] ""  IFV
 SG_ CAN_FL_DET_RESERVED_FLAGS_137 : 87|5@0+ (1,0) [0|31] ""  IFV
 SG_ CAN_FL_DET_SNR_137 : 95|8@0+ (0.35156,0) [0|89.6478] "dB"  IFV
 SG_ CAN_FL_DET_MULTI_TARGET_PROB_137 : 99|4@0+ (0.06667,0) [0|1] ""  IFV
 SG_ CAN_FL_DET_CONFID_AZIMUTH_137 : 101|2@0+ (1,0) [0|3] ""  IFV
 SG_ CAN_FL_DET_CONFID_ELEVATION_137 : 103|2@0+ (1,0) [0|3] ""  IFV
 SG_ CAN_FL_DET_EXISTENCE_PROB_137 : 107|4@0+ (1,0) [0|15] ""  IFV
 SG_ CAN_FL_DET_CLASS_137 : 111|4@0+ (1,0) [0|15] ""  IFV
 SG_ CAN_FL_DET_RANGE_138 : 127|14@0+ (0.015625,0) [0|255.984375] "m"  IFV
 SG_ CAN_FL_DET_SD_RANGE_138 : 129|6@0+ (0.025,0) [0|1.5] "m"  IFV
 SG_ CAN_FL_DET_RANGE_RATE_138 : 139|14@0+ (0.015625,-128) [-128|127.984375] "m/s"  IFV
 SG_ CAN_FL_DET_SD_RANGE_RATE_138 : 157|6@0+ (0.02,0) [0|1.2] "m/s"  IFV
 SG_ CAN_FL_DET_AZIMUTH_138 : 167|13@0+ (0.0007668,-3.141593) [-3.141593|3.141593] "rad"  IFV
 SG_ CAN_FL_DET_SD_AZIMUTH_138 : 170|6@0+ (0.001745329,0) [0|0.104719755] "rad"  IFV
 SG_ CAN_FL_DET_ELEVATION_138 : 180|7@0+ (0.157449,-9.99812) [-9.99812|9.997903] "deg"  IFV
 SG_ CAN_FL_DET_SD_ELEVATION_138 : 189|6@0+ (0.003490659,0) [0|0.20943951] "rad"  IFV
 SG_ CAN_FL_DET_AMPLITUDE_138 : 199|7@0+ (1,-64) [-64|63] "dBsm"  IFV
 SG_ CAN_FL_DET_VALID_FLAG_138 : 192|1@0+ (1,0) [0|1] ""  IFV
 SG_ CAN_FL_DET_SUPER_RES_138 : 200|1@0+ (1,0) [0|1] ""  IFV
 SG_ CAN_FL_DET_LOW_SNR_FLAG_138 : 201|1@0+ (1,0) [0|1] ""  IFV
 SG_ CAN_FL_DET_MIXER_BIAS_FLAG_138 : 202|1@0+ (1,0) [0|1] ""  IFV
 SG_ CAN_FL_DET_RESERVED_FLAGS_138 : 207|5@0+ (1,0) [0|31] ""  IFV
 SG_ CAN_FL_DET_SNR_138 : 215|8@0+ (0.35156,0) [0|89.6478] "dB"  IFV
 SG_ CAN_FL_DET_MULTI_TARGET_PROB_138 : 219|4@0+ (0.06667,0) [0|1] ""  IFV
 SG_ CAN_FL_DET_CONFID_AZIMUTH_138 : 221|2@0+ (1,0) [0|3] ""  IFV
 SG_ CAN_FL_DET_CONFID_ELEVATION_138 : 223|2@0+ (1,0) [0|3] ""  IFV
 SG_ CAN_FL_DET_EXISTENCE_PROB_138 : 227|4@0+ (1,0) [0|15] ""  IFV
 SG_ CAN_FL_DET_CLASS_138 : 231|4@0+ (1,0) [0|15] ""  IFV
 SG_ CAN_FL_DET_RANGE_139 : 247|14@0+ (0.015625,0) [0|255.984375] "m"  IFV
 SG_ CAN_FL_DET_SD_RANGE_139 : 249|6@0+ (0.025,0) [0|1.5] "m"  IFV
 SG_ CAN_FL_DET_RANGE_RATE_139 : 259|14@0+ (0.015625,-128) [-128|127.984375] "m/s"  IFV
 SG_ CAN_FL_DET_SD_RANGE_RATE_139 : 277|6@0+ (0.02,0) [0|1.2] "m/s"  IFV
 SG_ CAN_FL_DET_AZIMUTH_139 : 287|13@0+ (0.0007668,-3.141593) [-3.141593|3.141593] "rad"  IFV
 SG_ CAN_FL_DET_SD_AZIMUTH_139 : 290|6@0+ (0.001745329,0) [0|0.104719755] "rad"  IFV
 SG_ CAN_FL_DET_ELEVATION_139 : 300|7@0+ (0.157449,-9.99812) [-9.99812|9.997903] "deg"  IFV
 SG_ CAN_FL_DET_SD_ELEVATION_139 : 309|6@0+ (0.003490659,0) [0|0.20943951] "rad"  IFV
 SG_ CAN_FL_DET_AMPLITUDE_139 : 319|7@0+ (1,-64) [-64|63] "dBsm"  IFV
 SG_ CAN_FL_DET_VALID_FLAG_139 : 312|1@0+ (1,0) [0|1] ""  IFV
 SG_ CAN_FL_DET_SUPER_RES_139 : 320|1@0+ (1,0) [0|1] ""  IFV
 SG_ CAN_FL_DET_LOW_SNR_FLAG_139 : 321|1@0+ (1,0) [0|1] ""  IFV
 SG_ CAN_FL_DET_MIXER_BIAS_FLAG_139 : 322|1@0+ (1,0) [0|1] ""  IFV
 SG_ CAN_FL_DET_RESERVED_FLAGS_139 : 327|5@0+ (1,0) [0|31] ""  IFV
 SG_ CAN_FL_DET_SNR_139 : 335|8@0+ (0.35156,0) [0|89.6478] "dB"  IFV
 SG_ CAN_FL_DET_MULTI_TARGET_PROB_139 : 339|4@0+ (0.06667,0) [0|1] ""  IFV
 SG_ CAN_FL_DET_CONFID_AZIMUTH_139 : 341|2@0+ (1,0) [0|3] ""  IFV
 SG_ CAN_FL_DET_CONFID_ELEVATION_139 : 343|2@0+ (1,0) [0|3] ""  IFV
 SG_ CAN_FL_DET_EXISTENCE_PROB_139 : 347|4@0+ (1,0) [0|15] ""  IFV
 SG_ CAN_FL_DET_CLASS_139 : 351|4@0+ (1,0) [0|15] ""  IFV
 SG_ CAN_FL_DET_RANGE_140 : 367|14@0+ (0.015625,0) [0|255.984375] "m"  IFV
 SG_ CAN_FL_DET_SD_RANGE_140 : 369|6@0+ (0.025,0) [0|1.5] "m"  IFV
 SG_ CAN_FL_DET_RANGE_RATE_140 : 379|14@0+ (0.015625,-128) [-128|127.984375] "m/s"  IFV
 SG_ CAN_FL_DET_SD_RANGE_RATE_140 : 397|6@0+ (0.02,0) [0|1.2] "m/s"  IFV
 SG_ CAN_FL_DET_AZIMUTH_140 : 407|13@0+ (0.0007668,-3.141593) [-3.141593|3.141593] "rad"  IFV
 SG_ CAN_FL_DET_SD_AZIMUTH_140 : 410|6@0+ (0.001745329,0) [0|0.104719755] "rad"  IFV
 SG_ CAN_FL_DET_ELEVATION_140 : 420|7@0+ (0.157449,-9.99812) [-9.99812|9.997903] "deg"  IFV
 SG_ CAN_FL_DET_SD_ELEVATION_140 : 429|6@0+ (0.003490659,0) [0|0.20943951] "rad"  IFV
 SG_ CAN_FL_DET_AMPLITUDE_140 : 439|7@0+ (1,-64) [-64|63] "dBsm"  IFV
 SG_ CAN_FL_DET_VALID_FLAG_140 : 432|1@0+ (1,0) [0|1] ""  IFV
 SG_ CAN_FL_DET_SUPER_RES_140 : 440|1@0+ (1,0) [0|1] ""  IFV
 SG_ CAN_FL_DET_LOW_SNR_FLAG_140 : 441|1@0+ (1,0) [0|1] ""  IFV
 SG_ CAN_FL_DET_MIXER_BIAS_FLAG_140 : 442|1@0+ (1,0) [0|1] ""  IFV
 SG_ CAN_FL_DET_RESERVED_FLAGS_140 : 447|5@0+ (1,0) [0|31] ""  IFV
 SG_ CAN_FL_DET_SNR_140 : 455|8@0+ (0.35156,0) [0|89.6478] "dB"  IFV
 SG_ CAN_FL_DET_MULTI_TARGET_PROB_140 : 459|4@0+ (0.06667,0) [0|1] ""  IFV
 SG_ CAN_FL_DET_CONFID_AZIMUTH_140 : 461|2@0+ (1,0) [0|3] ""  IFV
 SG_ CAN_FL_DET_CONFID_ELEVATION_140 : 463|2@0+ (1,0) [0|3] ""  IFV
 SG_ CAN_FL_DET_EXISTENCE_PROB_140 : 467|4@0+ (1,0) [0|15] ""  IFV
 SG_ CAN_FL_DET_CLASS_140 : 471|4@0+ (1,0) [0|15] ""  IFV

BO_ 803 SODFL_DETECTION_141_144: 64 SODFL
 SG_ CAN_FL_DET_RANGE_141 : 7|14@0+ (0.015625,0) [0|255.984375] "m"  IFV
 SG_ CAN_FL_DET_SD_RANGE_141 : 9|6@0+ (0.025,0) [0|1.5] "m"  IFV
 SG_ CAN_FL_DET_RANGE_RATE_141 : 19|14@0+ (0.015625,-128) [-128|127.984375] "m/s"  IFV
 SG_ CAN_FL_DET_SD_RANGE_RATE_141 : 37|6@0+ (0.02,0) [0|1.2] "m/s"  IFV
 SG_ CAN_FL_DET_AZIMUTH_141 : 47|13@0+ (0.0007668,-3.141593) [-3.141593|3.141593] "rad"  IFV
 SG_ CAN_FL_DET_SD_AZIMUTH_141 : 50|6@0+ (0.001745329,0) [0|0.104719755] "rad"  IFV
 SG_ CAN_FL_DET_ELEVATION_141 : 60|7@0+ (0.157449,-9.99812) [-9.99812|9.997903] "deg"  IFV
 SG_ CAN_FL_DET_SD_ELEVATION_141 : 69|6@0+ (0.003490659,0) [0|0.20943951] "rad"  IFV
 SG_ CAN_FL_DET_AMPLITUDE_141 : 79|7@0+ (1,-64) [-64|63] "dBsm"  IFV
 SG_ CAN_FL_DET_VALID_FLAG_141 : 72|1@0+ (1,0) [0|1] ""  IFV
 SG_ CAN_FL_DET_SUPER_RES_141 : 80|1@0+ (1,0) [0|1] ""  IFV
 SG_ CAN_FL_DET_LOW_SNR_FLAG_141 : 81|1@0+ (1,0) [0|1] ""  IFV
 SG_ CAN_FL_DET_MIXER_BIAS_FLAG_141 : 82|1@0+ (1,0) [0|1] ""  IFV
 SG_ CAN_FL_DET_RESERVED_FLAGS_141 : 87|5@0+ (1,0) [0|31] ""  IFV
 SG_ CAN_FL_DET_SNR_141 : 95|8@0+ (0.35156,0) [0|89.6478] "dB"  IFV
 SG_ CAN_FL_DET_MULTI_TARGET_PROB_141 : 99|4@0+ (0.06667,0) [0|1] ""  IFV
 SG_ CAN_FL_DET_CONFID_AZIMUTH_141 : 101|2@0+ (1,0) [0|3] ""  IFV
 SG_ CAN_FL_DET_CONFID_ELEVATION_141 : 103|2@0+ (1,0) [0|3] ""  IFV
 SG_ CAN_FL_DET_EXISTENCE_PROB_141 : 107|4@0+ (1,0) [0|15] ""  IFV
 SG_ CAN_FL_DET_CLASS_141 : 111|4@0+ (1,0) [0|15] ""  IFV
 SG_ CAN_FL_DET_RANGE_142 : 127|14@0+ (0.015625,0) [0|255.984375] "m"  IFV
 SG_ CAN_FL_DET_SD_RANGE_142 : 129|6@0+ (0.025,0) [0|1.5] "m"  IFV
 SG_ CAN_FL_DET_RANGE_RATE_142 : 139|14@0+ (0.015625,-128) [-128|127.984375] "m/s"  IFV
 SG_ CAN_FL_DET_SD_RANGE_RATE_142 : 157|6@0+ (0.02,0) [0|1.2] "m/s"  IFV
 SG_ CAN_FL_DET_AZIMUTH_142 : 167|13@0+ (0.0007668,-3.141593) [-3.141593|3.141593] "rad"  IFV
 SG_ CAN_FL_DET_SD_AZIMUTH_142 : 170|6@0+ (0.001745329,0) [0|0.104719755] "rad"  IFV
 SG_ CAN_FL_DET_ELEVATION_142 : 180|7@0+ (0.157449,-9.99812) [-9.99812|9.997903] "deg"  IFV
 SG_ CAN_FL_DET_SD_ELEVATION_142 : 189|6@0+ (0.003490659,0) [0|0.20943951] "rad"  IFV
 SG_ CAN_FL_DET_AMPLITUDE_142 : 199|7@0+ (1,-64) [-64|63] "dBsm"  IFV
 SG_ CAN_FL_DET_VALID_FLAG_142 : 192|1@0+ (1,0) [0|1] ""  IFV
 SG_ CAN_FL_DET_SUPER_RES_142 : 200|1@0+ (1,0) [0|1] ""  IFV
 SG_ CAN_FL_DET_LOW_SNR_FLAG_142 : 201|1@0+ (1,0) [0|1] ""  IFV
 SG_ CAN_FL_DET_MIXER_BIAS_FLAG_142 : 202|1@0+ (1,0) [0|1] ""  IFV
 SG_ CAN_FL_DET_RESERVED_FLAGS_142 : 207|5@0+ (1,0) [0|31] ""  IFV
 SG_ CAN_FL_DET_SNR_142 : 215|8@0+ (0.35156,0) [0|89.6478] "dB"  IFV
 SG_ CAN_FL_DET_MULTI_TARGET_PROB_142 : 219|4@0+ (0.06667,0) [0|1] ""  IFV
 SG_ CAN_FL_DET_CONFID_AZIMUTH_142 : 221|2@0+ (1,0) [0|3] ""  IFV
 SG_ CAN_FL_DET_CONFID_ELEVATION_142 : 223|2@0+ (1,0) [0|3] ""  IFV
 SG_ CAN_FL_DET_EXISTENCE_PROB_142 : 227|4@0+ (1,0) [0|15] ""  IFV
 SG_ CAN_FL_DET_CLASS_142 : 231|4@0+ (1,0) [0|15] ""  IFV
 SG_ CAN_FL_DET_RANGE_143 : 247|14@0+ (0.015625,0) [0|255.984375] "m"  IFV
 SG_ CAN_FL_DET_SD_RANGE_143 : 249|6@0+ (0.025,0) [0|1.5] "m"  IFV
 SG_ CAN_FL_DET_RANGE_RATE_143 : 259|14@0+ (0.015625,-128) [-128|127.984375] "m/s"  IFV
 SG_ CAN_FL_DET_SD_RANGE_RATE_143 : 277|6@0+ (0.02,0) [0|1.2] "m/s"  IFV
 SG_ CAN_FL_DET_AZIMUTH_143 : 287|13@0+ (0.0007668,-3.141593) [-3.141593|3.141593] "rad"  IFV
 SG_ CAN_FL_DET_SD_AZIMUTH_143 : 290|6@0+ (0.001745329,0) [0|0.104719755] "rad"  IFV
 SG_ CAN_FL_DET_ELEVATION_143 : 300|7@0+ (0.157449,-9.99812) [-9.99812|9.997903] "deg"  IFV
 SG_ CAN_FL_DET_SD_ELEVATION_143 : 309|6@0+ (0.003490659,0) [0|0.20943951] "rad"  IFV
 SG_ CAN_FL_DET_AMPLITUDE_143 : 319|7@0+ (1,-64) [-64|63] "dBsm"  IFV
 SG_ CAN_FL_DET_VALID_FLAG_143 : 312|1@0+ (1,0) [0|1] ""  IFV
 SG_ CAN_FL_DET_SUPER_RES_143 : 320|1@0+ (1,0) [0|1] ""  IFV
 SG_ CAN_FL_DET_LOW_SNR_FLAG_143 : 321|1@0+ (1,0) [0|1] ""  IFV
 SG_ CAN_FL_DET_MIXER_BIAS_FLAG_143 : 322|1@0+ (1,0) [0|1] ""  IFV
 SG_ CAN_FL_DET_RESERVED_FLAGS_143 : 327|5@0+ (1,0) [0|31] ""  IFV
 SG_ CAN_FL_DET_SNR_143 : 335|8@0+ (0.35156,0) [0|89.6478] "dB"  IFV
 SG_ CAN_FL_DET_MULTI_TARGET_PROB_143 : 339|4@0+ (0.06667,0) [0|1] ""  IFV
 SG_ CAN_FL_DET_CONFID_AZIMUTH_143 : 341|2@0+ (1,0) [0|3] ""  IFV
 SG_ CAN_FL_DET_CONFID_ELEVATION_143 : 343|2@0+ (1,0) [0|3] ""  IFV
 SG_ CAN_FL_DET_EXISTENCE_PROB_143 : 347|4@0+ (1,0) [0|15] ""  IFV
 SG_ CAN_FL_DET_CLASS_143 : 351|4@0+ (1,0) [0|15] ""  IFV
 SG_ CAN_FL_DET_RANGE_144 : 367|14@0+ (0.015625,0) [0|255.984375] "m"  IFV
 SG_ CAN_FL_DET_SD_RANGE_144 : 369|6@0+ (0.025,0) [0|1.5] "m"  IFV
 SG_ CAN_FL_DET_RANGE_RATE_144 : 379|14@0+ (0.015625,-128) [-128|127.984375] "m/s"  IFV
 SG_ CAN_FL_DET_SD_RANGE_RATE_144 : 397|6@0+ (0.02,0) [0|1.2] "m/s"  IFV
 SG_ CAN_FL_DET_AZIMUTH_144 : 407|13@0+ (0.0007668,-3.141593) [-3.141593|3.141593] "rad"  IFV
 SG_ CAN_FL_DET_SD_AZIMUTH_144 : 410|6@0+ (0.001745329,0) [0|0.104719755] "rad"  IFV
 SG_ CAN_FL_DET_ELEVATION_144 : 420|7@0+ (0.157449,-9.99812) [-9.99812|9.997903] "deg"  IFV
 SG_ CAN_FL_DET_SD_ELEVATION_144 : 429|6@0+ (0.003490659,0) [0|0.20943951] "rad"  IFV
 SG_ CAN_FL_DET_AMPLITUDE_144 : 439|7@0+ (1,-64) [-64|63] "dBsm"  IFV
 SG_ CAN_FL_DET_VALID_FLAG_144 : 432|1@0+ (1,0) [0|1] ""  IFV
 SG_ CAN_FL_DET_SUPER_RES_144 : 440|1@0+ (1,0) [0|1] ""  IFV
 SG_ CAN_FL_DET_LOW_SNR_FLAG_144 : 441|1@0+ (1,0) [0|1] ""  IFV
 SG_ CAN_FL_DET_MIXER_BIAS_FLAG_144 : 442|1@0+ (1,0) [0|1] ""  IFV
 SG_ CAN_FL_DET_RESERVED_FLAGS_144 : 447|5@0+ (1,0) [0|31] ""  IFV
 SG_ CAN_FL_DET_SNR_144 : 455|8@0+ (0.35156,0) [0|89.6478] "dB"  IFV
 SG_ CAN_FL_DET_MULTI_TARGET_PROB_144 : 459|4@0+ (0.06667,0) [0|1] ""  IFV
 SG_ CAN_FL_DET_CONFID_AZIMUTH_144 : 461|2@0+ (1,0) [0|3] ""  IFV
 SG_ CAN_FL_DET_CONFID_ELEVATION_144 : 463|2@0+ (1,0) [0|3] ""  IFV
 SG_ CAN_FL_DET_EXISTENCE_PROB_144 : 467|4@0+ (1,0) [0|15] ""  IFV
 SG_ CAN_FL_DET_CLASS_144 : 471|4@0+ (1,0) [0|15] ""  IFV

BO_ 804 SODFL_DETECTION_145_148: 64 SODFL
 SG_ CAN_FL_DET_RANGE_145 : 7|14@0+ (0.015625,0) [0|255.984375] "m"  IFV
 SG_ CAN_FL_DET_SD_RANGE_145 : 9|6@0+ (0.025,0) [0|1.5] "m"  IFV
 SG_ CAN_FL_DET_RANGE_RATE_145 : 19|14@0+ (0.015625,-128) [-128|127.984375] "m/s"  IFV
 SG_ CAN_FL_DET_SD_RANGE_RATE_145 : 37|6@0+ (0.02,0) [0|1.2] "m/s"  IFV
 SG_ CAN_FL_DET_AZIMUTH_145 : 47|13@0+ (0.0007668,-3.141593) [-3.141593|3.141593] "rad"  IFV
 SG_ CAN_FL_DET_SD_AZIMUTH_145 : 50|6@0+ (0.001745329,0) [0|0.104719755] "rad"  IFV
 SG_ CAN_FL_DET_ELEVATION_145 : 60|7@0+ (0.157449,-9.99812) [-9.99812|9.997903] "deg"  IFV
 SG_ CAN_FL_DET_SD_ELEVATION_145 : 69|6@0+ (0.003490659,0) [0|0.20943951] "rad"  IFV
 SG_ CAN_FL_DET_AMPLITUDE_145 : 79|7@0+ (1,-64) [-64|63] "dBsm"  IFV
 SG_ CAN_FL_DET_VALID_FLAG_145 : 72|1@0+ (1,0) [0|1] ""  IFV
 SG_ CAN_FL_DET_SUPER_RES_145 : 80|1@0+ (1,0) [0|1] ""  IFV
 SG_ CAN_FL_DET_LOW_SNR_FLAG_145 : 81|1@0+ (1,0) [0|1] ""  IFV
 SG_ CAN_FL_DET_MIXER_BIAS_FLAG_145 : 82|1@0+ (1,0) [0|1] ""  IFV
 SG_ CAN_FL_DET_RESERVED_FLAGS_145 : 87|5@0+ (1,0) [0|31] ""  IFV
 SG_ CAN_FL_DET_SNR_145 : 95|8@0+ (0.35156,0) [0|89.6478] "dB"  IFV
 SG_ CAN_FL_DET_MULTI_TARGET_PROB_145 : 99|4@0+ (0.06667,0) [0|1] ""  IFV
 SG_ CAN_FL_DET_CONFID_AZIMUTH_145 : 101|2@0+ (1,0) [0|3] ""  IFV
 SG_ CAN_FL_DET_CONFID_ELEVATION_145 : 103|2@0+ (1,0) [0|3] ""  IFV
 SG_ CAN_FL_DET_EXISTENCE_PROB_145 : 107|4@0+ (1,0) [0|15] ""  IFV
 SG_ CAN_FL_DET_CLASS_145 : 111|4@0+ (1,0) [0|15] ""  IFV
 SG_ CAN_FL_DET_RANGE_146 : 127|14@0+ (0.015625,0) [0|255.984375] "m"  IFV
 SG_ CAN_FL_DET_SD_RANGE_146 : 129|6@0+ (0.025,0) [0|1.5] "m"  IFV
 SG_ CAN_FL_DET_RANGE_RATE_146 : 139|14@0+ (0.015625,-128) [-128|127.984375] "m/s"  IFV
 SG_ CAN_FL_DET_SD_RANGE_RATE_146 : 157|6@0+ (0.02,0) [0|1.2] "m/s"  IFV
 SG_ CAN_FL_DET_AZIMUTH_146 : 167|13@0+ (0.0007668,-3.141593) [-3.141593|3.141593] "rad"  IFV
 SG_ CAN_FL_DET_SD_AZIMUTH_146 : 170|6@0+ (0.001745329,0) [0|0.104719755] "rad"  IFV
 SG_ CAN_FL_DET_ELEVATION_146 : 180|7@0+ (0.157449,-9.99812) [-9.99812|9.997903] "deg"  IFV
 SG_ CAN_FL_DET_SD_ELEVATION_146 : 189|6@0+ (0.003490659,0) [0|0.20943951] "rad"  IFV
 SG_ CAN_FL_DET_AMPLITUDE_146 : 199|7@0+ (1,-64) [-64|63] "dBsm"  IFV
 SG_ CAN_FL_DET_VALID_FLAG_146 : 192|1@0+ (1,0) [0|1] ""  IFV
 SG_ CAN_FL_DET_SUPER_RES_146 : 200|1@0+ (1,0) [0|1] ""  IFV
 SG_ CAN_FL_DET_LOW_SNR_FLAG_146 : 201|1@0+ (1,0) [0|1] ""  IFV
 SG_ CAN_FL_DET_MIXER_BIAS_FLAG_146 : 202|1@0+ (1,0) [0|1] ""  IFV
 SG_ CAN_FL_DET_RESERVED_FLAGS_146 : 207|5@0+ (1,0) [0|31] ""  IFV
 SG_ CAN_FL_DET_SNR_146 : 215|8@0+ (0.35156,0) [0|89.6478] "dB"  IFV
 SG_ CAN_FL_DET_MULTI_TARGET_PROB_146 : 219|4@0+ (0.06667,0) [0|1] ""  IFV
 SG_ CAN_FL_DET_CONFID_AZIMUTH_146 : 221|2@0+ (1,0) [0|3] ""  IFV
 SG_ CAN_FL_DET_CONFID_ELEVATION_146 : 223|2@0+ (1,0) [0|3] ""  IFV
 SG_ CAN_FL_DET_EXISTENCE_PROB_146 : 227|4@0+ (1,0) [0|15] ""  IFV
 SG_ CAN_FL_DET_CLASS_146 : 231|4@0+ (1,0) [0|15] ""  IFV
 SG_ CAN_FL_DET_RANGE_147 : 247|14@0+ (0.015625,0) [0|255.984375] "m"  IFV
 SG_ CAN_FL_DET_SD_RANGE_147 : 249|6@0+ (0.025,0) [0|1.5] "m"  IFV
 SG_ CAN_FL_DET_RANGE_RATE_147 : 259|14@0+ (0.015625,-128) [-128|127.984375] "m/s"  IFV
 SG_ CAN_FL_DET_SD_RANGE_RATE_147 : 277|6@0+ (0.02,0) [0|1.2] "m/s"  IFV
 SG_ CAN_FL_DET_AZIMUTH_147 : 287|13@0+ (0.0007668,-3.141593) [-3.141593|3.141593] "rad"  IFV
 SG_ CAN_FL_DET_SD_AZIMUTH_147 : 290|6@0+ (0.001745329,0) [0|0.104719755] "rad"  IFV
 SG_ CAN_FL_DET_ELEVATION_147 : 300|7@0+ (0.157449,-9.99812) [-9.99812|9.997903] "deg"  IFV
 SG_ CAN_FL_DET_SD_ELEVATION_147 : 309|6@0+ (0.003490659,0) [0|0.20943951] "rad"  IFV
 SG_ CAN_FL_DET_AMPLITUDE_147 : 319|7@0+ (1,-64) [-64|63] "dBsm"  IFV
 SG_ CAN_FL_DET_VALID_FLAG_147 : 312|1@0+ (1,0) [0|1] ""  IFV
 SG_ CAN_FL_DET_SUPER_RES_147 : 320|1@0+ (1,0) [0|1] ""  IFV
 SG_ CAN_FL_DET_LOW_SNR_FLAG_147 : 321|1@0+ (1,0) [0|1] ""  IFV
 SG_ CAN_FL_DET_MIXER_BIAS_FLAG_147 : 322|1@0+ (1,0) [0|1] ""  IFV
 SG_ CAN_FL_DET_RESERVED_FLAGS_147 : 327|5@0+ (1,0) [0|31] ""  IFV
 SG_ CAN_FL_DET_SNR_147 : 335|8@0+ (0.35156,0) [0|89.6478] "dB"  IFV
 SG_ CAN_FL_DET_MULTI_TARGET_PROB_147 : 339|4@0+ (0.06667,0) [0|1] ""  IFV
 SG_ CAN_FL_DET_CONFID_AZIMUTH_147 : 341|2@0+ (1,0) [0|3] ""  IFV
 SG_ CAN_FL_DET_CONFID_ELEVATION_147 : 343|2@0+ (1,0) [0|3] ""  IFV
 SG_ CAN_FL_DET_EXISTENCE_PROB_147 : 347|4@0+ (1,0) [0|15] ""  IFV
 SG_ CAN_FL_DET_CLASS_147 : 351|4@0+ (1,0) [0|15] ""  IFV
 SG_ CAN_FL_DET_RANGE_148 : 367|14@0+ (0.015625,0) [0|255.984375] "m"  IFV
 SG_ CAN_FL_DET_SD_RANGE_148 : 369|6@0+ (0.025,0) [0|1.5] "m"  IFV
 SG_ CAN_FL_DET_RANGE_RATE_148 : 379|14@0+ (0.015625,-128) [-128|127.984375] "m/s"  IFV
 SG_ CAN_FL_DET_SD_RANGE_RATE_148 : 397|6@0+ (0.02,0) [0|1.2] "m/s"  IFV
 SG_ CAN_FL_DET_AZIMUTH_148 : 407|13@0+ (0.0007668,-3.141593) [-3.141593|3.141593] "rad"  IFV
 SG_ CAN_FL_DET_SD_AZIMUTH_148 : 410|6@0+ (0.001745329,0) [0|0.104719755] "rad"  IFV
 SG_ CAN_FL_DET_ELEVATION_148 : 420|7@0+ (0.157449,-9.99812) [-9.99812|9.997903] "deg"  IFV
 SG_ CAN_FL_DET_SD_ELEVATION_148 : 429|6@0+ (0.003490659,0) [0|0.20943951] "rad"  IFV
 SG_ CAN_FL_DET_AMPLITUDE_148 : 439|7@0+ (1,-64) [-64|63] "dBsm"  IFV
 SG_ CAN_FL_DET_VALID_FLAG_148 : 432|1@0+ (1,0) [0|1] ""  IFV
 SG_ CAN_FL_DET_SUPER_RES_148 : 440|1@0+ (1,0) [0|1] ""  IFV
 SG_ CAN_FL_DET_LOW_SNR_FLAG_148 : 441|1@0+ (1,0) [0|1] ""  IFV
 SG_ CAN_FL_DET_MIXER_BIAS_FLAG_148 : 442|1@0+ (1,0) [0|1] ""  IFV
 SG_ CAN_FL_DET_RESERVED_FLAGS_148 : 447|5@0+ (1,0) [0|31] ""  IFV
 SG_ CAN_FL_DET_SNR_148 : 455|8@0+ (0.35156,0) [0|89.6478] "dB"  IFV
 SG_ CAN_FL_DET_MULTI_TARGET_PROB_148 : 459|4@0+ (0.06667,0) [0|1] ""  IFV
 SG_ CAN_FL_DET_CONFID_AZIMUTH_148 : 461|2@0+ (1,0) [0|3] ""  IFV
 SG_ CAN_FL_DET_CONFID_ELEVATION_148 : 463|2@0+ (1,0) [0|3] ""  IFV
 SG_ CAN_FL_DET_EXISTENCE_PROB_148 : 467|4@0+ (1,0) [0|15] ""  IFV
 SG_ CAN_FL_DET_CLASS_148 : 471|4@0+ (1,0) [0|15] ""  IFV

BO_ 805 SODFL_DETECTION_149_152: 64 SODFL
 SG_ CAN_FL_DET_RANGE_149 : 7|14@0+ (0.015625,0) [0|255.984375] "m"  IFV
 SG_ CAN_FL_DET_SD_RANGE_149 : 9|6@0+ (0.025,0) [0|1.5] "m"  IFV
 SG_ CAN_FL_DET_RANGE_RATE_149 : 19|14@0+ (0.015625,-128) [-128|127.984375] "m/s"  IFV
 SG_ CAN_FL_DET_SD_RANGE_RATE_149 : 37|6@0+ (0.02,0) [0|1.2] "m/s"  IFV
 SG_ CAN_FL_DET_AZIMUTH_149 : 47|13@0+ (0.0007668,-3.141593) [-3.141593|3.141593] "rad"  IFV
 SG_ CAN_FL_DET_SD_AZIMUTH_149 : 50|6@0+ (0.001745329,0) [0|0.104719755] "rad"  IFV
 SG_ CAN_FL_DET_ELEVATION_149 : 60|7@0+ (0.157449,-9.99812) [-9.99812|9.997903] "deg"  IFV
 SG_ CAN_FL_DET_SD_ELEVATION_149 : 69|6@0+ (0.003490659,0) [0|0.20943951] "rad"  IFV
 SG_ CAN_FL_DET_AMPLITUDE_149 : 79|7@0+ (1,-64) [-64|63] "dBsm"  IFV
 SG_ CAN_FL_DET_VALID_FLAG_149 : 72|1@0+ (1,0) [0|1] ""  IFV
 SG_ CAN_FL_DET_SUPER_RES_149 : 80|1@0+ (1,0) [0|1] ""  IFV
 SG_ CAN_FL_DET_LOW_SNR_FLAG_149 : 81|1@0+ (1,0) [0|1] ""  IFV
 SG_ CAN_FL_DET_MIXER_BIAS_FLAG_149 : 82|1@0+ (1,0) [0|1] ""  IFV
 SG_ CAN_FL_DET_RESERVED_FLAGS_149 : 87|5@0+ (1,0) [0|31] ""  IFV
 SG_ CAN_FL_DET_SNR_149 : 95|8@0+ (0.35156,0) [0|89.6478] "dB"  IFV
 SG_ CAN_FL_DET_MULTI_TARGET_PROB_149 : 99|4@0+ (0.06667,0) [0|1] ""  IFV
 SG_ CAN_FL_DET_CONFID_AZIMUTH_149 : 101|2@0+ (1,0) [0|3] ""  IFV
 SG_ CAN_FL_DET_CONFID_ELEVATION_149 : 103|2@0+ (1,0) [0|3] ""  IFV
 SG_ CAN_FL_DET_EXISTENCE_PROB_149 : 107|4@0+ (1,0) [0|15] ""  IFV
 SG_ CAN_FL_DET_CLASS_149 : 111|4@0+ (1,0) [0|15] ""  IFV
 SG_ CAN_FL_DET_RANGE_150 : 127|14@0+ (0.015625,0) [0|255.984375] "m"  IFV
 SG_ CAN_FL_DET_SD_RANGE_150 : 129|6@0+ (0.025,0) [0|1.5] "m"  IFV
 SG_ CAN_FL_DET_RANGE_RATE_150 : 139|14@0+ (0.015625,-128) [-128|127.984375] "m/s"  IFV
 SG_ CAN_FL_DET_SD_RANGE_RATE_150 : 157|6@0+ (0.02,0) [0|1.2] "m/s"  IFV
 SG_ CAN_FL_DET_AZIMUTH_150 : 167|13@0+ (0.0007668,-3.141593) [-3.141593|3.141593] "rad"  IFV
 SG_ CAN_FL_DET_SD_AZIMUTH_150 : 170|6@0+ (0.001745329,0) [0|0.104719755] "rad"  IFV
 SG_ CAN_FL_DET_ELEVATION_150 : 180|7@0+ (0.157449,-9.99812) [-9.99812|9.997903] "deg"  IFV
 SG_ CAN_FL_DET_SD_ELEVATION_150 : 189|6@0+ (0.003490659,0) [0|0.20943951] "rad"  IFV
 SG_ CAN_FL_DET_AMPLITUDE_150 : 199|7@0+ (1,-64) [-64|63] "dBsm"  IFV
 SG_ CAN_FL_DET_VALID_FLAG_150 : 192|1@0+ (1,0) [0|1] ""  IFV
 SG_ CAN_FL_DET_SUPER_RES_150 : 200|1@0+ (1,0) [0|1] ""  IFV
 SG_ CAN_FL_DET_LOW_SNR_FLAG_150 : 201|1@0+ (1,0) [0|1] ""  IFV
 SG_ CAN_FL_DET_MIXER_BIAS_FLAG_150 : 202|1@0+ (1,0) [0|1] ""  IFV
 SG_ CAN_FL_DET_RESERVED_FLAGS_150 : 207|5@0+ (1,0) [0|31] ""  IFV
 SG_ CAN_FL_DET_SNR_150 : 215|8@0+ (0.35156,0) [0|89.6478] "dB"  IFV
 SG_ CAN_FL_DET_MULTI_TARGET_PROB_150 : 219|4@0+ (0.06667,0) [0|1] ""  IFV
 SG_ CAN_FL_DET_CONFID_AZIMUTH_150 : 221|2@0+ (1,0) [0|3] ""  IFV
 SG_ CAN_FL_DET_CONFID_ELEVATION_150 : 223|2@0+ (1,0) [0|3] ""  IFV
 SG_ CAN_FL_DET_EXISTENCE_PROB_150 : 227|4@0+ (1,0) [0|15] ""  IFV
 SG_ CAN_FL_DET_CLASS_150 : 231|4@0+ (1,0) [0|15] ""  IFV
 SG_ CAN_FL_DET_RANGE_151 : 247|14@0+ (0.015625,0) [0|255.984375] "m"  IFV
 SG_ CAN_FL_DET_SD_RANGE_151 : 249|6@0+ (0.025,0) [0|1.5] "m"  IFV
 SG_ CAN_FL_DET_RANGE_RATE_151 : 259|14@0+ (0.015625,-128) [-128|127.984375] "m/s"  IFV
 SG_ CAN_FL_DET_SD_RANGE_RATE_151 : 277|6@0+ (0.02,0) [0|1.2] "m/s"  IFV
 SG_ CAN_FL_DET_AZIMUTH_151 : 287|13@0+ (0.0007668,-3.141593) [-3.141593|3.141593] "rad"  IFV
 SG_ CAN_FL_DET_SD_AZIMUTH_151 : 290|6@0+ (0.001745329,0) [0|0.104719755] "rad"  IFV
 SG_ CAN_FL_DET_ELEVATION_151 : 300|7@0+ (0.157449,-9.99812) [-9.99812|9.997903] "deg"  IFV
 SG_ CAN_FL_DET_SD_ELEVATION_151 : 309|6@0+ (0.003490659,0) [0|0.20943951] "rad"  IFV
 SG_ CAN_FL_DET_AMPLITUDE_151 : 319|7@0+ (1,-64) [-64|63] "dBsm"  IFV
 SG_ CAN_FL_DET_VALID_FLAG_151 : 312|1@0+ (1,0) [0|1] ""  IFV
 SG_ CAN_FL_DET_SUPER_RES_151 : 320|1@0+ (1,0) [0|1] ""  IFV
 SG_ CAN_FL_DET_LOW_SNR_FLAG_151 : 321|1@0+ (1,0) [0|1] ""  IFV
 SG_ CAN_FL_DET_MIXER_BIAS_FLAG_151 : 322|1@0+ (1,0) [0|1] ""  IFV
 SG_ CAN_FL_DET_RESERVED_FLAGS_151 : 327|5@0+ (1,0) [0|31] ""  IFV
 SG_ CAN_FL_DET_SNR_151 : 335|8@0+ (0.35156,0) [0|89.6478] "dB"  IFV
 SG_ CAN_FL_DET_MULTI_TARGET_PROB_151 : 339|4@0+ (0.06667,0) [0|1] ""  IFV
 SG_ CAN_FL_DET_CONFID_AZIMUTH_151 : 341|2@0+ (1,0) [0|3] ""  IFV
 SG_ CAN_FL_DET_CONFID_ELEVATION_151 : 343|2@0+ (1,0) [0|3] ""  IFV
 SG_ CAN_FL_DET_EXISTENCE_PROB_151 : 347|4@0+ (1,0) [0|15] ""  IFV
 SG_ CAN_FL_DET_CLASS_151 : 351|4@0+ (1,0) [0|15] ""  IFV
 SG_ CAN_FL_DET_RANGE_152 : 367|14@0+ (0.015625,0) [0|255.984375] "m"  IFV
 SG_ CAN_FL_DET_SD_RANGE_152 : 369|6@0+ (0.025,0) [0|1.5] "m"  IFV
 SG_ CAN_FL_DET_RANGE_RATE_152 : 379|14@0+ (0.015625,-128) [-128|127.984375] "m/s"  IFV
 SG_ CAN_FL_DET_SD_RANGE_RATE_152 : 397|6@0+ (0.02,0) [0|1.2] "m/s"  IFV
 SG_ CAN_FL_DET_AZIMUTH_152 : 407|13@0+ (0.0007668,-3.141593) [-3.141593|3.141593] "rad"  IFV
 SG_ CAN_FL_DET_SD_AZIMUTH_152 : 410|6@0+ (0.001745329,0) [0|0.104719755] "rad"  IFV
 SG_ CAN_FL_DET_ELEVATION_152 : 420|7@0+ (0.157449,-9.99812) [-9.99812|9.997903] "deg"  IFV
 SG_ CAN_FL_DET_SD_ELEVATION_152 : 429|6@0+ (0.003490659,0) [0|0.20943951] "rad"  IFV
 SG_ CAN_FL_DET_AMPLITUDE_152 : 439|7@0+ (1,-64) [-64|63] "dBsm"  IFV
 SG_ CAN_FL_DET_VALID_FLAG_152 : 432|1@0+ (1,0) [0|1] ""  IFV
 SG_ CAN_FL_DET_SUPER_RES_152 : 440|1@0+ (1,0) [0|1] ""  IFV
 SG_ CAN_FL_DET_LOW_SNR_FLAG_152 : 441|1@0+ (1,0) [0|1] ""  IFV
 SG_ CAN_FL_DET_MIXER_BIAS_FLAG_152 : 442|1@0+ (1,0) [0|1] ""  IFV
 SG_ CAN_FL_DET_RESERVED_FLAGS_152 : 447|5@0+ (1,0) [0|31] ""  IFV
 SG_ CAN_FL_DET_SNR_152 : 455|8@0+ (0.35156,0) [0|89.6478] "dB"  IFV
 SG_ CAN_FL_DET_MULTI_TARGET_PROB_152 : 459|4@0+ (0.06667,0) [0|1] ""  IFV
 SG_ CAN_FL_DET_CONFID_AZIMUTH_152 : 461|2@0+ (1,0) [0|3] ""  IFV
 SG_ CAN_FL_DET_CONFID_ELEVATION_152 : 463|2@0+ (1,0) [0|3] ""  IFV
 SG_ CAN_FL_DET_EXISTENCE_PROB_152 : 467|4@0+ (1,0) [0|15] ""  IFV
 SG_ CAN_FL_DET_CLASS_152 : 471|4@0+ (1,0) [0|15] ""  IFV

BO_ 806 SODFL_DETECTION_153_156: 64 SODFL
 SG_ CAN_FL_DET_RANGE_153 : 7|14@0+ (0.015625,0) [0|255.984375] "m"  IFV
 SG_ CAN_FL_DET_SD_RANGE_153 : 9|6@0+ (0.025,0) [0|1.5] "m"  IFV
 SG_ CAN_FL_DET_RANGE_RATE_153 : 19|14@0+ (0.015625,-128) [-128|127.984375] "m/s"  IFV
 SG_ CAN_FL_DET_SD_RANGE_RATE_153 : 37|6@0+ (0.02,0) [0|1.2] "m/s"  IFV
 SG_ CAN_FL_DET_AZIMUTH_153 : 47|13@0+ (0.0007668,-3.141593) [-3.141593|3.141593] "rad"  IFV
 SG_ CAN_FL_DET_SD_AZIMUTH_153 : 50|6@0+ (0.001745329,0) [0|0.104719755] "rad"  IFV
 SG_ CAN_FL_DET_ELEVATION_153 : 60|7@0+ (0.157449,-9.99812) [-9.99812|9.997903] "deg"  IFV
 SG_ CAN_FL_DET_SD_ELEVATION_153 : 69|6@0+ (0.003490659,0) [0|0.20943951] "rad"  IFV
 SG_ CAN_FL_DET_AMPLITUDE_153 : 79|7@0+ (1,-64) [-64|63] "dBsm"  IFV
 SG_ CAN_FL_DET_VALID_FLAG_153 : 72|1@0+ (1,0) [0|1] ""  IFV
 SG_ CAN_FL_DET_SUPER_RES_153 : 80|1@0+ (1,0) [0|1] ""  IFV
 SG_ CAN_FL_DET_LOW_SNR_FLAG_153 : 81|1@0+ (1,0) [0|1] ""  IFV
 SG_ CAN_FL_DET_MIXER_BIAS_FLAG_153 : 82|1@0+ (1,0) [0|1] ""  IFV
 SG_ CAN_FL_DET_RESERVED_FLAGS_153 : 87|5@0+ (1,0) [0|31] ""  IFV
 SG_ CAN_FL_DET_SNR_153 : 95|8@0+ (0.35156,0) [0|89.6478] "dB"  IFV
 SG_ CAN_FL_DET_MULTI_TARGET_PROB_153 : 99|4@0+ (0.06667,0) [0|1] ""  IFV
 SG_ CAN_FL_DET_CONFID_AZIMUTH_153 : 101|2@0+ (1,0) [0|3] ""  IFV
 SG_ CAN_FL_DET_CONFID_ELEVATION_153 : 103|2@0+ (1,0) [0|3] ""  IFV
 SG_ CAN_FL_DET_EXISTENCE_PROB_153 : 107|4@0+ (1,0) [0|15] ""  IFV
 SG_ CAN_FL_DET_CLASS_153 : 111|4@0+ (1,0) [0|15] ""  IFV
 SG_ CAN_FL_DET_RANGE_154 : 127|14@0+ (0.015625,0) [0|255.984375] "m"  IFV
 SG_ CAN_FL_DET_SD_RANGE_154 : 129|6@0+ (0.025,0) [0|1.5] "m"  IFV
 SG_ CAN_FL_DET_RANGE_RATE_154 : 139|14@0+ (0.015625,-128) [-128|127.984375] "m/s"  IFV
 SG_ CAN_FL_DET_SD_RANGE_RATE_154 : 157|6@0+ (0.02,0) [0|1.2] "m/s"  IFV
 SG_ CAN_FL_DET_AZIMUTH_154 : 167|13@0+ (0.0007668,-3.141593) [-3.141593|3.141593] "rad"  IFV
 SG_ CAN_FL_DET_SD_AZIMUTH_154 : 170|6@0+ (0.001745329,0) [0|0.104719755] "rad"  IFV
 SG_ CAN_FL_DET_ELEVATION_154 : 180|7@0+ (0.157449,-9.99812) [-9.99812|9.997903] "deg"  IFV
 SG_ CAN_FL_DET_SD_ELEVATION_154 : 189|6@0+ (0.003490659,0) [0|0.20943951] "rad"  IFV
 SG_ CAN_FL_DET_AMPLITUDE_154 : 199|7@0+ (1,-64) [-64|63] "dBsm"  IFV
 SG_ CAN_FL_DET_VALID_FLAG_154 : 192|1@0+ (1,0) [0|1] ""  IFV
 SG_ CAN_FL_DET_SUPER_RES_154 : 200|1@0+ (1,0) [0|1] ""  IFV
 SG_ CAN_FL_DET_LOW_SNR_FLAG_154 : 201|1@0+ (1,0) [0|1] ""  IFV
 SG_ CAN_FL_DET_MIXER_BIAS_FLAG_154 : 202|1@0+ (1,0) [0|1] ""  IFV
 SG_ CAN_FL_DET_RESERVED_FLAGS_154 : 207|5@0+ (1,0) [0|31] ""  IFV
 SG_ CAN_FL_DET_SNR_154 : 215|8@0+ (0.35156,0) [0|89.6478] "dB"  IFV
 SG_ CAN_FL_DET_MULTI_TARGET_PROB_154 : 219|4@0+ (0.06667,0) [0|1] ""  IFV
 SG_ CAN_FL_DET_CONFID_AZIMUTH_154 : 221|2@0+ (1,0) [0|3] ""  IFV
 SG_ CAN_FL_DET_CONFID_ELEVATION_154 : 223|2@0+ (1,0) [0|3] ""  IFV
 SG_ CAN_FL_DET_EXISTENCE_PROB_154 : 227|4@0+ (1,0) [0|15] ""  IFV
 SG_ CAN_FL_DET_CLASS_154 : 231|4@0+ (1,0) [0|15] ""  IFV
 SG_ CAN_FL_DET_RANGE_155 : 247|14@0+ (0.015625,0) [0|255.984375] "m"  IFV
 SG_ CAN_FL_DET_SD_RANGE_155 : 249|6@0+ (0.025,0) [0|1.5] "m"  IFV
 SG_ CAN_FL_DET_RANGE_RATE_155 : 259|14@0+ (0.015625,-128) [-128|127.984375] "m/s"  IFV
 SG_ CAN_FL_DET_SD_RANGE_RATE_155 : 277|6@0+ (0.02,0) [0|1.2] "m/s"  IFV
 SG_ CAN_FL_DET_AZIMUTH_155 : 287|13@0+ (0.0007668,-3.141593) [-3.141593|3.141593] "rad"  IFV
 SG_ CAN_FL_DET_SD_AZIMUTH_155 : 290|6@0+ (0.001745329,0) [0|0.104719755] "rad"  IFV
 SG_ CAN_FL_DET_ELEVATION_155 : 300|7@0+ (0.157449,-9.99812) [-9.99812|9.997903] "deg"  IFV
 SG_ CAN_FL_DET_SD_ELEVATION_155 : 309|6@0+ (0.003490659,0) [0|0.20943951] "rad"  IFV
 SG_ CAN_FL_DET_AMPLITUDE_155 : 319|7@0+ (1,-64) [-64|63] "dBsm"  IFV
 SG_ CAN_FL_DET_VALID_FLAG_155 : 312|1@0+ (1,0) [0|1] ""  IFV
 SG_ CAN_FL_DET_SUPER_RES_155 : 320|1@0+ (1,0) [0|1] ""  IFV
 SG_ CAN_FL_DET_LOW_SNR_FLAG_155 : 321|1@0+ (1,0) [0|1] ""  IFV
 SG_ CAN_FL_DET_MIXER_BIAS_FLAG_155 : 322|1@0+ (1,0) [0|1] ""  IFV
 SG_ CAN_FL_DET_RESERVED_FLAGS_155 : 327|5@0+ (1,0) [0|31] ""  IFV
 SG_ CAN_FL_DET_SNR_155 : 335|8@0+ (0.35156,0) [0|89.6478] "dB"  IFV
 SG_ CAN_FL_DET_MULTI_TARGET_PROB_155 : 339|4@0+ (0.06667,0) [0|1] ""  IFV
 SG_ CAN_FL_DET_CONFID_AZIMUTH_155 : 341|2@0+ (1,0) [0|3] ""  IFV
 SG_ CAN_FL_DET_CONFID_ELEVATION_155 : 343|2@0+ (1,0) [0|3] ""  IFV
 SG_ CAN_FL_DET_EXISTENCE_PROB_155 : 347|4@0+ (1,0) [0|15] ""  IFV
 SG_ CAN_FL_DET_CLASS_155 : 351|4@0+ (1,0) [0|15] ""  IFV
 SG_ CAN_FL_DET_RANGE_156 : 367|14@0+ (0.015625,0) [0|255.984375] "m"  IFV
 SG_ CAN_FL_DET_SD_RANGE_156 : 369|6@0+ (0.025,0) [0|1.5] "m"  IFV
 SG_ CAN_FL_DET_RANGE_RATE_156 : 379|14@0+ (0.015625,-128) [-128|127.984375] "m/s"  IFV
 SG_ CAN_FL_DET_SD_RANGE_RATE_156 : 397|6@0+ (0.02,0) [0|1.2] "m/s"  IFV
 SG_ CAN_FL_DET_AZIMUTH_156 : 407|13@0+ (0.0007668,-3.141593) [-3.141593|3.141593] "rad"  IFV
 SG_ CAN_FL_DET_SD_AZIMUTH_156 : 410|6@0+ (0.001745329,0) [0|0.104719755] "rad"  IFV
 SG_ CAN_FL_DET_ELEVATION_156 : 420|7@0+ (0.157449,-9.99812) [-9.99812|9.997903] "deg"  IFV
 SG_ CAN_FL_DET_SD_ELEVATION_156 : 429|6@0+ (0.003490659,0) [0|0.20943951] "rad"  IFV
 SG_ CAN_FL_DET_AMPLITUDE_156 : 439|7@0+ (1,-64) [-64|63] "dBsm"  IFV
 SG_ CAN_FL_DET_VALID_FLAG_156 : 432|1@0+ (1,0) [0|1] ""  IFV
 SG_ CAN_FL_DET_SUPER_RES_156 : 440|1@0+ (1,0) [0|1] ""  IFV
 SG_ CAN_FL_DET_LOW_SNR_FLAG_156 : 441|1@0+ (1,0) [0|1] ""  IFV
 SG_ CAN_FL_DET_MIXER_BIAS_FLAG_156 : 442|1@0+ (1,0) [0|1] ""  IFV
 SG_ CAN_FL_DET_RESERVED_FLAGS_156 : 447|5@0+ (1,0) [0|31] ""  IFV
 SG_ CAN_FL_DET_SNR_156 : 455|8@0+ (0.35156,0) [0|89.6478] "dB"  IFV
 SG_ CAN_FL_DET_MULTI_TARGET_PROB_156 : 459|4@0+ (0.06667,0) [0|1] ""  IFV
 SG_ CAN_FL_DET_CONFID_AZIMUTH_156 : 461|2@0+ (1,0) [0|3] ""  IFV
 SG_ CAN_FL_DET_CONFID_ELEVATION_156 : 463|2@0+ (1,0) [0|3] ""  IFV
 SG_ CAN_FL_DET_EXISTENCE_PROB_156 : 467|4@0+ (1,0) [0|15] ""  IFV
 SG_ CAN_FL_DET_CLASS_156 : 471|4@0+ (1,0) [0|15] ""  IFV

BO_ 807 SODFL_DETECTION_157_160: 64 SODFL
 SG_ CAN_FL_DET_RANGE_157 : 7|14@0+ (0.015625,0) [0|255.984375] "m"  IFV
 SG_ CAN_FL_DET_SD_RANGE_157 : 9|6@0+ (0.025,0) [0|1.5] "m"  IFV
 SG_ CAN_FL_DET_RANGE_RATE_157 : 19|14@0+ (0.015625,-128) [-128|127.984375] "m/s"  IFV
 SG_ CAN_FL_DET_SD_RANGE_RATE_157 : 37|6@0+ (0.02,0) [0|1.2] "m/s"  IFV
 SG_ CAN_FL_DET_AZIMUTH_157 : 47|13@0+ (0.0007668,-3.141593) [-3.141593|3.141593] "rad"  IFV
 SG_ CAN_FL_DET_SD_AZIMUTH_157 : 50|6@0+ (0.001745329,0) [0|0.104719755] "rad"  IFV
 SG_ CAN_FL_DET_ELEVATION_157 : 60|7@0+ (0.157449,-9.99812) [-9.99812|9.997903] "deg"  IFV
 SG_ CAN_FL_DET_SD_ELEVATION_157 : 69|6@0+ (0.003490659,0) [0|0.20943951] "rad"  IFV
 SG_ CAN_FL_DET_AMPLITUDE_157 : 79|7@0+ (1,-64) [-64|63] "dBsm"  IFV
 SG_ CAN_FL_DET_VALID_FLAG_157 : 72|1@0+ (1,0) [0|1] ""  IFV
 SG_ CAN_FL_DET_SUPER_RES_157 : 80|1@0+ (1,0) [0|1] ""  IFV
 SG_ CAN_FL_DET_LOW_SNR_FLAG_157 : 81|1@0+ (1,0) [0|1] ""  IFV
 SG_ CAN_FL_DET_MIXER_BIAS_FLAG_157 : 82|1@0+ (1,0) [0|1] ""  IFV
 SG_ CAN_FL_DET_RESERVED_FLAGS_157 : 87|5@0+ (1,0) [0|31] ""  IFV
 SG_ CAN_FL_DET_SNR_157 : 95|8@0+ (0.35156,0) [0|89.6478] "dB"  IFV
 SG_ CAN_FL_DET_MULTI_TARGET_PROB_157 : 99|4@0+ (0.06667,0) [0|1] ""  IFV
 SG_ CAN_FL_DET_CONFID_AZIMUTH_157 : 101|2@0+ (1,0) [0|3] ""  IFV
 SG_ CAN_FL_DET_CONFID_ELEVATION_157 : 103|2@0+ (1,0) [0|3] ""  IFV
 SG_ CAN_FL_DET_EXISTENCE_PROB_157 : 107|4@0+ (1,0) [0|15] ""  IFV
 SG_ CAN_FL_DET_CLASS_157 : 111|4@0+ (1,0) [0|15] ""  IFV
 SG_ CAN_FL_DET_RANGE_158 : 127|14@0+ (0.015625,0) [0|255.984375] "m"  IFV
 SG_ CAN_FL_DET_SD_RANGE_158 : 129|6@0+ (0.025,0) [0|1.5] "m"  IFV
 SG_ CAN_FL_DET_RANGE_RATE_158 : 139|14@0+ (0.015625,-128) [-128|127.984375] "m/s"  IFV
 SG_ CAN_FL_DET_SD_RANGE_RATE_158 : 157|6@0+ (0.02,0) [0|1.2] "m/s"  IFV
 SG_ CAN_FL_DET_AZIMUTH_158 : 167|13@0+ (0.0007668,-3.141593) [-3.141593|3.141593] "rad"  IFV
 SG_ CAN_FL_DET_SD_AZIMUTH_158 : 170|6@0+ (0.001745329,0) [0|0.104719755] "rad"  IFV
 SG_ CAN_FL_DET_ELEVATION_158 : 180|7@0+ (0.157449,-9.99812) [-9.99812|9.997903] "deg"  IFV
 SG_ CAN_FL_DET_SD_ELEVATION_158 : 189|6@0+ (0.003490659,0) [0|0.20943951] "rad"  IFV
 SG_ CAN_FL_DET_AMPLITUDE_158 : 199|7@0+ (1,-64) [-64|63] "dBsm"  IFV
 SG_ CAN_FL_DET_VALID_FLAG_158 : 192|1@0+ (1,0) [0|1] ""  IFV
 SG_ CAN_FL_DET_SUPER_RES_158 : 200|1@0+ (1,0) [0|1] ""  IFV
 SG_ CAN_FL_DET_LOW_SNR_FLAG_158 : 201|1@0+ (1,0) [0|1] ""  IFV
 SG_ CAN_FL_DET_MIXER_BIAS_FLAG_158 : 202|1@0+ (1,0) [0|1] ""  IFV
 SG_ CAN_FL_DET_RESERVED_FLAGS_158 : 207|5@0+ (1,0) [0|31] ""  IFV
 SG_ CAN_FL_DET_SNR_158 : 215|8@0+ (0.35156,0) [0|89.6478] "dB"  IFV
 SG_ CAN_FL_DET_MULTI_TARGET_PROB_158 : 219|4@0+ (0.06667,0) [0|1] ""  IFV
 SG_ CAN_FL_DET_CONFID_AZIMUTH_158 : 221|2@0+ (1,0) [0|3] ""  IFV
 SG_ CAN_FL_DET_CONFID_ELEVATION_158 : 223|2@0+ (1,0) [0|3] ""  IFV
 SG_ CAN_FL_DET_EXISTENCE_PROB_158 : 227|4@0+ (1,0) [0|15] ""  IFV
 SG_ CAN_FL_DET_CLASS_158 : 231|4@0+ (1,0) [0|15] ""  IFV
 SG_ CAN_FL_DET_RANGE_159 : 247|14@0+ (0.015625,0) [0|255.984375] "m"  IFV
 SG_ CAN_FL_DET_SD_RANGE_159 : 249|6@0+ (0.025,0) [0|1.5] "m"  IFV
 SG_ CAN_FL_DET_RANGE_RATE_159 : 259|14@0+ (0.015625,-128) [-128|127.984375] "m/s"  IFV
 SG_ CAN_FL_DET_SD_RANGE_RATE_159 : 277|6@0+ (0.02,0) [0|1.2] "m/s"  IFV
 SG_ CAN_FL_DET_AZIMUTH_159 : 287|13@0+ (0.0007668,-3.141593) [-3.141593|3.141593] "rad"  IFV
 SG_ CAN_FL_DET_SD_AZIMUTH_159 : 290|6@0+ (0.001745329,0) [0|0.104719755] "rad"  IFV
 SG_ CAN_FL_DET_ELEVATION_159 : 300|7@0+ (0.157449,-9.99812) [-9.99812|9.997903] "deg"  IFV
 SG_ CAN_FL_DET_SD_ELEVATION_159 : 309|6@0+ (0.003490659,0) [0|0.20943951] "rad"  IFV
 SG_ CAN_FL_DET_AMPLITUDE_159 : 319|7@0+ (1,-64) [-64|63] "dBsm"  IFV
 SG_ CAN_FL_DET_VALID_FLAG_159 : 312|1@0+ (1,0) [0|1] ""  IFV
 SG_ CAN_FL_DET_SUPER_RES_159 : 320|1@0+ (1,0) [0|1] ""  IFV
 SG_ CAN_FL_DET_LOW_SNR_FLAG_159 : 321|1@0+ (1,0) [0|1] ""  IFV
 SG_ CAN_FL_DET_MIXER_BIAS_FLAG_159 : 322|1@0+ (1,0) [0|1] ""  IFV
 SG_ CAN_FL_DET_RESERVED_FLAGS_159 : 327|5@0+ (1,0) [0|31] ""  IFV
 SG_ CAN_FL_DET_SNR_159 : 335|8@0+ (0.35156,0) [0|89.6478] "dB"  IFV
 SG_ CAN_FL_DET_MULTI_TARGET_PROB_159 : 339|4@0+ (0.06667,0) [0|1] ""  IFV
 SG_ CAN_FL_DET_CONFID_AZIMUTH_159 : 341|2@0+ (1,0) [0|3] ""  IFV
 SG_ CAN_FL_DET_CONFID_ELEVATION_159 : 343|2@0+ (1,0) [0|3] ""  IFV
 SG_ CAN_FL_DET_EXISTENCE_PROB_159 : 347|4@0+ (1,0) [0|15] ""  IFV
 SG_ CAN_FL_DET_CLASS_159 : 351|4@0+ (1,0) [0|15] ""  IFV
 SG_ CAN_FL_DET_RANGE_160 : 367|14@0+ (0.015625,0) [0|255.984375] "m"  IFV
 SG_ CAN_FL_DET_SD_RANGE_160 : 369|6@0+ (0.025,0) [0|1.5] "m"  IFV
 SG_ CAN_FL_DET_RANGE_RATE_160 : 379|14@0+ (0.015625,-128) [-128|127.984375] "m/s"  IFV
 SG_ CAN_FL_DET_SD_RANGE_RATE_160 : 397|6@0+ (0.02,0) [0|1.2] "m/s"  IFV
 SG_ CAN_FL_DET_AZIMUTH_160 : 407|13@0+ (0.0007668,-3.141593) [-3.141593|3.141593] "rad"  IFV
 SG_ CAN_FL_DET_SD_AZIMUTH_160 : 410|6@0+ (0.001745329,0) [0|0.104719755] "rad"  IFV
 SG_ CAN_FL_DET_ELEVATION_160 : 420|7@0+ (0.157449,-9.99812) [-9.99812|9.997903] "deg"  IFV
 SG_ CAN_FL_DET_SD_ELEVATION_160 : 429|6@0+ (0.003490659,0) [0|0.20943951] "rad"  IFV
 SG_ CAN_FL_DET_AMPLITUDE_160 : 439|7@0+ (1,-64) [-64|63] "dBsm"  IFV
 SG_ CAN_FL_DET_VALID_FLAG_160 : 432|1@0+ (1,0) [0|1] ""  IFV
 SG_ CAN_FL_DET_SUPER_RES_160 : 440|1@0+ (1,0) [0|1] ""  IFV
 SG_ CAN_FL_DET_LOW_SNR_FLAG_160 : 441|1@0+ (1,0) [0|1] ""  IFV
 SG_ CAN_FL_DET_MIXER_BIAS_FLAG_160 : 442|1@0+ (1,0) [0|1] ""  IFV
 SG_ CAN_FL_DET_RESERVED_FLAGS_160 : 447|5@0+ (1,0) [0|31] ""  IFV
 SG_ CAN_FL_DET_SNR_160 : 455|8@0+ (0.35156,0) [0|89.6478] "dB"  IFV
 SG_ CAN_FL_DET_MULTI_TARGET_PROB_160 : 459|4@0+ (0.06667,0) [0|1] ""  IFV
 SG_ CAN_FL_DET_CONFID_AZIMUTH_160 : 461|2@0+ (1,0) [0|3] ""  IFV
 SG_ CAN_FL_DET_CONFID_ELEVATION_160 : 463|2@0+ (1,0) [0|3] ""  IFV
 SG_ CAN_FL_DET_EXISTENCE_PROB_160 : 467|4@0+ (1,0) [0|15] ""  IFV
 SG_ CAN_FL_DET_CLASS_160 : 471|4@0+ (1,0) [0|15] ""  IFV

BO_ 808 SODFL_DETECTION_161_164: 64 SODFL
 SG_ CAN_FL_DET_RANGE_161 : 7|14@0+ (0.015625,0) [0|255.984375] "m"  IFV
 SG_ CAN_FL_DET_SD_RANGE_161 : 9|6@0+ (0.025,0) [0|1.5] "m"  IFV
 SG_ CAN_FL_DET_RANGE_RATE_161 : 19|14@0+ (0.015625,-128) [-128|127.984375] "m/s"  IFV
 SG_ CAN_FL_DET_SD_RANGE_RATE_161 : 37|6@0+ (0.02,0) [0|1.2] "m/s"  IFV
 SG_ CAN_FL_DET_AZIMUTH_161 : 47|13@0+ (0.0007668,-3.141593) [-3.141593|3.141593] "rad"  IFV
 SG_ CAN_FL_DET_SD_AZIMUTH_161 : 50|6@0+ (0.001745329,0) [0|0.104719755] "rad"  IFV
 SG_ CAN_FL_DET_ELEVATION_161 : 60|7@0+ (0.157449,-9.99812) [-9.99812|9.997903] "deg"  IFV
 SG_ CAN_FL_DET_SD_ELEVATION_161 : 69|6@0+ (0.003490659,0) [0|0.20943951] "rad"  IFV
 SG_ CAN_FL_DET_AMPLITUDE_161 : 79|7@0+ (1,-64) [-64|63] "dBsm"  IFV
 SG_ CAN_FL_DET_VALID_FLAG_161 : 72|1@0+ (1,0) [0|1] ""  IFV
 SG_ CAN_FL_DET_SUPER_RES_161 : 80|1@0+ (1,0) [0|1] ""  IFV
 SG_ CAN_FL_DET_LOW_SNR_FLAG_161 : 81|1@0+ (1,0) [0|1] ""  IFV
 SG_ CAN_FL_DET_MIXER_BIAS_FLAG_161 : 82|1@0+ (1,0) [0|1] ""  IFV
 SG_ CAN_FL_DET_RESERVED_FLAGS_161 : 87|5@0+ (1,0) [0|31] ""  IFV
 SG_ CAN_FL_DET_SNR_161 : 95|8@0+ (0.35156,0) [0|89.6478] "dB"  IFV
 SG_ CAN_FL_DET_MULTI_TARGET_PROB_161 : 99|4@0+ (0.06667,0) [0|1] ""  IFV
 SG_ CAN_FL_DET_CONFID_AZIMUTH_161 : 101|2@0+ (1,0) [0|3] ""  IFV
 SG_ CAN_FL_DET_CONFID_ELEVATION_161 : 103|2@0+ (1,0) [0|3] ""  IFV
 SG_ CAN_FL_DET_EXISTENCE_PROB_161 : 107|4@0+ (1,0) [0|15] ""  IFV
 SG_ CAN_FL_DET_CLASS_161 : 111|4@0+ (1,0) [0|15] ""  IFV
 SG_ CAN_FL_DET_RANGE_162 : 127|14@0+ (0.015625,0) [0|255.984375] "m"  IFV
 SG_ CAN_FL_DET_SD_RANGE_162 : 129|6@0+ (0.025,0) [0|1.5] "m"  IFV
 SG_ CAN_FL_DET_RANGE_RATE_162 : 139|14@0+ (0.015625,-128) [-128|127.984375] "m/s"  IFV
 SG_ CAN_FL_DET_SD_RANGE_RATE_162 : 157|6@0+ (0.02,0) [0|1.2] "m/s"  IFV
 SG_ CAN_FL_DET_AZIMUTH_162 : 167|13@0+ (0.0007668,-3.141593) [-3.141593|3.141593] "rad"  IFV
 SG_ CAN_FL_DET_SD_AZIMUTH_162 : 170|6@0+ (0.001745329,0) [0|0.104719755] "rad"  IFV
 SG_ CAN_FL_DET_ELEVATION_162 : 180|7@0+ (0.157449,-9.99812) [-9.99812|9.997903] "deg"  IFV
 SG_ CAN_FL_DET_SD_ELEVATION_162 : 189|6@0+ (0.003490659,0) [0|0.20943951] "rad"  IFV
 SG_ CAN_FL_DET_AMPLITUDE_162 : 199|7@0+ (1,-64) [-64|63] "dBsm"  IFV
 SG_ CAN_FL_DET_VALID_FLAG_162 : 192|1@0+ (1,0) [0|1] ""  IFV
 SG_ CAN_FL_DET_SUPER_RES_162 : 200|1@0+ (1,0) [0|1] ""  IFV
 SG_ CAN_FL_DET_LOW_SNR_FLAG_162 : 201|1@0+ (1,0) [0|1] ""  IFV
 SG_ CAN_FL_DET_MIXER_BIAS_FLAG_162 : 202|1@0+ (1,0) [0|1] ""  IFV
 SG_ CAN_FL_DET_RESERVED_FLAGS_162 : 207|5@0+ (1,0) [0|31] ""  IFV
 SG_ CAN_FL_DET_SNR_162 : 215|8@0+ (0.35156,0) [0|89.6478] "dB"  IFV
 SG_ CAN_FL_DET_MULTI_TARGET_PROB_162 : 219|4@0+ (0.06667,0) [0|1] ""  IFV
 SG_ CAN_FL_DET_CONFID_AZIMUTH_162 : 221|2@0+ (1,0) [0|3] ""  IFV
 SG_ CAN_FL_DET_CONFID_ELEVATION_162 : 223|2@0+ (1,0) [0|3] ""  IFV
 SG_ CAN_FL_DET_EXISTENCE_PROB_162 : 227|4@0+ (1,0) [0|15] ""  IFV
 SG_ CAN_FL_DET_CLASS_162 : 231|4@0+ (1,0) [0|15] ""  IFV
 SG_ CAN_FL_DET_RANGE_163 : 247|14@0+ (0.015625,0) [0|255.984375] "m"  IFV
 SG_ CAN_FL_DET_SD_RANGE_163 : 249|6@0+ (0.025,0) [0|1.5] "m"  IFV
 SG_ CAN_FL_DET_RANGE_RATE_163 : 259|14@0+ (0.015625,-128) [-128|127.984375] "m/s"  IFV
 SG_ CAN_FL_DET_SD_RANGE_RATE_163 : 277|6@0+ (0.02,0) [0|1.2] "m/s"  IFV
 SG_ CAN_FL_DET_AZIMUTH_163 : 287|13@0+ (0.0007668,-3.141593) [-3.141593|3.141593] "rad"  IFV
 SG_ CAN_FL_DET_SD_AZIMUTH_163 : 290|6@0+ (0.001745329,0) [0|0.104719755] "rad"  IFV
 SG_ CAN_FL_DET_ELEVATION_163 : 300|7@0+ (0.157449,-9.99812) [-9.99812|9.997903] "deg"  IFV
 SG_ CAN_FL_DET_SD_ELEVATION_163 : 309|6@0+ (0.003490659,0) [0|0.20943951] "rad"  IFV
 SG_ CAN_FL_DET_AMPLITUDE_163 : 319|7@0+ (1,-64) [-64|63] "dBsm"  IFV
 SG_ CAN_FL_DET_VALID_FLAG_163 : 312|1@0+ (1,0) [0|1] ""  IFV
 SG_ CAN_FL_DET_SUPER_RES_163 : 320|1@0+ (1,0) [0|1] ""  IFV
 SG_ CAN_FL_DET_LOW_SNR_FLAG_163 : 321|1@0+ (1,0) [0|1] ""  IFV
 SG_ CAN_FL_DET_MIXER_BIAS_FLAG_163 : 322|1@0+ (1,0) [0|1] ""  IFV
 SG_ CAN_FL_DET_RESERVED_FLAGS_163 : 327|5@0+ (1,0) [0|31] ""  IFV
 SG_ CAN_FL_DET_SNR_163 : 335|8@0+ (0.35156,0) [0|89.6478] "dB"  IFV
 SG_ CAN_FL_DET_MULTI_TARGET_PROB_163 : 339|4@0+ (0.06667,0) [0|1] ""  IFV
 SG_ CAN_FL_DET_CONFID_AZIMUTH_163 : 341|2@0+ (1,0) [0|3] ""  IFV
 SG_ CAN_FL_DET_CONFID_ELEVATION_163 : 343|2@0+ (1,0) [0|3] ""  IFV
 SG_ CAN_FL_DET_EXISTENCE_PROB_163 : 347|4@0+ (1,0) [0|15] ""  IFV
 SG_ CAN_FL_DET_CLASS_163 : 351|4@0+ (1,0) [0|15] ""  IFV
 SG_ CAN_FL_DET_RANGE_164 : 367|14@0+ (0.015625,0) [0|255.984375] "m"  IFV
 SG_ CAN_FL_DET_SD_RANGE_164 : 369|6@0+ (0.025,0) [0|1.5] "m"  IFV
 SG_ CAN_FL_DET_RANGE_RATE_164 : 379|14@0+ (0.015625,-128) [-128|127.984375] "m/s"  IFV
 SG_ CAN_FL_DET_SD_RANGE_RATE_164 : 397|6@0+ (0.02,0) [0|1.2] "m/s"  IFV
 SG_ CAN_FL_DET_AZIMUTH_164 : 407|13@0+ (0.0007668,-3.141593) [-3.141593|3.141593] "rad"  IFV
 SG_ CAN_FL_DET_SD_AZIMUTH_164 : 410|6@0+ (0.001745329,0) [0|0.104719755] "rad"  IFV
 SG_ CAN_FL_DET_ELEVATION_164 : 420|7@0+ (0.157449,-9.99812) [-9.99812|9.997903] "deg"  IFV
 SG_ CAN_FL_DET_SD_ELEVATION_164 : 429|6@0+ (0.003490659,0) [0|0.20943951] "rad"  IFV
 SG_ CAN_FL_DET_AMPLITUDE_164 : 439|7@0+ (1,-64) [-64|63] "dBsm"  IFV
 SG_ CAN_FL_DET_VALID_FLAG_164 : 432|1@0+ (1,0) [0|1] ""  IFV
 SG_ CAN_FL_DET_SUPER_RES_164 : 440|1@0+ (1,0) [0|1] ""  IFV
 SG_ CAN_FL_DET_LOW_SNR_FLAG_164 : 441|1@0+ (1,0) [0|1] ""  IFV
 SG_ CAN_FL_DET_MIXER_BIAS_FLAG_164 : 442|1@0+ (1,0) [0|1] ""  IFV
 SG_ CAN_FL_DET_RESERVED_FLAGS_164 : 447|5@0+ (1,0) [0|31] ""  IFV
 SG_ CAN_FL_DET_SNR_164 : 455|8@0+ (0.35156,0) [0|89.6478] "dB"  IFV
 SG_ CAN_FL_DET_MULTI_TARGET_PROB_164 : 459|4@0+ (0.06667,0) [0|1] ""  IFV
 SG_ CAN_FL_DET_CONFID_AZIMUTH_164 : 461|2@0+ (1,0) [0|3] ""  IFV
 SG_ CAN_FL_DET_CONFID_ELEVATION_164 : 463|2@0+ (1,0) [0|3] ""  IFV
 SG_ CAN_FL_DET_EXISTENCE_PROB_164 : 467|4@0+ (1,0) [0|15] ""  IFV
 SG_ CAN_FL_DET_CLASS_164 : 471|4@0+ (1,0) [0|15] ""  IFV

BO_ 809 SODFL_DETECTION_165_168: 64 SODFL
 SG_ CAN_FL_DET_RANGE_165 : 7|14@0+ (0.015625,0) [0|255.984375] "m"  IFV
 SG_ CAN_FL_DET_SD_RANGE_165 : 9|6@0+ (0.025,0) [0|1.5] "m"  IFV
 SG_ CAN_FL_DET_RANGE_RATE_165 : 19|14@0+ (0.015625,-128) [-128|127.984375] "m/s"  IFV
 SG_ CAN_FL_DET_SD_RANGE_RATE_165 : 37|6@0+ (0.02,0) [0|1.2] "m/s"  IFV
 SG_ CAN_FL_DET_AZIMUTH_165 : 47|13@0+ (0.0007668,-3.141593) [-3.141593|3.141593] "rad"  IFV
 SG_ CAN_FL_DET_SD_AZIMUTH_165 : 50|6@0+ (0.001745329,0) [0|0.104719755] "rad"  IFV
 SG_ CAN_FL_DET_ELEVATION_165 : 60|7@0+ (0.157449,-9.99812) [-9.99812|9.997903] "deg"  IFV
 SG_ CAN_FL_DET_SD_ELEVATION_165 : 69|6@0+ (0.003490659,0) [0|0.20943951] "rad"  IFV
 SG_ CAN_FL_DET_AMPLITUDE_165 : 79|7@0+ (1,-64) [-64|63] "dBsm"  IFV
 SG_ CAN_FL_DET_VALID_FLAG_165 : 72|1@0+ (1,0) [0|1] ""  IFV
 SG_ CAN_FL_DET_SUPER_RES_165 : 80|1@0+ (1,0) [0|1] ""  IFV
 SG_ CAN_FL_DET_LOW_SNR_FLAG_165 : 81|1@0+ (1,0) [0|1] ""  IFV
 SG_ CAN_FL_DET_MIXER_BIAS_FLAG_165 : 82|1@0+ (1,0) [0|1] ""  IFV
 SG_ CAN_FL_DET_RESERVED_FLAGS_165 : 87|5@0+ (1,0) [0|31] ""  IFV
 SG_ CAN_FL_DET_SNR_165 : 95|8@0+ (0.35156,0) [0|89.6478] "dB"  IFV
 SG_ CAN_FL_DET_MULTI_TARGET_PROB_165 : 99|4@0+ (0.06667,0) [0|1] ""  IFV
 SG_ CAN_FL_DET_CONFID_AZIMUTH_165 : 101|2@0+ (1,0) [0|3] ""  IFV
 SG_ CAN_FL_DET_CONFID_ELEVATION_165 : 103|2@0+ (1,0) [0|3] ""  IFV
 SG_ CAN_FL_DET_EXISTENCE_PROB_165 : 107|4@0+ (1,0) [0|15] ""  IFV
 SG_ CAN_FL_DET_CLASS_165 : 111|4@0+ (1,0) [0|15] ""  IFV
 SG_ CAN_FL_DET_RANGE_166 : 127|14@0+ (0.015625,0) [0|255.984375] "m"  IFV
 SG_ CAN_FL_DET_SD_RANGE_166 : 129|6@0+ (0.025,0) [0|1.5] "m"  IFV
 SG_ CAN_FL_DET_RANGE_RATE_166 : 139|14@0+ (0.015625,-128) [-128|127.984375] "m/s"  IFV
 SG_ CAN_FL_DET_SD_RANGE_RATE_166 : 157|6@0+ (0.02,0) [0|1.2] "m/s"  IFV
 SG_ CAN_FL_DET_AZIMUTH_166 : 167|13@0+ (0.0007668,-3.141593) [-3.141593|3.141593] "rad"  IFV
 SG_ CAN_FL_DET_SD_AZIMUTH_166 : 170|6@0+ (0.001745329,0) [0|0.104719755] "rad"  IFV
 SG_ CAN_FL_DET_ELEVATION_166 : 180|7@0+ (0.157449,-9.99812) [-9.99812|9.997903] "deg"  IFV
 SG_ CAN_FL_DET_SD_ELEVATION_166 : 189|6@0+ (0.003490659,0) [0|0.20943951] "rad"  IFV
 SG_ CAN_FL_DET_AMPLITUDE_166 : 199|7@0+ (1,-64) [-64|63] "dBsm"  IFV
 SG_ CAN_FL_DET_VALID_FLAG_166 : 192|1@0+ (1,0) [0|1] ""  IFV
 SG_ CAN_FL_DET_SUPER_RES_166 : 200|1@0+ (1,0) [0|1] ""  IFV
 SG_ CAN_FL_DET_LOW_SNR_FLAG_166 : 201|1@0+ (1,0) [0|1] ""  IFV
 SG_ CAN_FL_DET_MIXER_BIAS_FLAG_166 : 202|1@0+ (1,0) [0|1] ""  IFV
 SG_ CAN_FL_DET_RESERVED_FLAGS_166 : 207|5@0+ (1,0) [0|31] ""  IFV
 SG_ CAN_FL_DET_SNR_166 : 215|8@0+ (0.35156,0) [0|89.6478] "dB"  IFV
 SG_ CAN_FL_DET_MULTI_TARGET_PROB_166 : 219|4@0+ (0.06667,0) [0|1] ""  IFV
 SG_ CAN_FL_DET_CONFID_AZIMUTH_166 : 221|2@0+ (1,0) [0|3] ""  IFV
 SG_ CAN_FL_DET_CONFID_ELEVATION_166 : 223|2@0+ (1,0) [0|3] ""  IFV
 SG_ CAN_FL_DET_EXISTENCE_PROB_166 : 227|4@0+ (1,0) [0|15] ""  IFV
 SG_ CAN_FL_DET_CLASS_166 : 231|4@0+ (1,0) [0|15] ""  IFV
 SG_ CAN_FL_DET_RANGE_167 : 247|14@0+ (0.015625,0) [0|255.984375] "m"  IFV
 SG_ CAN_FL_DET_SD_RANGE_167 : 249|6@0+ (0.025,0) [0|1.5] "m"  IFV
 SG_ CAN_FL_DET_RANGE_RATE_167 : 259|14@0+ (0.015625,-128) [-128|127.984375] "m/s"  IFV
 SG_ CAN_FL_DET_SD_RANGE_RATE_167 : 277|6@0+ (0.02,0) [0|1.2] "m/s"  IFV
 SG_ CAN_FL_DET_AZIMUTH_167 : 287|13@0+ (0.0007668,-3.141593) [-3.141593|3.141593] "rad"  IFV
 SG_ CAN_FL_DET_SD_AZIMUTH_167 : 290|6@0+ (0.001745329,0) [0|0.104719755] "rad"  IFV
 SG_ CAN_FL_DET_ELEVATION_167 : 300|7@0+ (0.157449,-9.99812) [-9.99812|9.997903] "deg"  IFV
 SG_ CAN_FL_DET_SD_ELEVATION_167 : 309|6@0+ (0.003490659,0) [0|0.20943951] "rad"  IFV
 SG_ CAN_FL_DET_AMPLITUDE_167 : 319|7@0+ (1,-64) [-64|63] "dBsm"  IFV
 SG_ CAN_FL_DET_VALID_FLAG_167 : 312|1@0+ (1,0) [0|1] ""  IFV
 SG_ CAN_FL_DET_SUPER_RES_167 : 320|1@0+ (1,0) [0|1] ""  IFV
 SG_ CAN_FL_DET_LOW_SNR_FLAG_167 : 321|1@0+ (1,0) [0|1] ""  IFV
 SG_ CAN_FL_DET_MIXER_BIAS_FLAG_167 : 322|1@0+ (1,0) [0|1] ""  IFV
 SG_ CAN_FL_DET_RESERVED_FLAGS_167 : 327|5@0+ (1,0) [0|31] ""  IFV
 SG_ CAN_FL_DET_SNR_167 : 335|8@0+ (0.35156,0) [0|89.6478] "dB"  IFV
 SG_ CAN_FL_DET_MULTI_TARGET_PROB_167 : 339|4@0+ (0.06667,0) [0|1] ""  IFV
 SG_ CAN_FL_DET_CONFID_AZIMUTH_167 : 341|2@0+ (1,0) [0|3] ""  IFV
 SG_ CAN_FL_DET_CONFID_ELEVATION_167 : 343|2@0+ (1,0) [0|3] ""  IFV
 SG_ CAN_FL_DET_EXISTENCE_PROB_167 : 347|4@0+ (1,0) [0|15] ""  IFV
 SG_ CAN_FL_DET_CLASS_167 : 351|4@0+ (1,0) [0|15] ""  IFV
 SG_ CAN_FL_DET_RANGE_168 : 367|14@0+ (0.015625,0) [0|255.984375] "m"  IFV
 SG_ CAN_FL_DET_SD_RANGE_168 : 369|6@0+ (0.025,0) [0|1.5] "m"  IFV
 SG_ CAN_FL_DET_RANGE_RATE_168 : 379|14@0+ (0.015625,-128) [-128|127.984375] "m/s"  IFV
 SG_ CAN_FL_DET_SD_RANGE_RATE_168 : 397|6@0+ (0.02,0) [0|1.2] "m/s"  IFV
 SG_ CAN_FL_DET_AZIMUTH_168 : 407|13@0+ (0.0007668,-3.141593) [-3.141593|3.141593] "rad"  IFV
 SG_ CAN_FL_DET_SD_AZIMUTH_168 : 410|6@0+ (0.001745329,0) [0|0.104719755] "rad"  IFV
 SG_ CAN_FL_DET_ELEVATION_168 : 420|7@0+ (0.157449,-9.99812) [-9.99812|9.997903] "deg"  IFV
 SG_ CAN_FL_DET_SD_ELEVATION_168 : 429|6@0+ (0.003490659,0) [0|0.20943951] "rad"  IFV
 SG_ CAN_FL_DET_AMPLITUDE_168 : 439|7@0+ (1,-64) [-64|63] "dBsm"  IFV
 SG_ CAN_FL_DET_VALID_FLAG_168 : 432|1@0+ (1,0) [0|1] ""  IFV
 SG_ CAN_FL_DET_SUPER_RES_168 : 440|1@0+ (1,0) [0|1] ""  IFV
 SG_ CAN_FL_DET_LOW_SNR_FLAG_168 : 441|1@0+ (1,0) [0|1] ""  IFV
 SG_ CAN_FL_DET_MIXER_BIAS_FLAG_168 : 442|1@0+ (1,0) [0|1] ""  IFV
 SG_ CAN_FL_DET_RESERVED_FLAGS_168 : 447|5@0+ (1,0) [0|31] ""  IFV
 SG_ CAN_FL_DET_SNR_168 : 455|8@0+ (0.35156,0) [0|89.6478] "dB"  IFV
 SG_ CAN_FL_DET_MULTI_TARGET_PROB_168 : 459|4@0+ (0.06667,0) [0|1] ""  IFV
 SG_ CAN_FL_DET_CONFID_AZIMUTH_168 : 461|2@0+ (1,0) [0|3] ""  IFV
 SG_ CAN_FL_DET_CONFID_ELEVATION_168 : 463|2@0+ (1,0) [0|3] ""  IFV
 SG_ CAN_FL_DET_EXISTENCE_PROB_168 : 467|4@0+ (1,0) [0|15] ""  IFV
 SG_ CAN_FL_DET_CLASS_168 : 471|4@0+ (1,0) [0|15] ""  IFV

BO_ 810 SODFL_DETECTION_169_172: 64 SODFL
 SG_ CAN_FL_DET_RANGE_169 : 7|14@0+ (0.015625,0) [0|255.984375] "m"  IFV
 SG_ CAN_FL_DET_SD_RANGE_169 : 9|6@0+ (0.025,0) [0|1.5] "m"  IFV
 SG_ CAN_FL_DET_RANGE_RATE_169 : 19|14@0+ (0.015625,-128) [-128|127.984375] "m/s"  IFV
 SG_ CAN_FL_DET_SD_RANGE_RATE_169 : 37|6@0+ (0.02,0) [0|1.2] "m/s"  IFV
 SG_ CAN_FL_DET_AZIMUTH_169 : 47|13@0+ (0.0007668,-3.141593) [-3.141593|3.141593] "rad"  IFV
 SG_ CAN_FL_DET_SD_AZIMUTH_169 : 50|6@0+ (0.001745329,0) [0|0.104719755] "rad"  IFV
 SG_ CAN_FL_DET_ELEVATION_169 : 60|7@0+ (0.157449,-9.99812) [-9.99812|9.997903] "deg"  IFV
 SG_ CAN_FL_DET_SD_ELEVATION_169 : 69|6@0+ (0.003490659,0) [0|0.20943951] "rad"  IFV
 SG_ CAN_FL_DET_AMPLITUDE_169 : 79|7@0+ (1,-64) [-64|63] "dBsm"  IFV
 SG_ CAN_FL_DET_VALID_FLAG_169 : 72|1@0+ (1,0) [0|1] ""  IFV
 SG_ CAN_FL_DET_SUPER_RES_169 : 80|1@0+ (1,0) [0|1] ""  IFV
 SG_ CAN_FL_DET_LOW_SNR_FLAG_169 : 81|1@0+ (1,0) [0|1] ""  IFV
 SG_ CAN_FL_DET_MIXER_BIAS_FLAG_169 : 82|1@0+ (1,0) [0|1] ""  IFV
 SG_ CAN_FL_DET_RESERVED_FLAGS_169 : 87|5@0+ (1,0) [0|31] ""  IFV
 SG_ CAN_FL_DET_SNR_169 : 95|8@0+ (0.35156,0) [0|89.6478] "dB"  IFV
 SG_ CAN_FL_DET_MULTI_TARGET_PROB_169 : 99|4@0+ (0.06667,0) [0|1] ""  IFV
 SG_ CAN_FL_DET_CONFID_AZIMUTH_169 : 101|2@0+ (1,0) [0|3] ""  IFV
 SG_ CAN_FL_DET_CONFID_ELEVATION_169 : 103|2@0+ (1,0) [0|3] ""  IFV
 SG_ CAN_FL_DET_EXISTENCE_PROB_169 : 107|4@0+ (1,0) [0|15] ""  IFV
 SG_ CAN_FL_DET_CLASS_169 : 111|4@0+ (1,0) [0|15] ""  IFV
 SG_ CAN_FL_DET_RANGE_170 : 127|14@0+ (0.015625,0) [0|255.984375] "m"  IFV
 SG_ CAN_FL_DET_SD_RANGE_170 : 129|6@0+ (0.025,0) [0|1.5] "m"  IFV
 SG_ CAN_FL_DET_RANGE_RATE_170 : 139|14@0+ (0.015625,-128) [-128|127.984375] "m/s"  IFV
 SG_ CAN_FL_DET_SD_RANGE_RATE_170 : 157|6@0+ (0.02,0) [0|1.2] "m/s"  IFV
 SG_ CAN_FL_DET_AZIMUTH_170 : 167|13@0+ (0.0007668,-3.141593) [-3.141593|3.141593] "rad"  IFV
 SG_ CAN_FL_DET_SD_AZIMUTH_170 : 170|6@0+ (0.001745329,0) [0|0.104719755] "rad"  IFV
 SG_ CAN_FL_DET_ELEVATION_170 : 180|7@0+ (0.157449,-9.99812) [-9.99812|9.997903] "deg"  IFV
 SG_ CAN_FL_DET_SD_ELEVATION_170 : 189|6@0+ (0.003490659,0) [0|0.20943951] "rad"  IFV
 SG_ CAN_FL_DET_AMPLITUDE_170 : 199|7@0+ (1,-64) [-64|63] "dBsm"  IFV
 SG_ CAN_FL_DET_VALID_FLAG_170 : 192|1@0+ (1,0) [0|1] ""  IFV
 SG_ CAN_FL_DET_SUPER_RES_170 : 200|1@0+ (1,0) [0|1] ""  IFV
 SG_ CAN_FL_DET_LOW_SNR_FLAG_170 : 201|1@0+ (1,0) [0|1] ""  IFV
 SG_ CAN_FL_DET_MIXER_BIAS_FLAG_170 : 202|1@0+ (1,0) [0|1] ""  IFV
 SG_ CAN_FL_DET_RESERVED_FLAGS_170 : 207|5@0+ (1,0) [0|31] ""  IFV
 SG_ CAN_FL_DET_SNR_170 : 215|8@0+ (0.35156,0) [0|89.6478] "dB"  IFV
 SG_ CAN_FL_DET_MULTI_TARGET_PROB_170 : 219|4@0+ (0.06667,0) [0|1] ""  IFV
 SG_ CAN_FL_DET_CONFID_AZIMUTH_170 : 221|2@0+ (1,0) [0|3] ""  IFV
 SG_ CAN_FL_DET_CONFID_ELEVATION_170 : 223|2@0+ (1,0) [0|3] ""  IFV
 SG_ CAN_FL_DET_EXISTENCE_PROB_170 : 227|4@0+ (1,0) [0|15] ""  IFV
 SG_ CAN_FL_DET_CLASS_170 : 231|4@0+ (1,0) [0|15] ""  IFV
 SG_ CAN_FL_DET_RANGE_171 : 247|14@0+ (0.015625,0) [0|255.984375] "m"  IFV
 SG_ CAN_FL_DET_SD_RANGE_171 : 249|6@0+ (0.025,0) [0|1.5] "m"  IFV
 SG_ CAN_FL_DET_RANGE_RATE_171 : 259|14@0+ (0.015625,-128) [-128|127.984375] "m/s"  IFV
 SG_ CAN_FL_DET_SD_RANGE_RATE_171 : 277|6@0+ (0.02,0) [0|1.2] "m/s"  IFV
 SG_ CAN_FL_DET_AZIMUTH_171 : 287|13@0+ (0.0007668,-3.141593) [-3.141593|3.141593] "rad"  IFV
 SG_ CAN_FL_DET_SD_AZIMUTH_171 : 290|6@0+ (0.001745329,0) [0|0.104719755] "rad"  IFV
 SG_ CAN_FL_DET_ELEVATION_171 : 300|7@0+ (0.157449,-9.99812) [-9.99812|9.997903] "deg"  IFV
 SG_ CAN_FL_DET_SD_ELEVATION_171 : 309|6@0+ (0.003490659,0) [0|0.20943951] "rad"  IFV
 SG_ CAN_FL_DET_AMPLITUDE_171 : 319|7@0+ (1,-64) [-64|63] "dBsm"  IFV
 SG_ CAN_FL_DET_VALID_FLAG_171 : 312|1@0+ (1,0) [0|1] ""  IFV
 SG_ CAN_FL_DET_SUPER_RES_171 : 320|1@0+ (1,0) [0|1] ""  IFV
 SG_ CAN_FL_DET_LOW_SNR_FLAG_171 : 321|1@0+ (1,0) [0|1] ""  IFV
 SG_ CAN_FL_DET_MIXER_BIAS_FLAG_171 : 322|1@0+ (1,0) [0|1] ""  IFV
 SG_ CAN_FL_DET_RESERVED_FLAGS_171 : 327|5@0+ (1,0) [0|31] ""  IFV
 SG_ CAN_FL_DET_SNR_171 : 335|8@0+ (0.35156,0) [0|89.6478] "dB"  IFV
 SG_ CAN_FL_DET_MULTI_TARGET_PROB_171 : 339|4@0+ (0.06667,0) [0|1] ""  IFV
 SG_ CAN_FL_DET_CONFID_AZIMUTH_171 : 341|2@0+ (1,0) [0|3] ""  IFV
 SG_ CAN_FL_DET_CONFID_ELEVATION_171 : 343|2@0+ (1,0) [0|3] ""  IFV
 SG_ CAN_FL_DET_EXISTENCE_PROB_171 : 347|4@0+ (1,0) [0|15] ""  IFV
 SG_ CAN_FL_DET_CLASS_171 : 351|4@0+ (1,0) [0|15] ""  IFV
 SG_ CAN_FL_DET_RANGE_172 : 367|14@0+ (0.015625,0) [0|255.984375] "m"  IFV
 SG_ CAN_FL_DET_SD_RANGE_172 : 369|6@0+ (0.025,0) [0|1.5] "m"  IFV
 SG_ CAN_FL_DET_RANGE_RATE_172 : 379|14@0+ (0.015625,-128) [-128|127.984375] "m/s"  IFV
 SG_ CAN_FL_DET_SD_RANGE_RATE_172 : 397|6@0+ (0.02,0) [0|1.2] "m/s"  IFV
 SG_ CAN_FL_DET_AZIMUTH_172 : 407|13@0+ (0.0007668,-3.141593) [-3.141593|3.141593] "rad"  IFV
 SG_ CAN_FL_DET_SD_AZIMUTH_172 : 410|6@0+ (0.001745329,0) [0|0.104719755] "rad"  IFV
 SG_ CAN_FL_DET_ELEVATION_172 : 420|7@0+ (0.157449,-9.99812) [-9.99812|9.997903] "deg"  IFV
 SG_ CAN_FL_DET_SD_ELEVATION_172 : 429|6@0+ (0.003490659,0) [0|0.20943951] "rad"  IFV
 SG_ CAN_FL_DET_AMPLITUDE_172 : 439|7@0+ (1,-64) [-64|63] "dBsm"  IFV
 SG_ CAN_FL_DET_VALID_FLAG_172 : 432|1@0+ (1,0) [0|1] ""  IFV
 SG_ CAN_FL_DET_SUPER_RES_172 : 440|1@0+ (1,0) [0|1] ""  IFV
 SG_ CAN_FL_DET_LOW_SNR_FLAG_172 : 441|1@0+ (1,0) [0|1] ""  IFV
 SG_ CAN_FL_DET_MIXER_BIAS_FLAG_172 : 442|1@0+ (1,0) [0|1] ""  IFV
 SG_ CAN_FL_DET_RESERVED_FLAGS_172 : 447|5@0+ (1,0) [0|31] ""  IFV
 SG_ CAN_FL_DET_SNR_172 : 455|8@0+ (0.35156,0) [0|89.6478] "dB"  IFV
 SG_ CAN_FL_DET_MULTI_TARGET_PROB_172 : 459|4@0+ (0.06667,0) [0|1] ""  IFV
 SG_ CAN_FL_DET_CONFID_AZIMUTH_172 : 461|2@0+ (1,0) [0|3] ""  IFV
 SG_ CAN_FL_DET_CONFID_ELEVATION_172 : 463|2@0+ (1,0) [0|3] ""  IFV
 SG_ CAN_FL_DET_EXISTENCE_PROB_172 : 467|4@0+ (1,0) [0|15] ""  IFV
 SG_ CAN_FL_DET_CLASS_172 : 471|4@0+ (1,0) [0|15] ""  IFV

BO_ 811 SODFL_DETECTION_173_176: 64 SODFL
 SG_ CAN_FL_DET_RANGE_173 : 7|14@0+ (0.015625,0) [0|255.984375] "m"  IFV
 SG_ CAN_FL_DET_SD_RANGE_173 : 9|6@0+ (0.025,0) [0|1.5] "m"  IFV
 SG_ CAN_FL_DET_RANGE_RATE_173 : 19|14@0+ (0.015625,-128) [-128|127.984375] "m/s"  IFV
 SG_ CAN_FL_DET_SD_RANGE_RATE_173 : 37|6@0+ (0.02,0) [0|1.2] "m/s"  IFV
 SG_ CAN_FL_DET_AZIMUTH_173 : 47|13@0+ (0.0007668,-3.141593) [-3.141593|3.141593] "rad"  IFV
 SG_ CAN_FL_DET_SD_AZIMUTH_173 : 50|6@0+ (0.001745329,0) [0|0.104719755] "rad"  IFV
 SG_ CAN_FL_DET_ELEVATION_173 : 60|7@0+ (0.157449,-9.99812) [-9.99812|9.997903] "deg"  IFV
 SG_ CAN_FL_DET_SD_ELEVATION_173 : 69|6@0+ (0.003490659,0) [0|0.20943951] "rad"  IFV
 SG_ CAN_FL_DET_AMPLITUDE_173 : 79|7@0+ (1,-64) [-64|63] "dBsm"  IFV
 SG_ CAN_FL_DET_VALID_FLAG_173 : 72|1@0+ (1,0) [0|1] ""  IFV
 SG_ CAN_FL_DET_SUPER_RES_173 : 80|1@0+ (1,0) [0|1] ""  IFV
 SG_ CAN_FL_DET_LOW_SNR_FLAG_173 : 81|1@0+ (1,0) [0|1] ""  IFV
 SG_ CAN_FL_DET_MIXER_BIAS_FLAG_173 : 82|1@0+ (1,0) [0|1] ""  IFV
 SG_ CAN_FL_DET_RESERVED_FLAGS_173 : 87|5@0+ (1,0) [0|31] ""  IFV
 SG_ CAN_FL_DET_SNR_173 : 95|8@0+ (0.35156,0) [0|89.6478] "dB"  IFV
 SG_ CAN_FL_DET_MULTI_TARGET_PROB_173 : 99|4@0+ (0.06667,0) [0|1] ""  IFV
 SG_ CAN_FL_DET_CONFID_AZIMUTH_173 : 101|2@0+ (1,0) [0|3] ""  IFV
 SG_ CAN_FL_DET_CONFID_ELEVATION_173 : 103|2@0+ (1,0) [0|3] ""  IFV
 SG_ CAN_FL_DET_EXISTENCE_PROB_173 : 107|4@0+ (1,0) [0|15] ""  IFV
 SG_ CAN_FL_DET_CLASS_173 : 111|4@0+ (1,0) [0|15] ""  IFV
 SG_ CAN_FL_DET_RANGE_174 : 127|14@0+ (0.015625,0) [0|255.984375] "m"  IFV
 SG_ CAN_FL_DET_SD_RANGE_174 : 129|6@0+ (0.025,0) [0|1.5] "m"  IFV
 SG_ CAN_FL_DET_RANGE_RATE_174 : 139|14@0+ (0.015625,-128) [-128|127.984375] "m/s"  IFV
 SG_ CAN_FL_DET_SD_RANGE_RATE_174 : 157|6@0+ (0.02,0) [0|1.2] "m/s"  IFV
 SG_ CAN_FL_DET_AZIMUTH_174 : 167|13@0+ (0.0007668,-3.141593) [-3.141593|3.141593] "rad"  IFV
 SG_ CAN_FL_DET_SD_AZIMUTH_174 : 170|6@0+ (0.001745329,0) [0|0.104719755] "rad"  IFV
 SG_ CAN_FL_DET_ELEVATION_174 : 180|7@0+ (0.157449,-9.99812) [-9.99812|9.997903] "deg"  IFV
 SG_ CAN_FL_DET_SD_ELEVATION_174 : 189|6@0+ (0.003490659,0) [0|0.20943951] "rad"  IFV
 SG_ CAN_FL_DET_AMPLITUDE_174 : 199|7@0+ (1,-64) [-64|63] "dBsm"  IFV
 SG_ CAN_FL_DET_VALID_FLAG_174 : 192|1@0+ (1,0) [0|1] ""  IFV
 SG_ CAN_FL_DET_SUPER_RES_174 : 200|1@0+ (1,0) [0|1] ""  IFV
 SG_ CAN_FL_DET_LOW_SNR_FLAG_174 : 201|1@0+ (1,0) [0|1] ""  IFV
 SG_ CAN_FL_DET_MIXER_BIAS_FLAG_174 : 202|1@0+ (1,0) [0|1] ""  IFV
 SG_ CAN_FL_DET_RESERVED_FLAGS_174 : 207|5@0+ (1,0) [0|31] ""  IFV
 SG_ CAN_FL_DET_SNR_174 : 215|8@0+ (0.35156,0) [0|89.6478] "dB"  IFV
 SG_ CAN_FL_DET_MULTI_TARGET_PROB_174 : 219|4@0+ (0.06667,0) [0|1] ""  IFV
 SG_ CAN_FL_DET_CONFID_AZIMUTH_174 : 221|2@0+ (1,0) [0|3] ""  IFV
 SG_ CAN_FL_DET_CONFID_ELEVATION_174 : 223|2@0+ (1,0) [0|3] ""  IFV
 SG_ CAN_FL_DET_EXISTENCE_PROB_174 : 227|4@0+ (1,0) [0|15] ""  IFV
 SG_ CAN_FL_DET_CLASS_174 : 231|4@0+ (1,0) [0|15] ""  IFV
 SG_ CAN_FL_DET_RANGE_175 : 247|14@0+ (0.015625,0) [0|255.984375] "m"  IFV
 SG_ CAN_FL_DET_SD_RANGE_175 : 249|6@0+ (0.025,0) [0|1.5] "m"  IFV
 SG_ CAN_FL_DET_RANGE_RATE_175 : 259|14@0+ (0.015625,-128) [-128|127.984375] "m/s"  IFV
 SG_ CAN_FL_DET_SD_RANGE_RATE_175 : 277|6@0+ (0.02,0) [0|1.2] "m/s"  IFV
 SG_ CAN_FL_DET_AZIMUTH_175 : 287|13@0+ (0.0007668,-3.141593) [-3.141593|3.141593] "rad"  IFV
 SG_ CAN_FL_DET_SD_AZIMUTH_175 : 290|6@0+ (0.001745329,0) [0|0.104719755] "rad"  IFV
 SG_ CAN_FL_DET_ELEVATION_175 : 300|7@0+ (0.157449,-9.99812) [-9.99812|9.997903] "deg"  IFV
 SG_ CAN_FL_DET_SD_ELEVATION_175 : 309|6@0+ (0.003490659,0) [0|0.20943951] "rad"  IFV
 SG_ CAN_FL_DET_AMPLITUDE_175 : 319|7@0+ (1,-64) [-64|63] "dBsm"  IFV
 SG_ CAN_FL_DET_VALID_FLAG_175 : 312|1@0+ (1,0) [0|1] ""  IFV
 SG_ CAN_FL_DET_SUPER_RES_175 : 320|1@0+ (1,0) [0|1] ""  IFV
 SG_ CAN_FL_DET_LOW_SNR_FLAG_175 : 321|1@0+ (1,0) [0|1] ""  IFV
 SG_ CAN_FL_DET_MIXER_BIAS_FLAG_175 : 322|1@0+ (1,0) [0|1] ""  IFV
 SG_ CAN_FL_DET_RESERVED_FLAGS_175 : 327|5@0+ (1,0) [0|31] ""  IFV
 SG_ CAN_FL_DET_SNR_175 : 335|8@0+ (0.35156,0) [0|89.6478] "dB"  IFV
 SG_ CAN_FL_DET_MULTI_TARGET_PROB_175 : 339|4@0+ (0.06667,0) [0|1] ""  IFV
 SG_ CAN_FL_DET_CONFID_AZIMUTH_175 : 341|2@0+ (1,0) [0|3] ""  IFV
 SG_ CAN_FL_DET_CONFID_ELEVATION_175 : 343|2@0+ (1,0) [0|3] ""  IFV
 SG_ CAN_FL_DET_EXISTENCE_PROB_175 : 347|4@0+ (1,0) [0|15] ""  IFV
 SG_ CAN_FL_DET_CLASS_175 : 351|4@0+ (1,0) [0|15] ""  IFV
 SG_ CAN_FL_DET_RANGE_176 : 367|14@0+ (0.015625,0) [0|255.984375] "m"  IFV
 SG_ CAN_FL_DET_SD_RANGE_176 : 369|6@0+ (0.025,0) [0|1.5] "m"  IFV
 SG_ CAN_FL_DET_RANGE_RATE_176 : 379|14@0+ (0.015625,-128) [-128|127.984375] "m/s"  IFV
 SG_ CAN_FL_DET_SD_RANGE_RATE_176 : 397|6@0+ (0.02,0) [0|1.2] "m/s"  IFV
 SG_ CAN_FL_DET_AZIMUTH_176 : 407|13@0+ (0.0007668,-3.141593) [-3.141593|3.141593] "rad"  IFV
 SG_ CAN_FL_DET_SD_AZIMUTH_176 : 410|6@0+ (0.001745329,0) [0|0.104719755] "rad"  IFV
 SG_ CAN_FL_DET_ELEVATION_176 : 420|7@0+ (0.157449,-9.99812) [-9.99812|9.997903] "deg"  IFV
 SG_ CAN_FL_DET_SD_ELEVATION_176 : 429|6@0+ (0.003490659,0) [0|0.20943951] "rad"  IFV
 SG_ CAN_FL_DET_AMPLITUDE_176 : 439|7@0+ (1,-64) [-64|63] "dBsm"  IFV
 SG_ CAN_FL_DET_VALID_FLAG_176 : 432|1@0+ (1,0) [0|1] ""  IFV
 SG_ CAN_FL_DET_SUPER_RES_176 : 440|1@0+ (1,0) [0|1] ""  IFV
 SG_ CAN_FL_DET_LOW_SNR_FLAG_176 : 441|1@0+ (1,0) [0|1] ""  IFV
 SG_ CAN_FL_DET_MIXER_BIAS_FLAG_176 : 442|1@0+ (1,0) [0|1] ""  IFV
 SG_ CAN_FL_DET_RESERVED_FLAGS_176 : 447|5@0+ (1,0) [0|31] ""  IFV
 SG_ CAN_FL_DET_SNR_176 : 455|8@0+ (0.35156,0) [0|89.6478] "dB"  IFV
 SG_ CAN_FL_DET_MULTI_TARGET_PROB_176 : 459|4@0+ (0.06667,0) [0|1] ""  IFV
 SG_ CAN_FL_DET_CONFID_AZIMUTH_176 : 461|2@0+ (1,0) [0|3] ""  IFV
 SG_ CAN_FL_DET_CONFID_ELEVATION_176 : 463|2@0+ (1,0) [0|3] ""  IFV
 SG_ CAN_FL_DET_EXISTENCE_PROB_176 : 467|4@0+ (1,0) [0|15] ""  IFV
 SG_ CAN_FL_DET_CLASS_176 : 471|4@0+ (1,0) [0|15] ""  IFV

BO_ 812 SODFL_DETECTION_177_180: 64 SODFL
 SG_ CAN_FL_DET_RANGE_177 : 7|14@0+ (0.015625,0) [0|255.984375] "m"  IFV
 SG_ CAN_FL_DET_SD_RANGE_177 : 9|6@0+ (0.025,0) [0|1.5] "m"  IFV
 SG_ CAN_FL_DET_RANGE_RATE_177 : 19|14@0+ (0.015625,-128) [-128|127.984375] "m/s"  IFV
 SG_ CAN_FL_DET_SD_RANGE_RATE_177 : 37|6@0+ (0.02,0) [0|1.2] "m/s"  IFV
 SG_ CAN_FL_DET_AZIMUTH_177 : 47|13@0+ (0.0007668,-3.141593) [-3.141593|3.141593] "rad"  IFV
 SG_ CAN_FL_DET_SD_AZIMUTH_177 : 50|6@0+ (0.001745329,0) [0|0.104719755] "rad"  IFV
 SG_ CAN_FL_DET_ELEVATION_177 : 60|7@0+ (0.157449,-9.99812) [-9.99812|9.997903] "deg"  IFV
 SG_ CAN_FL_DET_SD_ELEVATION_177 : 69|6@0+ (0.003490659,0) [0|0.20943951] "rad"  IFV
 SG_ CAN_FL_DET_AMPLITUDE_177 : 79|7@0+ (1,-64) [-64|63] "dBsm"  IFV
 SG_ CAN_FL_DET_VALID_FLAG_177 : 72|1@0+ (1,0) [0|1] ""  IFV
 SG_ CAN_FL_DET_SUPER_RES_177 : 80|1@0+ (1,0) [0|1] ""  IFV
 SG_ CAN_FL_DET_LOW_SNR_FLAG_177 : 81|1@0+ (1,0) [0|1] ""  IFV
 SG_ CAN_FL_DET_MIXER_BIAS_FLAG_177 : 82|1@0+ (1,0) [0|1] ""  IFV
 SG_ CAN_FL_DET_RESERVED_FLAGS_177 : 87|5@0+ (1,0) [0|31] ""  IFV
 SG_ CAN_FL_DET_SNR_177 : 95|8@0+ (0.35156,0) [0|89.6478] "dB"  IFV
 SG_ CAN_FL_DET_MULTI_TARGET_PROB_177 : 99|4@0+ (0.06667,0) [0|1] ""  IFV
 SG_ CAN_FL_DET_CONFID_AZIMUTH_177 : 101|2@0+ (1,0) [0|3] ""  IFV
 SG_ CAN_FL_DET_CONFID_ELEVATION_177 : 103|2@0+ (1,0) [0|3] ""  IFV
 SG_ CAN_FL_DET_EXISTENCE_PROB_177 : 107|4@0+ (1,0) [0|15] ""  IFV
 SG_ CAN_FL_DET_CLASS_177 : 111|4@0+ (1,0) [0|15] ""  IFV
 SG_ CAN_FL_DET_RANGE_178 : 127|14@0+ (0.015625,0) [0|255.984375] "m"  IFV
 SG_ CAN_FL_DET_SD_RANGE_178 : 129|6@0+ (0.025,0) [0|1.5] "m"  IFV
 SG_ CAN_FL_DET_RANGE_RATE_178 : 139|14@0+ (0.015625,-128) [-128|127.984375] "m/s"  IFV
 SG_ CAN_FL_DET_SD_RANGE_RATE_178 : 157|6@0+ (0.02,0) [0|1.2] "m/s"  IFV
 SG_ CAN_FL_DET_AZIMUTH_178 : 167|13@0+ (0.0007668,-3.141593) [-3.141593|3.141593] "rad"  IFV
 SG_ CAN_FL_DET_SD_AZIMUTH_178 : 170|6@0+ (0.001745329,0) [0|0.104719755] "rad"  IFV
 SG_ CAN_FL_DET_ELEVATION_178 : 180|7@0+ (0.157449,-9.99812) [-9.99812|9.997903] "deg"  IFV
 SG_ CAN_FL_DET_SD_ELEVATION_178 : 189|6@0+ (0.003490659,0) [0|0.20943951] "rad"  IFV
 SG_ CAN_FL_DET_AMPLITUDE_178 : 199|7@0+ (1,-64) [-64|63] "dBsm"  IFV
 SG_ CAN_FL_DET_VALID_FLAG_178 : 192|1@0+ (1,0) [0|1] ""  IFV
 SG_ CAN_FL_DET_SUPER_RES_178 : 200|1@0+ (1,0) [0|1] ""  IFV
 SG_ CAN_FL_DET_LOW_SNR_FLAG_178 : 201|1@0+ (1,0) [0|1] ""  IFV
 SG_ CAN_FL_DET_MIXER_BIAS_FLAG_178 : 202|1@0+ (1,0) [0|1] ""  IFV
 SG_ CAN_FL_DET_RESERVED_FLAGS_178 : 207|5@0+ (1,0) [0|31] ""  IFV
 SG_ CAN_FL_DET_SNR_178 : 215|8@0+ (0.35156,0) [0|89.6478] "dB"  IFV
 SG_ CAN_FL_DET_MULTI_TARGET_PROB_178 : 219|4@0+ (0.06667,0) [0|1] ""  IFV
 SG_ CAN_FL_DET_CONFID_AZIMUTH_178 : 221|2@0+ (1,0) [0|3] ""  IFV
 SG_ CAN_FL_DET_CONFID_ELEVATION_178 : 223|2@0+ (1,0) [0|3] ""  IFV
 SG_ CAN_FL_DET_EXISTENCE_PROB_178 : 227|4@0+ (1,0) [0|15] ""  IFV
 SG_ CAN_FL_DET_CLASS_178 : 231|4@0+ (1,0) [0|15] ""  IFV
 SG_ CAN_FL_DET_RANGE_179 : 247|14@0+ (0.015625,0) [0|255.984375] "m"  IFV
 SG_ CAN_FL_DET_SD_RANGE_179 : 249|6@0+ (0.025,0) [0|1.5] "m"  IFV
 SG_ CAN_FL_DET_RANGE_RATE_179 : 259|14@0+ (0.015625,-128) [-128|127.984375] "m/s"  IFV
 SG_ CAN_FL_DET_SD_RANGE_RATE_179 : 277|6@0+ (0.02,0) [0|1.2] "m/s"  IFV
 SG_ CAN_FL_DET_AZIMUTH_179 : 287|13@0+ (0.0007668,-3.141593) [-3.141593|3.141593] "rad"  IFV
 SG_ CAN_FL_DET_SD_AZIMUTH_179 : 290|6@0+ (0.001745329,0) [0|0.104719755] "rad"  IFV
 SG_ CAN_FL_DET_ELEVATION_179 : 300|7@0+ (0.157449,-9.99812) [-9.99812|9.997903] "deg"  IFV
 SG_ CAN_FL_DET_SD_ELEVATION_179 : 309|6@0+ (0.003490659,0) [0|0.20943951] "rad"  IFV
 SG_ CAN_FL_DET_AMPLITUDE_179 : 319|7@0+ (1,-64) [-64|63] "dBsm"  IFV
 SG_ CAN_FL_DET_VALID_FLAG_179 : 312|1@0+ (1,0) [0|1] ""  IFV
 SG_ CAN_FL_DET_SUPER_RES_179 : 320|1@0+ (1,0) [0|1] ""  IFV
 SG_ CAN_FL_DET_LOW_SNR_FLAG_179 : 321|1@0+ (1,0) [0|1] ""  IFV
 SG_ CAN_FL_DET_MIXER_BIAS_FLAG_179 : 322|1@0+ (1,0) [0|1] ""  IFV
 SG_ CAN_FL_DET_RESERVED_FLAGS_179 : 327|5@0+ (1,0) [0|31] ""  IFV
 SG_ CAN_FL_DET_SNR_179 : 335|8@0+ (0.35156,0) [0|89.6478] "dB"  IFV
 SG_ CAN_FL_DET_MULTI_TARGET_PROB_179 : 339|4@0+ (0.06667,0) [0|1] ""  IFV
 SG_ CAN_FL_DET_CONFID_AZIMUTH_179 : 341|2@0+ (1,0) [0|3] ""  IFV
 SG_ CAN_FL_DET_CONFID_ELEVATION_179 : 343|2@0+ (1,0) [0|3] ""  IFV
 SG_ CAN_FL_DET_EXISTENCE_PROB_179 : 347|4@0+ (1,0) [0|15] ""  IFV
 SG_ CAN_FL_DET_CLASS_179 : 351|4@0+ (1,0) [0|15] ""  IFV
 SG_ CAN_FL_DET_RANGE_180 : 367|14@0+ (0.015625,0) [0|255.984375] "m"  IFV
 SG_ CAN_FL_DET_SD_RANGE_180 : 369|6@0+ (0.025,0) [0|1.5] "m"  IFV
 SG_ CAN_FL_DET_RANGE_RATE_180 : 379|14@0+ (0.015625,-128) [-128|127.984375] "m/s"  IFV
 SG_ CAN_FL_DET_SD_RANGE_RATE_180 : 397|6@0+ (0.02,0) [0|1.2] "m/s"  IFV
 SG_ CAN_FL_DET_AZIMUTH_180 : 407|13@0+ (0.0007668,-3.141593) [-3.141593|3.141593] "rad"  IFV
 SG_ CAN_FL_DET_SD_AZIMUTH_180 : 410|6@0+ (0.001745329,0) [0|0.104719755] "rad"  IFV
 SG_ CAN_FL_DET_ELEVATION_180 : 420|7@0+ (0.157449,-9.99812) [-9.99812|9.997903] "deg"  IFV
 SG_ CAN_FL_DET_SD_ELEVATION_180 : 429|6@0+ (0.003490659,0) [0|0.20943951] "rad"  IFV
 SG_ CAN_FL_DET_AMPLITUDE_180 : 439|7@0+ (1,-64) [-64|63] "dBsm"  IFV
 SG_ CAN_FL_DET_VALID_FLAG_180 : 432|1@0+ (1,0) [0|1] ""  IFV
 SG_ CAN_FL_DET_SUPER_RES_180 : 440|1@0+ (1,0) [0|1] ""  IFV
 SG_ CAN_FL_DET_LOW_SNR_FLAG_180 : 441|1@0+ (1,0) [0|1] ""  IFV
 SG_ CAN_FL_DET_MIXER_BIAS_FLAG_180 : 442|1@0+ (1,0) [0|1] ""  IFV
 SG_ CAN_FL_DET_RESERVED_FLAGS_180 : 447|5@0+ (1,0) [0|31] ""  IFV
 SG_ CAN_FL_DET_SNR_180 : 455|8@0+ (0.35156,0) [0|89.6478] "dB"  IFV
 SG_ CAN_FL_DET_MULTI_TARGET_PROB_180 : 459|4@0+ (0.06667,0) [0|1] ""  IFV
 SG_ CAN_FL_DET_CONFID_AZIMUTH_180 : 461|2@0+ (1,0) [0|3] ""  IFV
 SG_ CAN_FL_DET_CONFID_ELEVATION_180 : 463|2@0+ (1,0) [0|3] ""  IFV
 SG_ CAN_FL_DET_EXISTENCE_PROB_180 : 467|4@0+ (1,0) [0|15] ""  IFV
 SG_ CAN_FL_DET_CLASS_180 : 471|4@0+ (1,0) [0|15] ""  IFV

BO_ 813 SODFL_DETECTION_181_184: 64 SODFL
 SG_ CAN_FL_DET_RANGE_181 : 7|14@0+ (0.015625,0) [0|255.984375] "m"  IFV
 SG_ CAN_FL_DET_SD_RANGE_181 : 9|6@0+ (0.025,0) [0|1.5] "m"  IFV
 SG_ CAN_FL_DET_RANGE_RATE_181 : 19|14@0+ (0.015625,-128) [-128|127.984375] "m/s"  IFV
 SG_ CAN_FL_DET_SD_RANGE_RATE_181 : 37|6@0+ (0.02,0) [0|1.2] "m/s"  IFV
 SG_ CAN_FL_DET_AZIMUTH_181 : 47|13@0+ (0.0007668,-3.141593) [-3.141593|3.141593] "rad"  IFV
 SG_ CAN_FL_DET_SD_AZIMUTH_181 : 50|6@0+ (0.001745329,0) [0|0.104719755] "rad"  IFV
 SG_ CAN_FL_DET_ELEVATION_181 : 60|7@0+ (0.157449,-9.99812) [-9.99812|9.997903] "deg"  IFV
 SG_ CAN_FL_DET_SD_ELEVATION_181 : 69|6@0+ (0.003490659,0) [0|0.20943951] "rad"  IFV
 SG_ CAN_FL_DET_AMPLITUDE_181 : 79|7@0+ (1,-64) [-64|63] "dBsm"  IFV
 SG_ CAN_FL_DET_VALID_FLAG_181 : 72|1@0+ (1,0) [0|1] ""  IFV
 SG_ CAN_FL_DET_SUPER_RES_181 : 80|1@0+ (1,0) [0|1] ""  IFV
 SG_ CAN_FL_DET_LOW_SNR_FLAG_181 : 81|1@0+ (1,0) [0|1] ""  IFV
 SG_ CAN_FL_DET_MIXER_BIAS_FLAG_181 : 82|1@0+ (1,0) [0|1] ""  IFV
 SG_ CAN_FL_DET_RESERVED_FLAGS_181 : 87|5@0+ (1,0) [0|31] ""  IFV
 SG_ CAN_FL_DET_SNR_181 : 95|8@0+ (0.35156,0) [0|89.6478] "dB"  IFV
 SG_ CAN_FL_DET_MULTI_TARGET_PROB_181 : 99|4@0+ (0.06667,0) [0|1] ""  IFV
 SG_ CAN_FL_DET_CONFID_AZIMUTH_181 : 101|2@0+ (1,0) [0|3] ""  IFV
 SG_ CAN_FL_DET_CONFID_ELEVATION_181 : 103|2@0+ (1,0) [0|3] ""  IFV
 SG_ CAN_FL_DET_EXISTENCE_PROB_181 : 107|4@0+ (1,0) [0|15] ""  IFV
 SG_ CAN_FL_DET_CLASS_181 : 111|4@0+ (1,0) [0|15] ""  IFV
 SG_ CAN_FL_DET_RANGE_182 : 127|14@0+ (0.015625,0) [0|255.984375] "m"  IFV
 SG_ CAN_FL_DET_SD_RANGE_182 : 129|6@0+ (0.025,0) [0|1.5] "m"  IFV
 SG_ CAN_FL_DET_RANGE_RATE_182 : 139|14@0+ (0.015625,-128) [-128|127.984375] "m/s"  IFV
 SG_ CAN_FL_DET_SD_RANGE_RATE_182 : 157|6@0+ (0.02,0) [0|1.2] "m/s"  IFV
 SG_ CAN_FL_DET_AZIMUTH_182 : 167|13@0+ (0.0007668,-3.141593) [-3.141593|3.141593] "rad"  IFV
 SG_ CAN_FL_DET_SD_AZIMUTH_182 : 170|6@0+ (0.001745329,0) [0|0.104719755] "rad"  IFV
 SG_ CAN_FL_DET_ELEVATION_182 : 180|7@0+ (0.157449,-9.99812) [-9.99812|9.997903] "deg"  IFV
 SG_ CAN_FL_DET_SD_ELEVATION_182 : 189|6@0+ (0.003490659,0) [0|0.20943951] "rad"  IFV
 SG_ CAN_FL_DET_AMPLITUDE_182 : 199|7@0+ (1,-64) [-64|63] "dBsm"  IFV
 SG_ CAN_FL_DET_VALID_FLAG_182 : 192|1@0+ (1,0) [0|1] ""  IFV
 SG_ CAN_FL_DET_SUPER_RES_182 : 200|1@0+ (1,0) [0|1] ""  IFV
 SG_ CAN_FL_DET_LOW_SNR_FLAG_182 : 201|1@0+ (1,0) [0|1] ""  IFV
 SG_ CAN_FL_DET_MIXER_BIAS_FLAG_182 : 202|1@0+ (1,0) [0|1] ""  IFV
 SG_ CAN_FL_DET_RESERVED_FLAGS_182 : 207|5@0+ (1,0) [0|31] ""  IFV
 SG_ CAN_FL_DET_SNR_182 : 215|8@0+ (0.35156,0) [0|89.6478] "dB"  IFV
 SG_ CAN_FL_DET_MULTI_TARGET_PROB_182 : 219|4@0+ (0.06667,0) [0|1] ""  IFV
 SG_ CAN_FL_DET_CONFID_AZIMUTH_182 : 221|2@0+ (1,0) [0|3] ""  IFV
 SG_ CAN_FL_DET_CONFID_ELEVATION_182 : 223|2@0+ (1,0) [0|3] ""  IFV
 SG_ CAN_FL_DET_EXISTENCE_PROB_182 : 227|4@0+ (1,0) [0|15] ""  IFV
 SG_ CAN_FL_DET_CLASS_182 : 231|4@0+ (1,0) [0|15] ""  IFV
 SG_ CAN_FL_DET_RANGE_183 : 247|14@0+ (0.015625,0) [0|255.984375] "m"  IFV
 SG_ CAN_FL_DET_SD_RANGE_183 : 249|6@0+ (0.025,0) [0|1.5] "m"  IFV
 SG_ CAN_FL_DET_RANGE_RATE_183 : 259|14@0+ (0.015625,-128) [-128|127.984375] "m/s"  IFV
 SG_ CAN_FL_DET_SD_RANGE_RATE_183 : 277|6@0+ (0.02,0) [0|1.2] "m/s"  IFV
 SG_ CAN_FL_DET_AZIMUTH_183 : 287|13@0+ (0.0007668,-3.141593) [-3.141593|3.141593] "rad"  IFV
 SG_ CAN_FL_DET_SD_AZIMUTH_183 : 290|6@0+ (0.001745329,0) [0|0.104719755] "rad"  IFV
 SG_ CAN_FL_DET_ELEVATION_183 : 300|7@0+ (0.157449,-9.99812) [-9.99812|9.997903] "deg"  IFV
 SG_ CAN_FL_DET_SD_ELEVATION_183 : 309|6@0+ (0.003490659,0) [0|0.20943951] "rad"  IFV
 SG_ CAN_FL_DET_AMPLITUDE_183 : 319|7@0+ (1,-64) [-64|63] "dBsm"  IFV
 SG_ CAN_FL_DET_VALID_FLAG_183 : 312|1@0+ (1,0) [0|1] ""  IFV
 SG_ CAN_FL_DET_SUPER_RES_183 : 320|1@0+ (1,0) [0|1] ""  IFV
 SG_ CAN_FL_DET_LOW_SNR_FLAG_183 : 321|1@0+ (1,0) [0|1] ""  IFV
 SG_ CAN_FL_DET_MIXER_BIAS_FLAG_183 : 322|1@0+ (1,0) [0|1] ""  IFV
 SG_ CAN_FL_DET_RESERVED_FLAGS_183 : 327|5@0+ (1,0) [0|31] ""  IFV
 SG_ CAN_FL_DET_SNR_183 : 335|8@0+ (0.35156,0) [0|89.6478] "dB"  IFV
 SG_ CAN_FL_DET_MULTI_TARGET_PROB_183 : 339|4@0+ (0.06667,0) [0|1] ""  IFV
 SG_ CAN_FL_DET_CONFID_AZIMUTH_183 : 341|2@0+ (1,0) [0|3] ""  IFV
 SG_ CAN_FL_DET_CONFID_ELEVATION_183 : 343|2@0+ (1,0) [0|3] ""  IFV
 SG_ CAN_FL_DET_EXISTENCE_PROB_183 : 347|4@0+ (1,0) [0|15] ""  IFV
 SG_ CAN_FL_DET_CLASS_183 : 351|4@0+ (1,0) [0|15] ""  IFV
 SG_ CAN_FL_DET_RANGE_184 : 367|14@0+ (0.015625,0) [0|255.984375] "m"  IFV
 SG_ CAN_FL_DET_SD_RANGE_184 : 369|6@0+ (0.025,0) [0|1.5] "m"  IFV
 SG_ CAN_FL_DET_RANGE_RATE_184 : 379|14@0+ (0.015625,-128) [-128|127.984375] "m/s"  IFV
 SG_ CAN_FL_DET_SD_RANGE_RATE_184 : 397|6@0+ (0.02,0) [0|1.2] "m/s"  IFV
 SG_ CAN_FL_DET_AZIMUTH_184 : 407|13@0+ (0.0007668,-3.141593) [-3.141593|3.141593] "rad"  IFV
 SG_ CAN_FL_DET_SD_AZIMUTH_184 : 410|6@0+ (0.001745329,0) [0|0.104719755] "rad"  IFV
 SG_ CAN_FL_DET_ELEVATION_184 : 420|7@0+ (0.157449,-9.99812) [-9.99812|9.997903] "deg"  IFV
 SG_ CAN_FL_DET_SD_ELEVATION_184 : 429|6@0+ (0.003490659,0) [0|0.20943951] "rad"  IFV
 SG_ CAN_FL_DET_AMPLITUDE_184 : 439|7@0+ (1,-64) [-64|63] "dBsm"  IFV
 SG_ CAN_FL_DET_VALID_FLAG_184 : 432|1@0+ (1,0) [0|1] ""  IFV
 SG_ CAN_FL_DET_SUPER_RES_184 : 440|1@0+ (1,0) [0|1] ""  IFV
 SG_ CAN_FL_DET_LOW_SNR_FLAG_184 : 441|1@0+ (1,0) [0|1] ""  IFV
 SG_ CAN_FL_DET_MIXER_BIAS_FLAG_184 : 442|1@0+ (1,0) [0|1] ""  IFV
 SG_ CAN_FL_DET_RESERVED_FLAGS_184 : 447|5@0+ (1,0) [0|31] ""  IFV
 SG_ CAN_FL_DET_SNR_184 : 455|8@0+ (0.35156,0) [0|89.6478] "dB"  IFV
 SG_ CAN_FL_DET_MULTI_TARGET_PROB_184 : 459|4@0+ (0.06667,0) [0|1] ""  IFV
 SG_ CAN_FL_DET_CONFID_AZIMUTH_184 : 461|2@0+ (1,0) [0|3] ""  IFV
 SG_ CAN_FL_DET_CONFID_ELEVATION_184 : 463|2@0+ (1,0) [0|3] ""  IFV
 SG_ CAN_FL_DET_EXISTENCE_PROB_184 : 467|4@0+ (1,0) [0|15] ""  IFV
 SG_ CAN_FL_DET_CLASS_184 : 471|4@0+ (1,0) [0|15] ""  IFV

BO_ 814 SODFL_DETECTION_185_188: 64 SODFL
 SG_ CAN_FL_DET_RANGE_185 : 7|14@0+ (0.015625,0) [0|255.984375] "m"  IFV
 SG_ CAN_FL_DET_SD_RANGE_185 : 9|6@0+ (0.025,0) [0|1.5] "m"  IFV
 SG_ CAN_FL_DET_RANGE_RATE_185 : 19|14@0+ (0.015625,-128) [-128|127.984375] "m/s"  IFV
 SG_ CAN_FL_DET_SD_RANGE_RATE_185 : 37|6@0+ (0.02,0) [0|1.2] "m/s"  IFV
 SG_ CAN_FL_DET_AZIMUTH_185 : 47|13@0+ (0.0007668,-3.141593) [-3.141593|3.141593] "rad"  IFV
 SG_ CAN_FL_DET_SD_AZIMUTH_185 : 50|6@0+ (0.001745329,0) [0|0.104719755] "rad"  IFV
 SG_ CAN_FL_DET_ELEVATION_185 : 60|7@0+ (0.157449,-9.99812) [-9.99812|9.997903] "deg"  IFV
 SG_ CAN_FL_DET_SD_ELEVATION_185 : 69|6@0+ (0.003490659,0) [0|0.20943951] "rad"  IFV
 SG_ CAN_FL_DET_AMPLITUDE_185 : 79|7@0+ (1,-64) [-64|63] "dBsm"  IFV
 SG_ CAN_FL_DET_VALID_FLAG_185 : 72|1@0+ (1,0) [0|1] ""  IFV
 SG_ CAN_FL_DET_SUPER_RES_185 : 80|1@0+ (1,0) [0|1] ""  IFV
 SG_ CAN_FL_DET_LOW_SNR_FLAG_185 : 81|1@0+ (1,0) [0|1] ""  IFV
 SG_ CAN_FL_DET_MIXER_BIAS_FLAG_185 : 82|1@0+ (1,0) [0|1] ""  IFV
 SG_ CAN_FL_DET_RESERVED_FLAGS_185 : 87|5@0+ (1,0) [0|31] ""  IFV
 SG_ CAN_FL_DET_SNR_185 : 95|8@0+ (0.35156,0) [0|89.6478] "dB"  IFV
 SG_ CAN_FL_DET_MULTI_TARGET_PROB_185 : 99|4@0+ (0.06667,0) [0|1] ""  IFV
 SG_ CAN_FL_DET_CONFID_AZIMUTH_185 : 101|2@0+ (1,0) [0|3] ""  IFV
 SG_ CAN_FL_DET_CONFID_ELEVATION_185 : 103|2@0+ (1,0) [0|3] ""  IFV
 SG_ CAN_FL_DET_EXISTENCE_PROB_185 : 107|4@0+ (1,0) [0|15] ""  IFV
 SG_ CAN_FL_DET_CLASS_185 : 111|4@0+ (1,0) [0|15] ""  IFV
 SG_ CAN_FL_DET_RANGE_186 : 127|14@0+ (0.015625,0) [0|255.984375] "m"  IFV
 SG_ CAN_FL_DET_SD_RANGE_186 : 129|6@0+ (0.025,0) [0|1.5] "m"  IFV
 SG_ CAN_FL_DET_RANGE_RATE_186 : 139|14@0+ (0.015625,-128) [-128|127.984375] "m/s"  IFV
 SG_ CAN_FL_DET_SD_RANGE_RATE_186 : 157|6@0+ (0.02,0) [0|1.2] "m/s"  IFV
 SG_ CAN_FL_DET_AZIMUTH_186 : 167|13@0+ (0.0007668,-3.141593) [-3.141593|3.141593] "rad"  IFV
 SG_ CAN_FL_DET_SD_AZIMUTH_186 : 170|6@0+ (0.001745329,0) [0|0.104719755] "rad"  IFV
 SG_ CAN_FL_DET_ELEVATION_186 : 180|7@0+ (0.157449,-9.99812) [-9.99812|9.997903] "deg"  IFV
 SG_ CAN_FL_DET_SD_ELEVATION_186 : 189|6@0+ (0.003490659,0) [0|0.20943951] "rad"  IFV
 SG_ CAN_FL_DET_AMPLITUDE_186 : 199|7@0+ (1,-64) [-64|63] "dBsm"  IFV
 SG_ CAN_FL_DET_VALID_FLAG_186 : 192|1@0+ (1,0) [0|1] ""  IFV
 SG_ CAN_FL_DET_SUPER_RES_186 : 200|1@0+ (1,0) [0|1] ""  IFV
 SG_ CAN_FL_DET_LOW_SNR_FLAG_186 : 201|1@0+ (1,0) [0|1] ""  IFV
 SG_ CAN_FL_DET_MIXER_BIAS_FLAG_186 : 202|1@0+ (1,0) [0|1] ""  IFV
 SG_ CAN_FL_DET_RESERVED_FLAGS_186 : 207|5@0+ (1,0) [0|31] ""  IFV
 SG_ CAN_FL_DET_SNR_186 : 215|8@0+ (0.35156,0) [0|89.6478] "dB"  IFV
 SG_ CAN_FL_DET_MULTI_TARGET_PROB_186 : 219|4@0+ (0.06667,0) [0|1] ""  IFV
 SG_ CAN_FL_DET_CONFID_AZIMUTH_186 : 221|2@0+ (1,0) [0|3] ""  IFV
 SG_ CAN_FL_DET_CONFID_ELEVATION_186 : 223|2@0+ (1,0) [0|3] ""  IFV
 SG_ CAN_FL_DET_EXISTENCE_PROB_186 : 227|4@0+ (1,0) [0|15] ""  IFV
 SG_ CAN_FL_DET_CLASS_186 : 231|4@0+ (1,0) [0|15] ""  IFV
 SG_ CAN_FL_DET_RANGE_187 : 247|14@0+ (0.015625,0) [0|255.984375] "m"  IFV
 SG_ CAN_FL_DET_SD_RANGE_187 : 249|6@0+ (0.025,0) [0|1.5] "m"  IFV
 SG_ CAN_FL_DET_RANGE_RATE_187 : 259|14@0+ (0.015625,-128) [-128|127.984375] "m/s"  IFV
 SG_ CAN_FL_DET_SD_RANGE_RATE_187 : 277|6@0+ (0.02,0) [0|1.2] "m/s"  IFV
 SG_ CAN_FL_DET_AZIMUTH_187 : 287|13@0+ (0.0007668,-3.141593) [-3.141593|3.141593] "rad"  IFV
 SG_ CAN_FL_DET_SD_AZIMUTH_187 : 290|6@0+ (0.001745329,0) [0|0.104719755] "rad"  IFV
 SG_ CAN_FL_DET_ELEVATION_187 : 300|7@0+ (0.157449,-9.99812) [-9.99812|9.997903] "deg"  IFV
 SG_ CAN_FL_DET_SD_ELEVATION_187 : 309|6@0+ (0.003490659,0) [0|0.20943951] "rad"  IFV
 SG_ CAN_FL_DET_AMPLITUDE_187 : 319|7@0+ (1,-64) [-64|63] "dBsm"  IFV
 SG_ CAN_FL_DET_VALID_FLAG_187 : 312|1@0+ (1,0) [0|1] ""  IFV
 SG_ CAN_FL_DET_SUPER_RES_187 : 320|1@0+ (1,0) [0|1] ""  IFV
 SG_ CAN_FL_DET_LOW_SNR_FLAG_187 : 321|1@0+ (1,0) [0|1] ""  IFV
 SG_ CAN_FL_DET_MIXER_BIAS_FLAG_187 : 322|1@0+ (1,0) [0|1] ""  IFV
 SG_ CAN_FL_DET_RESERVED_FLAGS_187 : 327|5@0+ (1,0) [0|31] ""  IFV
 SG_ CAN_FL_DET_SNR_187 : 335|8@0+ (0.35156,0) [0|89.6478] "dB"  IFV
 SG_ CAN_FL_DET_MULTI_TARGET_PROB_187 : 339|4@0+ (0.06667,0) [0|1] ""  IFV
 SG_ CAN_FL_DET_CONFID_AZIMUTH_187 : 341|2@0+ (1,0) [0|3] ""  IFV
 SG_ CAN_FL_DET_CONFID_ELEVATION_187 : 343|2@0+ (1,0) [0|3] ""  IFV
 SG_ CAN_FL_DET_EXISTENCE_PROB_187 : 347|4@0+ (1,0) [0|15] ""  IFV
 SG_ CAN_FL_DET_CLASS_187 : 351|4@0+ (1,0) [0|15] ""  IFV
 SG_ CAN_FL_DET_RANGE_188 : 367|14@0+ (0.015625,0) [0|255.984375] "m"  IFV
 SG_ CAN_FL_DET_SD_RANGE_188 : 369|6@0+ (0.025,0) [0|1.5] "m"  IFV
 SG_ CAN_FL_DET_RANGE_RATE_188 : 379|14@0+ (0.015625,-128) [-128|127.984375] "m/s"  IFV
 SG_ CAN_FL_DET_SD_RANGE_RATE_188 : 397|6@0+ (0.02,0) [0|1.2] "m/s"  IFV
 SG_ CAN_FL_DET_AZIMUTH_188 : 407|13@0+ (0.0007668,-3.141593) [-3.141593|3.141593] "rad"  IFV
 SG_ CAN_FL_DET_SD_AZIMUTH_188 : 410|6@0+ (0.001745329,0) [0|0.104719755] "rad"  IFV
 SG_ CAN_FL_DET_ELEVATION_188 : 420|7@0+ (0.157449,-9.99812) [-9.99812|9.997903] "deg"  IFV
 SG_ CAN_FL_DET_SD_ELEVATION_188 : 429|6@0+ (0.003490659,0) [0|0.20943951] "rad"  IFV
 SG_ CAN_FL_DET_AMPLITUDE_188 : 439|7@0+ (1,-64) [-64|63] "dBsm"  IFV
 SG_ CAN_FL_DET_VALID_FLAG_188 : 432|1@0+ (1,0) [0|1] ""  IFV
 SG_ CAN_FL_DET_SUPER_RES_188 : 440|1@0+ (1,0) [0|1] ""  IFV
 SG_ CAN_FL_DET_LOW_SNR_FLAG_188 : 441|1@0+ (1,0) [0|1] ""  IFV
 SG_ CAN_FL_DET_MIXER_BIAS_FLAG_188 : 442|1@0+ (1,0) [0|1] ""  IFV
 SG_ CAN_FL_DET_RESERVED_FLAGS_188 : 447|5@0+ (1,0) [0|31] ""  IFV
 SG_ CAN_FL_DET_SNR_188 : 455|8@0+ (0.35156,0) [0|89.6478] "dB"  IFV
 SG_ CAN_FL_DET_MULTI_TARGET_PROB_188 : 459|4@0+ (0.06667,0) [0|1] ""  IFV
 SG_ CAN_FL_DET_CONFID_AZIMUTH_188 : 461|2@0+ (1,0) [0|3] ""  IFV
 SG_ CAN_FL_DET_CONFID_ELEVATION_188 : 463|2@0+ (1,0) [0|3] ""  IFV
 SG_ CAN_FL_DET_EXISTENCE_PROB_188 : 467|4@0+ (1,0) [0|15] ""  IFV
 SG_ CAN_FL_DET_CLASS_188 : 471|4@0+ (1,0) [0|15] ""  IFV

BO_ 815 SODFL_DETECTION_189_192: 64 SODFL
 SG_ CAN_FL_DET_RANGE_189 : 7|14@0+ (0.015625,0) [0|255.984375] "m"  IFV
 SG_ CAN_FL_DET_SD_RANGE_189 : 9|6@0+ (0.025,0) [0|1.5] "m"  IFV
 SG_ CAN_FL_DET_RANGE_RATE_189 : 19|14@0+ (0.015625,-128) [-128|127.984375] "m/s"  IFV
 SG_ CAN_FL_DET_SD_RANGE_RATE_189 : 37|6@0+ (0.02,0) [0|1.2] "m/s"  IFV
 SG_ CAN_FL_DET_AZIMUTH_189 : 47|13@0+ (0.0007668,-3.141593) [-3.141593|3.141593] "rad"  IFV
 SG_ CAN_FL_DET_SD_AZIMUTH_189 : 50|6@0+ (0.001745329,0) [0|0.104719755] "rad"  IFV
 SG_ CAN_FL_DET_ELEVATION_189 : 60|7@0+ (0.157449,-9.99812) [-9.99812|9.997903] "deg"  IFV
 SG_ CAN_FL_DET_SD_ELEVATION_189 : 69|6@0+ (0.003490659,0) [0|0.20943951] "rad"  IFV
 SG_ CAN_FL_DET_AMPLITUDE_189 : 79|7@0+ (1,-64) [-64|63] "dBsm"  IFV
 SG_ CAN_FL_DET_VALID_FLAG_189 : 72|1@0+ (1,0) [0|1] ""  IFV
 SG_ CAN_FL_DET_SUPER_RES_189 : 80|1@0+ (1,0) [0|1] ""  IFV
 SG_ CAN_FL_DET_LOW_SNR_FLAG_189 : 81|1@0+ (1,0) [0|1] ""  IFV
 SG_ CAN_FL_DET_MIXER_BIAS_FLAG_189 : 82|1@0+ (1,0) [0|1] ""  IFV
 SG_ CAN_FL_DET_RESERVED_FLAGS_189 : 87|5@0+ (1,0) [0|31] ""  IFV
 SG_ CAN_FL_DET_SNR_189 : 95|8@0+ (0.35156,0) [0|89.6478] "dB"  IFV
 SG_ CAN_FL_DET_MULTI_TARGET_PROB_189 : 99|4@0+ (0.06667,0) [0|1] ""  IFV
 SG_ CAN_FL_DET_CONFID_AZIMUTH_189 : 101|2@0+ (1,0) [0|3] ""  IFV
 SG_ CAN_FL_DET_CONFID_ELEVATION_189 : 103|2@0+ (1,0) [0|3] ""  IFV
 SG_ CAN_FL_DET_EXISTENCE_PROB_189 : 107|4@0+ (1,0) [0|15] ""  IFV
 SG_ CAN_FL_DET_CLASS_189 : 111|4@0+ (1,0) [0|15] ""  IFV
 SG_ CAN_FL_DET_RANGE_190 : 127|14@0+ (0.015625,0) [0|255.984375] "m"  IFV
 SG_ CAN_FL_DET_SD_RANGE_190 : 129|6@0+ (0.025,0) [0|1.5] "m"  IFV
 SG_ CAN_FL_DET_RANGE_RATE_190 : 139|14@0+ (0.015625,-128) [-128|127.984375] "m/s"  IFV
 SG_ CAN_FL_DET_SD_RANGE_RATE_190 : 157|6@0+ (0.02,0) [0|1.2] "m/s"  IFV
 SG_ CAN_FL_DET_AZIMUTH_190 : 167|13@0+ (0.0007668,-3.141593) [-3.141593|3.141593] "rad"  IFV
 SG_ CAN_FL_DET_SD_AZIMUTH_190 : 170|6@0+ (0.001745329,0) [0|0.104719755] "rad"  IFV
 SG_ CAN_FL_DET_ELEVATION_190 : 180|7@0+ (0.157449,-9.99812) [-9.99812|9.997903] "deg"  IFV
 SG_ CAN_FL_DET_SD_ELEVATION_190 : 189|6@0+ (0.003490659,0) [0|0.20943951] "rad"  IFV
 SG_ CAN_FL_DET_AMPLITUDE_190 : 199|7@0+ (1,-64) [-64|63] "dBsm"  IFV
 SG_ CAN_FL_DET_VALID_FLAG_190 : 192|1@0+ (1,0) [0|1] ""  IFV
 SG_ CAN_FL_DET_SUPER_RES_190 : 200|1@0+ (1,0) [0|1] ""  IFV
 SG_ CAN_FL_DET_LOW_SNR_FLAG_190 : 201|1@0+ (1,0) [0|1] ""  IFV
 SG_ CAN_FL_DET_MIXER_BIAS_FLAG_190 : 202|1@0+ (1,0) [0|1] ""  IFV
 SG_ CAN_FL_DET_RESERVED_FLAGS_190 : 207|5@0+ (1,0) [0|31] ""  IFV
 SG_ CAN_FL_DET_SNR_190 : 215|8@0+ (0.35156,0) [0|89.6478] "dB"  IFV
 SG_ CAN_FL_DET_MULTI_TARGET_PROB_190 : 219|4@0+ (0.06667,0) [0|1] ""  IFV
 SG_ CAN_FL_DET_CONFID_AZIMUTH_190 : 221|2@0+ (1,0) [0|3] ""  IFV
 SG_ CAN_FL_DET_CONFID_ELEVATION_190 : 223|2@0+ (1,0) [0|3] ""  IFV
 SG_ CAN_FL_DET_EXISTENCE_PROB_190 : 227|4@0+ (1,0) [0|15] ""  IFV
 SG_ CAN_FL_DET_CLASS_190 : 231|4@0+ (1,0) [0|15] ""  IFV
 SG_ CAN_FL_DET_RANGE_191 : 247|14@0+ (0.015625,0) [0|255.984375] "m"  IFV
 SG_ CAN_FL_DET_SD_RANGE_191 : 249|6@0+ (0.025,0) [0|1.5] "m"  IFV
 SG_ CAN_FL_DET_RANGE_RATE_191 : 259|14@0+ (0.015625,-128) [-128|127.984375] "m/s"  IFV
 SG_ CAN_FL_DET_SD_RANGE_RATE_191 : 277|6@0+ (0.02,0) [0|1.2] "m/s"  IFV
 SG_ CAN_FL_DET_AZIMUTH_191 : 287|13@0+ (0.0007668,-3.141593) [-3.141593|3.141593] "rad"  IFV
 SG_ CAN_FL_DET_SD_AZIMUTH_191 : 290|6@0+ (0.001745329,0) [0|0.104719755] "rad"  IFV
 SG_ CAN_FL_DET_ELEVATION_191 : 300|7@0+ (0.157449,-9.99812) [-9.99812|9.997903] "deg"  IFV
 SG_ CAN_FL_DET_SD_ELEVATION_191 : 309|6@0+ (0.003490659,0) [0|0.20943951] "rad"  IFV
 SG_ CAN_FL_DET_AMPLITUDE_191 : 319|7@0+ (1,-64) [-64|63] "dBsm"  IFV
 SG_ CAN_FL_DET_VALID_FLAG_191 : 312|1@0+ (1,0) [0|1] ""  IFV
 SG_ CAN_FL_DET_SUPER_RES_191 : 320|1@0+ (1,0) [0|1] ""  IFV
 SG_ CAN_FL_DET_LOW_SNR_FLAG_191 : 321|1@0+ (1,0) [0|1] ""  IFV
 SG_ CAN_FL_DET_MIXER_BIAS_FLAG_191 : 322|1@0+ (1,0) [0|1] ""  IFV
 SG_ CAN_FL_DET_RESERVED_FLAGS_191 : 327|5@0+ (1,0) [0|31] ""  IFV
 SG_ CAN_FL_DET_SNR_191 : 335|8@0+ (0.35156,0) [0|89.6478] "dB"  IFV
 SG_ CAN_FL_DET_MULTI_TARGET_PROB_191 : 339|4@0+ (0.06667,0) [0|1] ""  IFV
 SG_ CAN_FL_DET_CONFID_AZIMUTH_191 : 341|2@0+ (1,0) [0|3] ""  IFV
 SG_ CAN_FL_DET_CONFID_ELEVATION_191 : 343|2@0+ (1,0) [0|3] ""  IFV
 SG_ CAN_FL_DET_EXISTENCE_PROB_191 : 347|4@0+ (1,0) [0|15] ""  IFV
 SG_ CAN_FL_DET_CLASS_191 : 351|4@0+ (1,0) [0|15] ""  IFV
 SG_ CAN_FL_DET_RANGE_192 : 367|14@0+ (0.015625,0) [0|255.984375] "m"  IFV
 SG_ CAN_FL_DET_SD_RANGE_192 : 369|6@0+ (0.025,0) [0|1.5] "m"  IFV
 SG_ CAN_FL_DET_RANGE_RATE_192 : 379|14@0+ (0.015625,-128) [-128|127.984375] "m/s"  IFV
 SG_ CAN_FL_DET_SD_RANGE_RATE_192 : 397|6@0+ (0.02,0) [0|1.2] "m/s"  IFV
 SG_ CAN_FL_DET_AZIMUTH_192 : 407|13@0+ (0.0007668,-3.141593) [-3.141593|3.141593] "rad"  IFV
 SG_ CAN_FL_DET_SD_AZIMUTH_192 : 410|6@0+ (0.001745329,0) [0|0.104719755] "rad"  IFV
 SG_ CAN_FL_DET_ELEVATION_192 : 420|7@0+ (0.157449,-9.99812) [-9.99812|9.997903] "deg"  IFV
 SG_ CAN_FL_DET_SD_ELEVATION_192 : 429|6@0+ (0.003490659,0) [0|0.20943951] "rad"  IFV
 SG_ CAN_FL_DET_AMPLITUDE_192 : 439|7@0+ (1,-64) [-64|63] "dBsm"  IFV
 SG_ CAN_FL_DET_VALID_FLAG_192 : 432|1@0+ (1,0) [0|1] ""  IFV
 SG_ CAN_FL_DET_SUPER_RES_192 : 440|1@0+ (1,0) [0|1] ""  IFV
 SG_ CAN_FL_DET_LOW_SNR_FLAG_192 : 441|1@0+ (1,0) [0|1] ""  IFV
 SG_ CAN_FL_DET_MIXER_BIAS_FLAG_192 : 442|1@0+ (1,0) [0|1] ""  IFV
 SG_ CAN_FL_DET_RESERVED_FLAGS_192 : 447|5@0+ (1,0) [0|31] ""  IFV
 SG_ CAN_FL_DET_SNR_192 : 455|8@0+ (0.35156,0) [0|89.6478] "dB"  IFV
 SG_ CAN_FL_DET_MULTI_TARGET_PROB_192 : 459|4@0+ (0.06667,0) [0|1] ""  IFV
 SG_ CAN_FL_DET_CONFID_AZIMUTH_192 : 461|2@0+ (1,0) [0|3] ""  IFV
 SG_ CAN_FL_DET_CONFID_ELEVATION_192 : 463|2@0+ (1,0) [0|3] ""  IFV
 SG_ CAN_FL_DET_EXISTENCE_PROB_192 : 467|4@0+ (1,0) [0|15] ""  IFV
 SG_ CAN_FL_DET_CLASS_192 : 471|4@0+ (1,0) [0|15] ""  IFV

BO_ 816 SODFL_DETECTION_193_196: 64 SODFL
 SG_ CAN_FL_DET_RANGE_193 : 7|14@0+ (0.015625,0) [0|255.984375] "m"  IFV
 SG_ CAN_FL_DET_SD_RANGE_193 : 9|6@0+ (0.025,0) [0|1.5] "m"  IFV
 SG_ CAN_FL_DET_RANGE_RATE_193 : 19|14@0+ (0.015625,-128) [-128|127.984375] "m/s"  IFV
 SG_ CAN_FL_DET_SD_RANGE_RATE_193 : 37|6@0+ (0.02,0) [0|1.2] "m/s"  IFV
 SG_ CAN_FL_DET_AZIMUTH_193 : 47|13@0+ (0.0007668,-3.141593) [-3.141593|3.141593] "rad"  IFV
 SG_ CAN_FL_DET_SD_AZIMUTH_193 : 50|6@0+ (0.001745329,0) [0|0.104719755] "rad"  IFV
 SG_ CAN_FL_DET_ELEVATION_193 : 60|7@0+ (0.157449,-9.99812) [-9.99812|9.997903] "deg"  IFV
 SG_ CAN_FL_DET_SD_ELEVATION_193 : 69|6@0+ (0.003490659,0) [0|0.20943951] "rad"  IFV
 SG_ CAN_FL_DET_AMPLITUDE_193 : 79|7@0+ (1,-64) [-64|63] "dBsm"  IFV
 SG_ CAN_FL_DET_VALID_FLAG_193 : 72|1@0+ (1,0) [0|1] ""  IFV
 SG_ CAN_FL_DET_SUPER_RES_193 : 80|1@0+ (1,0) [0|1] ""  IFV
 SG_ CAN_FL_DET_LOW_SNR_FLAG_193 : 81|1@0+ (1,0) [0|1] ""  IFV
 SG_ CAN_FL_DET_MIXER_BIAS_FLAG_193 : 82|1@0+ (1,0) [0|1] ""  IFV
 SG_ CAN_FL_DET_RESERVED_FLAGS_193 : 87|5@0+ (1,0) [0|31] ""  IFV
 SG_ CAN_FL_DET_SNR_193 : 95|8@0+ (0.35156,0) [0|89.6478] "dB"  IFV
 SG_ CAN_FL_DET_MULTI_TARGET_PROB_193 : 99|4@0+ (0.06667,0) [0|1] ""  IFV
 SG_ CAN_FL_DET_CONFID_AZIMUTH_193 : 101|2@0+ (1,0) [0|3] ""  IFV
 SG_ CAN_FL_DET_CONFID_ELEVATION_193 : 103|2@0+ (1,0) [0|3] ""  IFV
 SG_ CAN_FL_DET_EXISTENCE_PROB_193 : 107|4@0+ (1,0) [0|15] ""  IFV
 SG_ CAN_FL_DET_CLASS_193 : 111|4@0+ (1,0) [0|15] ""  IFV
 SG_ CAN_FL_DET_RANGE_194 : 127|14@0+ (0.015625,0) [0|255.984375] "m"  IFV
 SG_ CAN_FL_DET_SD_RANGE_194 : 129|6@0+ (0.025,0) [0|1.5] "m"  IFV
 SG_ CAN_FL_DET_RANGE_RATE_194 : 139|14@0+ (0.015625,-128) [-128|127.984375] "m/s"  IFV
 SG_ CAN_FL_DET_SD_RANGE_RATE_194 : 157|6@0+ (0.02,0) [0|1.2] "m/s"  IFV
 SG_ CAN_FL_DET_AZIMUTH_194 : 167|13@0+ (0.0007668,-3.141593) [-3.141593|3.141593] "rad"  IFV
 SG_ CAN_FL_DET_SD_AZIMUTH_194 : 170|6@0+ (0.001745329,0) [0|0.104719755] "rad"  IFV
 SG_ CAN_FL_DET_ELEVATION_194 : 180|7@0+ (0.157449,-9.99812) [-9.99812|9.997903] "deg"  IFV
 SG_ CAN_FL_DET_SD_ELEVATION_194 : 189|6@0+ (0.003490659,0) [0|0.20943951] "rad"  IFV
 SG_ CAN_FL_DET_AMPLITUDE_194 : 199|7@0+ (1,-64) [-64|63] "dBsm"  IFV
 SG_ CAN_FL_DET_VALID_FLAG_194 : 192|1@0+ (1,0) [0|1] ""  IFV
 SG_ CAN_FL_DET_SUPER_RES_194 : 200|1@0+ (1,0) [0|1] ""  IFV
 SG_ CAN_FL_DET_LOW_SNR_FLAG_194 : 201|1@0+ (1,0) [0|1] ""  IFV
 SG_ CAN_FL_DET_MIXER_BIAS_FLAG_194 : 202|1@0+ (1,0) [0|1] ""  IFV
 SG_ CAN_FL_DET_RESERVED_FLAGS_194 : 207|5@0+ (1,0) [0|31] ""  IFV
 SG_ CAN_FL_DET_SNR_194 : 215|8@0+ (0.35156,0) [0|89.6478] "dB"  IFV
 SG_ CAN_FL_DET_MULTI_TARGET_PROB_194 : 219|4@0+ (0.06667,0) [0|1] ""  IFV
 SG_ CAN_FL_DET_CONFID_AZIMUTH_194 : 221|2@0+ (1,0) [0|3] ""  IFV
 SG_ CAN_FL_DET_CONFID_ELEVATION_194 : 223|2@0+ (1,0) [0|3] ""  IFV
 SG_ CAN_FL_DET_EXISTENCE_PROB_194 : 227|4@0+ (1,0) [0|15] ""  IFV
 SG_ CAN_FL_DET_CLASS_194 : 231|4@0+ (1,0) [0|15] ""  IFV
 SG_ CAN_FL_DET_RANGE_195 : 247|14@0+ (0.015625,0) [0|255.984375] "m"  IFV
 SG_ CAN_FL_DET_SD_RANGE_195 : 249|6@0+ (0.025,0) [0|1.5] "m"  IFV
 SG_ CAN_FL_DET_RANGE_RATE_195 : 259|14@0+ (0.015625,-128) [-128|127.984375] "m/s"  IFV
 SG_ CAN_FL_DET_SD_RANGE_RATE_195 : 277|6@0+ (0.02,0) [0|1.2] "m/s"  IFV
 SG_ CAN_FL_DET_AZIMUTH_195 : 287|13@0+ (0.0007668,-3.141593) [-3.141593|3.141593] "rad"  IFV
 SG_ CAN_FL_DET_SD_AZIMUTH_195 : 290|6@0+ (0.001745329,0) [0|0.104719755] "rad"  IFV
 SG_ CAN_FL_DET_ELEVATION_195 : 300|7@0+ (0.157449,-9.99812) [-9.99812|9.997903] "deg"  IFV
 SG_ CAN_FL_DET_SD_ELEVATION_195 : 309|6@0+ (0.003490659,0) [0|0.20943951] "rad"  IFV
 SG_ CAN_FL_DET_AMPLITUDE_195 : 319|7@0+ (1,-64) [-64|63] "dBsm"  IFV
 SG_ CAN_FL_DET_VALID_FLAG_195 : 312|1@0+ (1,0) [0|1] ""  IFV
 SG_ CAN_FL_DET_SUPER_RES_195 : 320|1@0+ (1,0) [0|1] ""  IFV
 SG_ CAN_FL_DET_LOW_SNR_FLAG_195 : 321|1@0+ (1,0) [0|1] ""  IFV
 SG_ CAN_FL_DET_MIXER_BIAS_FLAG_195 : 322|1@0+ (1,0) [0|1] ""  IFV
 SG_ CAN_FL_DET_RESERVED_FLAGS_195 : 327|5@0+ (1,0) [0|31] ""  IFV
 SG_ CAN_FL_DET_SNR_195 : 335|8@0+ (0.35156,0) [0|89.6478] "dB"  IFV
 SG_ CAN_FL_DET_MULTI_TARGET_PROB_195 : 339|4@0+ (0.06667,0) [0|1] ""  IFV
 SG_ CAN_FL_DET_CONFID_AZIMUTH_195 : 341|2@0+ (1,0) [0|3] ""  IFV
 SG_ CAN_FL_DET_CONFID_ELEVATION_195 : 343|2@0+ (1,0) [0|3] ""  IFV
 SG_ CAN_FL_DET_EXISTENCE_PROB_195 : 347|4@0+ (1,0) [0|15] ""  IFV
 SG_ CAN_FL_DET_CLASS_195 : 351|4@0+ (1,0) [0|15] ""  IFV
 SG_ CAN_FL_DET_RANGE_196 : 367|14@0+ (0.015625,0) [0|255.984375] "m"  IFV
 SG_ CAN_FL_DET_SD_RANGE_196 : 369|6@0+ (0.025,0) [0|1.5] "m"  IFV
 SG_ CAN_FL_DET_RANGE_RATE_196 : 379|14@0+ (0.015625,-128) [-128|127.984375] "m/s"  IFV
 SG_ CAN_FL_DET_SD_RANGE_RATE_196 : 397|6@0+ (0.02,0) [0|1.2] "m/s"  IFV
 SG_ CAN_FL_DET_AZIMUTH_196 : 407|13@0+ (0.0007668,-3.141593) [-3.141593|3.141593] "rad"  IFV
 SG_ CAN_FL_DET_SD_AZIMUTH_196 : 410|6@0+ (0.001745329,0) [0|0.104719755] "rad"  IFV
 SG_ CAN_FL_DET_ELEVATION_196 : 420|7@0+ (0.157449,-9.99812) [-9.99812|9.997903] "deg"  IFV
 SG_ CAN_FL_DET_SD_ELEVATION_196 : 429|6@0+ (0.003490659,0) [0|0.20943951] "rad"  IFV
 SG_ CAN_FL_DET_AMPLITUDE_196 : 439|7@0+ (1,-64) [-64|63] "dBsm"  IFV
 SG_ CAN_FL_DET_VALID_FLAG_196 : 432|1@0+ (1,0) [0|1] ""  IFV
 SG_ CAN_FL_DET_SUPER_RES_196 : 440|1@0+ (1,0) [0|1] ""  IFV
 SG_ CAN_FL_DET_LOW_SNR_FLAG_196 : 441|1@0+ (1,0) [0|1] ""  IFV
 SG_ CAN_FL_DET_MIXER_BIAS_FLAG_196 : 442|1@0+ (1,0) [0|1] ""  IFV
 SG_ CAN_FL_DET_RESERVED_FLAGS_196 : 447|5@0+ (1,0) [0|31] ""  IFV
 SG_ CAN_FL_DET_SNR_196 : 455|8@0+ (0.35156,0) [0|89.6478] "dB"  IFV
 SG_ CAN_FL_DET_MULTI_TARGET_PROB_196 : 459|4@0+ (0.06667,0) [0|1] ""  IFV
 SG_ CAN_FL_DET_CONFID_AZIMUTH_196 : 461|2@0+ (1,0) [0|3] ""  IFV
 SG_ CAN_FL_DET_CONFID_ELEVATION_196 : 463|2@0+ (1,0) [0|3] ""  IFV
 SG_ CAN_FL_DET_EXISTENCE_PROB_196 : 467|4@0+ (1,0) [0|15] ""  IFV
 SG_ CAN_FL_DET_CLASS_196 : 471|4@0+ (1,0) [0|15] ""  IFV

BO_ 817 SODFL_DETECTION_197_200: 64 SODFL
 SG_ CAN_FL_DET_RANGE_197 : 7|14@0+ (0.015625,0) [0|255.984375] "m"  IFV
 SG_ CAN_FL_DET_SD_RANGE_197 : 9|6@0+ (0.025,0) [0|1.5] "m"  IFV
 SG_ CAN_FL_DET_RANGE_RATE_197 : 19|14@0+ (0.015625,-128) [-128|127.984375] "m/s"  IFV
 SG_ CAN_FL_DET_SD_RANGE_RATE_197 : 37|6@0+ (0.02,0) [0|1.2] "m/s"  IFV
 SG_ CAN_FL_DET_AZIMUTH_197 : 47|13@0+ (0.0007668,-3.141593) [-3.141593|3.141593] "rad"  IFV
 SG_ CAN_FL_DET_SD_AZIMUTH_197 : 50|6@0+ (0.001745329,0) [0|0.104719755] "rad"  IFV
 SG_ CAN_FL_DET_ELEVATION_197 : 60|7@0+ (0.157449,-9.99812) [-9.99812|9.997903] "deg"  IFV
 SG_ CAN_FL_DET_SD_ELEVATION_197 : 69|6@0+ (0.003490659,0) [0|0.20943951] "rad"  IFV
 SG_ CAN_FL_DET_AMPLITUDE_197 : 79|7@0+ (1,-64) [-64|63] "dBsm"  IFV
 SG_ CAN_FL_DET_VALID_FLAG_197 : 72|1@0+ (1,0) [0|1] ""  IFV
 SG_ CAN_FL_DET_SUPER_RES_197 : 80|1@0+ (1,0) [0|1] ""  IFV
 SG_ CAN_FL_DET_LOW_SNR_FLAG_197 : 81|1@0+ (1,0) [0|1] ""  IFV
 SG_ CAN_FL_DET_MIXER_BIAS_FLAG_197 : 82|1@0+ (1,0) [0|1] ""  IFV
 SG_ CAN_FL_DET_RESERVED_FLAGS_197 : 87|5@0+ (1,0) [0|31] ""  IFV
 SG_ CAN_FL_DET_SNR_197 : 95|8@0+ (0.35156,0) [0|89.6478] "dB"  IFV
 SG_ CAN_FL_DET_MULTI_TARGET_PROB_197 : 99|4@0+ (0.06667,0) [0|1] ""  IFV
 SG_ CAN_FL_DET_CONFID_AZIMUTH_197 : 101|2@0+ (1,0) [0|3] ""  IFV
 SG_ CAN_FL_DET_CONFID_ELEVATION_197 : 103|2@0+ (1,0) [0|3] ""  IFV
 SG_ CAN_FL_DET_EXISTENCE_PROB_197 : 107|4@0+ (1,0) [0|15] ""  IFV
 SG_ CAN_FL_DET_CLASS_197 : 111|4@0+ (1,0) [0|15] ""  IFV
 SG_ CAN_FL_DET_RANGE_198 : 127|14@0+ (0.015625,0) [0|255.984375] "m"  IFV
 SG_ CAN_FL_DET_SD_RANGE_198 : 129|6@0+ (0.025,0) [0|1.5] "m"  IFV
 SG_ CAN_FL_DET_RANGE_RATE_198 : 139|14@0+ (0.015625,-128) [-128|127.984375] "m/s"  IFV
 SG_ CAN_FL_DET_SD_RANGE_RATE_198 : 157|6@0+ (0.02,0) [0|1.2] "m/s"  IFV
 SG_ CAN_FL_DET_AZIMUTH_198 : 167|13@0+ (0.0007668,-3.141593) [-3.141593|3.141593] "rad"  IFV
 SG_ CAN_FL_DET_SD_AZIMUTH_198 : 170|6@0+ (0.001745329,0) [0|0.104719755] "rad"  IFV
 SG_ CAN_FL_DET_ELEVATION_198 : 180|7@0+ (0.157449,-9.99812) [-9.99812|9.997903] "deg"  IFV
 SG_ CAN_FL_DET_SD_ELEVATION_198 : 189|6@0+ (0.003490659,0) [0|0.20943951] "rad"  IFV
 SG_ CAN_FL_DET_AMPLITUDE_198 : 199|7@0+ (1,-64) [-64|63] "dBsm"  IFV
 SG_ CAN_FL_DET_VALID_FLAG_198 : 192|1@0+ (1,0) [0|1] ""  IFV
 SG_ CAN_FL_DET_SUPER_RES_198 : 200|1@0+ (1,0) [0|1] ""  IFV
 SG_ CAN_FL_DET_LOW_SNR_FLAG_198 : 201|1@0+ (1,0) [0|1] ""  IFV
 SG_ CAN_FL_DET_MIXER_BIAS_FLAG_198 : 202|1@0+ (1,0) [0|1] ""  IFV
 SG_ CAN_FL_DET_RESERVED_FLAGS_198 : 207|5@0+ (1,0) [0|31] ""  IFV
 SG_ CAN_FL_DET_SNR_198 : 215|8@0+ (0.35156,0) [0|89.6478] "dB"  IFV
 SG_ CAN_FL_DET_MULTI_TARGET_PROB_198 : 219|4@0+ (0.06667,0) [0|1] ""  IFV
 SG_ CAN_FL_DET_CONFID_AZIMUTH_198 : 221|2@0+ (1,0) [0|3] ""  IFV
 SG_ CAN_FL_DET_CONFID_ELEVATION_198 : 223|2@0+ (1,0) [0|3] ""  IFV
 SG_ CAN_FL_DET_EXISTENCE_PROB_198 : 227|4@0+ (1,0) [0|15] ""  IFV
 SG_ CAN_FL_DET_CLASS_198 : 231|4@0+ (1,0) [0|15] ""  IFV
 SG_ CAN_FL_DET_RANGE_199 : 247|14@0+ (0.015625,0) [0|255.984375] "m"  IFV
 SG_ CAN_FL_DET_SD_RANGE_199 : 249|6@0+ (0.025,0) [0|1.5] "m"  IFV
 SG_ CAN_FL_DET_RANGE_RATE_199 : 259|14@0+ (0.015625,-128) [-128|127.984375] "m/s"  IFV
 SG_ CAN_FL_DET_SD_RANGE_RATE_199 : 277|6@0+ (0.02,0) [0|1.2] "m/s"  IFV
 SG_ CAN_FL_DET_AZIMUTH_199 : 287|13@0+ (0.0007668,-3.141593) [-3.141593|3.141593] "rad"  IFV
 SG_ CAN_FL_DET_SD_AZIMUTH_199 : 290|6@0+ (0.001745329,0) [0|0.104719755] "rad"  IFV
 SG_ CAN_FL_DET_ELEVATION_199 : 300|7@0+ (0.157449,-9.99812) [-9.99812|9.997903] "deg"  IFV
 SG_ CAN_FL_DET_SD_ELEVATION_199 : 309|6@0+ (0.003490659,0) [0|0.20943951] "rad"  IFV
 SG_ CAN_FL_DET_AMPLITUDE_199 : 319|7@0+ (1,-64) [-64|63] "dBsm"  IFV
 SG_ CAN_FL_DET_VALID_FLAG_199 : 312|1@0+ (1,0) [0|1] ""  IFV
 SG_ CAN_FL_DET_SUPER_RES_199 : 320|1@0+ (1,0) [0|1] ""  IFV
 SG_ CAN_FL_DET_LOW_SNR_FLAG_199 : 321|1@0+ (1,0) [0|1] ""  IFV
 SG_ CAN_FL_DET_MIXER_BIAS_FLAG_199 : 322|1@0+ (1,0) [0|1] ""  IFV
 SG_ CAN_FL_DET_RESERVED_FLAGS_199 : 327|5@0+ (1,0) [0|31] ""  IFV
 SG_ CAN_FL_DET_SNR_199 : 335|8@0+ (0.35156,0) [0|89.6478] "dB"  IFV
 SG_ CAN_FL_DET_MULTI_TARGET_PROB_199 : 339|4@0+ (0.06667,0) [0|1] ""  IFV
 SG_ CAN_FL_DET_CONFID_AZIMUTH_199 : 341|2@0+ (1,0) [0|3] ""  IFV
 SG_ CAN_FL_DET_CONFID_ELEVATION_199 : 343|2@0+ (1,0) [0|3] ""  IFV
 SG_ CAN_FL_DET_EXISTENCE_PROB_199 : 347|4@0+ (1,0) [0|15] ""  IFV
 SG_ CAN_FL_DET_CLASS_199 : 351|4@0+ (1,0) [0|15] ""  IFV
 SG_ CAN_FL_DET_RANGE_200 : 367|14@0+ (0.015625,0) [0|255.984375] "m"  IFV
 SG_ CAN_FL_DET_SD_RANGE_200 : 369|6@0+ (0.025,0) [0|1.5] "m"  IFV
 SG_ CAN_FL_DET_RANGE_RATE_200 : 379|14@0+ (0.015625,-128) [-128|127.984375] "m/s"  IFV
 SG_ CAN_FL_DET_SD_RANGE_RATE_200 : 397|6@0+ (0.02,0) [0|1.2] "m/s"  IFV
 SG_ CAN_FL_DET_AZIMUTH_200 : 407|13@0+ (0.0007668,-3.141593) [-3.141593|3.141593] "rad"  IFV
 SG_ CAN_FL_DET_SD_AZIMUTH_200 : 410|6@0+ (0.001745329,0) [0|0.104719755] "rad"  IFV
 SG_ CAN_FL_DET_ELEVATION_200 : 420|7@0+ (0.157449,-9.99812) [-9.99812|9.997903] "deg"  IFV
 SG_ CAN_FL_DET_SD_ELEVATION_200 : 429|6@0+ (0.003490659,0) [0|0.20943951] "rad"  IFV
 SG_ CAN_FL_DET_AMPLITUDE_200 : 439|7@0+ (1,-64) [-64|63] "dBsm"  IFV
 SG_ CAN_FL_DET_VALID_FLAG_200 : 432|1@0+ (1,0) [0|1] ""  IFV
 SG_ CAN_FL_DET_SUPER_RES_200 : 440|1@0+ (1,0) [0|1] ""  IFV
 SG_ CAN_FL_DET_LOW_SNR_FLAG_200 : 441|1@0+ (1,0) [0|1] ""  IFV
 SG_ CAN_FL_DET_MIXER_BIAS_FLAG_200 : 442|1@0+ (1,0) [0|1] ""  IFV
 SG_ CAN_FL_DET_RESERVED_FLAGS_200 : 447|5@0+ (1,0) [0|31] ""  IFV
 SG_ CAN_FL_DET_SNR_200 : 455|8@0+ (0.35156,0) [0|89.6478] "dB"  IFV
 SG_ CAN_FL_DET_MULTI_TARGET_PROB_200 : 459|4@0+ (0.06667,0) [0|1] ""  IFV
 SG_ CAN_FL_DET_CONFID_AZIMUTH_200 : 461|2@0+ (1,0) [0|3] ""  IFV
 SG_ CAN_FL_DET_CONFID_ELEVATION_200 : 463|2@0+ (1,0) [0|3] ""  IFV
 SG_ CAN_FL_DET_EXISTENCE_PROB_200 : 467|4@0+ (1,0) [0|15] ""  IFV
 SG_ CAN_FL_DET_CLASS_200 : 471|4@0+ (1,0) [0|15] ""  IFV

BO_ 1024 SODFR_DETECTION_001_004: 64 SODFR
 SG_ CAN_FR_DET_RANGE_001 : 7|14@0+ (0.015625,0) [0|255.984375] "m"  IFV
 SG_ CAN_FR_DET_SD_RANGE_001 : 9|6@0+ (0.025,0) [0|1.5] "m"  IFV
 SG_ CAN_FR_DET_RANGE_RATE_001 : 19|14@0+ (0.015625,-128) [-128|127.984375] "m/s"  IFV
 SG_ CAN_FR_DET_SD_RANGE_RATE_001 : 37|6@0+ (0.02,0) [0|1.2] "m/s"  IFV
 SG_ CAN_FR_DET_AZIMUTH_001 : 47|13@0+ (0.0007668,-3.141593) [-3.141593|3.141593] "rad"  IFV
 SG_ CAN_FR_DET_SD_AZIMUTH_001 : 50|6@0+ (0.001745329,0) [0|0.104719755] "rad"  IFV
 SG_ CAN_FR_DET_ELEVATION_001 : 60|7@0+ (0.157449,-9.99812) [-9.99812|9.997903] "deg"  IFV
 SG_ CAN_FR_DET_SD_ELEVATION_001 : 69|6@0+ (0.003490659,0) [0|0.20943951] "rad"  IFV
 SG_ CAN_FR_DET_AMPLITUDE_001 : 79|7@0+ (1,-64) [-64|63] "dBsm"  IFV
 SG_ CAN_FR_DET_VALID_FLAG_001 : 72|1@0+ (1,0) [0|1] ""  IFV
 SG_ CAN_FR_DET_SUPER_RES_001 : 80|1@0+ (1,0) [0|1] ""  IFV
 SG_ CAN_FR_DET_LOW_SNR_FLAG_001 : 81|1@0+ (1,0) [0|1] ""  IFV
 SG_ CAN_FR_DET_MIXER_BIAS_FLAG_001 : 82|1@0+ (1,0) [0|1] ""  IFV
 SG_ CAN_FR_DET_RESERVED_FLAGS_001 : 87|5@0+ (1,0) [0|31] ""  IFV
 SG_ CAN_FR_DET_SNR_001 : 95|8@0+ (0.35156,0) [0|89.6478] "dB"  IFV
 SG_ CAN_FR_DET_MULTI_TARGET_PROB_001 : 99|4@0+ (0.06667,0) [0|1] ""  IFV
 SG_ CAN_FR_DET_CONFID_AZIMUTH_001 : 101|2@0+ (1,0) [0|3] ""  IFV
 SG_ CAN_FR_DET_CONFID_ELEVATION_001 : 103|2@0+ (1,0) [0|3] ""  IFV
 SG_ CAN_FR_DET_EXISTENCE_PROB_001 : 107|4@0+ (1,0) [0|15] ""  IFV
 SG_ CAN_FR_DET_CLASS_001 : 111|4@0+ (1,0) [0|15] ""  IFV
 SG_ CAN_FR_DET_RANGE_002 : 127|14@0+ (0.015625,0) [0|255.984375] "m"  IFV
 SG_ CAN_FR_DET_SD_RANGE_002 : 129|6@0+ (0.025,0) [0|1.5] "m"  IFV
 SG_ CAN_FR_DET_RANGE_RATE_002 : 139|14@0+ (0.015625,-128) [-128|127.984375] "m/s"  IFV
 SG_ CAN_FR_DET_SD_RANGE_RATE_002 : 157|6@0+ (0.02,0) [0|1.2] "m/s"  IFV
 SG_ CAN_FR_DET_AZIMUTH_002 : 167|13@0+ (0.0007668,-3.141593) [-3.141593|3.141593] "rad"  IFV
 SG_ CAN_FR_DET_SD_AZIMUTH_002 : 170|6@0+ (0.001745329,0) [0|0.104719755] "rad"  IFV
 SG_ CAN_FR_DET_ELEVATION_002 : 180|7@0+ (0.157449,-9.99812) [-9.99812|9.997903] "deg"  IFV
 SG_ CAN_FR_DET_SD_ELEVATION_002 : 189|6@0+ (0.003490659,0) [0|0.20943951] "rad"  IFV
 SG_ CAN_FR_DET_AMPLITUDE_002 : 199|7@0+ (1,-64) [-64|63] "dBsm"  IFV
 SG_ CAN_FR_DET_VALID_FLAG_002 : 192|1@0+ (1,0) [0|1] ""  IFV
 SG_ CAN_FR_DET_SUPER_RES_002 : 200|1@0+ (1,0) [0|1] ""  IFV
 SG_ CAN_FR_DET_LOW_SNR_FLAG_002 : 201|1@0+ (1,0) [0|1] ""  IFV
 SG_ CAN_FR_DET_MIXER_BIAS_FLAG_002 : 202|1@0+ (1,0) [0|1] ""  IFV
 SG_ CAN_FR_DET_RESERVED_FLAGS_002 : 207|5@0+ (1,0) [0|31] ""  IFV
 SG_ CAN_FR_DET_SNR_002 : 215|8@0+ (0.35156,0) [0|89.6478] "dB"  IFV
 SG_ CAN_FR_DET_MULTI_TARGET_PROB_002 : 219|4@0+ (0.06667,0) [0|1] ""  IFV
 SG_ CAN_FR_DET_CONFID_AZIMUTH_002 : 221|2@0+ (1,0) [0|3] ""  IFV
 SG_ CAN_FR_DET_CONFID_ELEVATION_002 : 223|2@0+ (1,0) [0|3] ""  IFV
 SG_ CAN_FR_DET_EXISTENCE_PROB_002 : 227|4@0+ (1,0) [0|15] ""  IFV
 SG_ CAN_FR_DET_CLASS_002 : 231|4@0+ (1,0) [0|15] ""  IFV
 SG_ CAN_FR_DET_RANGE_003 : 247|14@0+ (0.015625,0) [0|255.984375] "m"  IFV
 SG_ CAN_FR_DET_SD_RANGE_003 : 249|6@0+ (0.025,0) [0|1.5] "m"  IFV
 SG_ CAN_FR_DET_RANGE_RATE_003 : 259|14@0+ (0.015625,-128) [-128|127.984375] "m/s"  IFV
 SG_ CAN_FR_DET_SD_RANGE_RATE_003 : 277|6@0+ (0.02,0) [0|1.2] "m/s"  IFV
 SG_ CAN_FR_DET_AZIMUTH_003 : 287|13@0+ (0.0007668,-3.141593) [-3.141593|3.141593] "rad"  IFV
 SG_ CAN_FR_DET_SD_AZIMUTH_003 : 290|6@0+ (0.001745329,0) [0|0.104719755] "rad"  IFV
 SG_ CAN_FR_DET_ELEVATION_003 : 300|7@0+ (0.157449,-9.99812) [-9.99812|9.997903] "deg"  IFV
 SG_ CAN_FR_DET_SD_ELEVATION_003 : 309|6@0+ (0.003490659,0) [0|0.20943951] "rad"  IFV
 SG_ CAN_FR_DET_AMPLITUDE_003 : 319|7@0+ (1,-64) [-64|63] "dBsm"  IFV
 SG_ CAN_FR_DET_VALID_FLAG_003 : 312|1@0+ (1,0) [0|1] ""  IFV
 SG_ CAN_FR_DET_SUPER_RES_003 : 320|1@0+ (1,0) [0|1] ""  IFV
 SG_ CAN_FR_DET_LOW_SNR_FLAG_003 : 321|1@0+ (1,0) [0|1] ""  IFV
 SG_ CAN_FR_DET_MIXER_BIAS_FLAG_003 : 322|1@0+ (1,0) [0|1] ""  IFV
 SG_ CAN_FR_DET_RESERVED_FLAGS_003 : 327|5@0+ (1,0) [0|31] ""  IFV
 SG_ CAN_FR_DET_SNR_003 : 335|8@0+ (0.35156,0) [0|89.6478] "dB"  IFV
 SG_ CAN_FR_DET_MULTI_TARGET_PROB_003 : 339|4@0+ (0.06667,0) [0|1] ""  IFV
 SG_ CAN_FR_DET_CONFID_AZIMUTH_003 : 341|2@0+ (1,0) [0|3] ""  IFV
 SG_ CAN_FR_DET_CONFID_ELEVATION_003 : 343|2@0+ (1,0) [0|3] ""  IFV
 SG_ CAN_FR_DET_EXISTENCE_PROB_003 : 347|4@0+ (1,0) [0|15] ""  IFV
 SG_ CAN_FR_DET_CLASS_003 : 351|4@0+ (1,0) [0|15] ""  IFV
 SG_ CAN_FR_DET_RANGE_004 : 367|14@0+ (0.015625,0) [0|255.984375] "m"  IFV
 SG_ CAN_FR_DET_SD_RANGE_004 : 369|6@0+ (0.025,0) [0|1.5] "m"  IFV
 SG_ CAN_FR_DET_RANGE_RATE_004 : 379|14@0+ (0.015625,-128) [-128|127.984375] "m/s"  IFV
 SG_ CAN_FR_DET_SD_RANGE_RATE_004 : 397|6@0+ (0.02,0) [0|1.2] "m/s"  IFV
 SG_ CAN_FR_DET_AZIMUTH_004 : 407|13@0+ (0.0007668,-3.141593) [-3.141593|3.141593] "rad"  IFV
 SG_ CAN_FR_DET_SD_AZIMUTH_004 : 410|6@0+ (0.001745329,0) [0|0.104719755] "rad"  IFV
 SG_ CAN_FR_DET_ELEVATION_004 : 420|7@0+ (0.157449,-9.99812) [-9.99812|9.997903] "deg"  IFV
 SG_ CAN_FR_DET_SD_ELEVATION_004 : 429|6@0+ (0.003490659,0) [0|0.20943951] "rad"  IFV
 SG_ CAN_FR_DET_AMPLITUDE_004 : 439|7@0+ (1,-64) [-64|63] "dBsm"  IFV
 SG_ CAN_FR_DET_VALID_FLAG_004 : 432|1@0+ (1,0) [0|1] ""  IFV
 SG_ CAN_FR_DET_SUPER_RES_004 : 440|1@0+ (1,0) [0|1] ""  IFV
 SG_ CAN_FR_DET_LOW_SNR_FLAG_004 : 441|1@0+ (1,0) [0|1] ""  IFV
 SG_ CAN_FR_DET_MIXER_BIAS_FLAG_004 : 442|1@0+ (1,0) [0|1] ""  IFV
 SG_ CAN_FR_DET_RESERVED_FLAGS_004 : 447|5@0+ (1,0) [0|31] ""  IFV
 SG_ CAN_FR_DET_SNR_004 : 455|8@0+ (0.35156,0) [0|89.6478] "dB"  IFV
 SG_ CAN_FR_DET_MULTI_TARGET_PROB_004 : 459|4@0+ (0.06667,0) [0|1] ""  IFV
 SG_ CAN_FR_DET_CONFID_AZIMUTH_004 : 461|2@0+ (1,0) [0|3] ""  IFV
 SG_ CAN_FR_DET_CONFID_ELEVATION_004 : 463|2@0+ (1,0) [0|3] ""  IFV
 SG_ CAN_FR_DET_EXISTENCE_PROB_004 : 467|4@0+ (1,0) [0|15] ""  IFV
 SG_ CAN_FR_DET_CLASS_004 : 471|4@0+ (1,0) [0|15] ""  IFV

BO_ 1025 SODFR_DETECTION_005_008: 64 SODFR
 SG_ CAN_FR_DET_RANGE_005 : 7|14@0+ (0.015625,0) [0|255.984375] "m"  IFV
 SG_ CAN_FR_DET_SD_RANGE_005 : 9|6@0+ (0.025,0) [0|1.5] "m"  IFV
 SG_ CAN_FR_DET_RANGE_RATE_005 : 19|14@0+ (0.015625,-128) [-128|127.984375] "m/s"  IFV
 SG_ CAN_FR_DET_SD_RANGE_RATE_005 : 37|6@0+ (0.02,0) [0|1.2] "m/s"  IFV
 SG_ CAN_FR_DET_AZIMUTH_005 : 47|13@0+ (0.0007668,-3.141593) [-3.141593|3.141593] "rad"  IFV
 SG_ CAN_FR_DET_SD_AZIMUTH_005 : 50|6@0+ (0.001745329,0) [0|0.104719755] "rad"  IFV
 SG_ CAN_FR_DET_ELEVATION_005 : 60|7@0+ (0.157449,-9.99812) [-9.99812|9.997903] "deg"  IFV
 SG_ CAN_FR_DET_SD_ELEVATION_005 : 69|6@0+ (0.003490659,0) [0|0.20943951] "rad"  IFV
 SG_ CAN_FR_DET_AMPLITUDE_005 : 79|7@0+ (1,-64) [-64|63] "dBsm"  IFV
 SG_ CAN_FR_DET_VALID_FLAG_005 : 72|1@0+ (1,0) [0|1] ""  IFV
 SG_ CAN_FR_DET_SUPER_RES_005 : 80|1@0+ (1,0) [0|1] ""  IFV
 SG_ CAN_FR_DET_LOW_SNR_FLAG_005 : 81|1@0+ (1,0) [0|1] ""  IFV
 SG_ CAN_FR_DET_MIXER_BIAS_FLAG_005 : 82|1@0+ (1,0) [0|1] ""  IFV
 SG_ CAN_FR_DET_RESERVED_FLAGS_005 : 87|5@0+ (1,0) [0|31] ""  IFV
 SG_ CAN_FR_DET_SNR_005 : 95|8@0+ (0.35156,0) [0|89.6478] "dB"  IFV
 SG_ CAN_FR_DET_MULTI_TARGET_PROB_005 : 99|4@0+ (0.06667,0) [0|1] ""  IFV
 SG_ CAN_FR_DET_CONFID_AZIMUTH_005 : 101|2@0+ (1,0) [0|3] ""  IFV
 SG_ CAN_FR_DET_CONFID_ELEVATION_005 : 103|2@0+ (1,0) [0|3] ""  IFV
 SG_ CAN_FR_DET_EXISTENCE_PROB_005 : 107|4@0+ (1,0) [0|15] ""  IFV
 SG_ CAN_FR_DET_CLASS_005 : 111|4@0+ (1,0) [0|15] ""  IFV
 SG_ CAN_FR_DET_RANGE_006 : 127|14@0+ (0.015625,0) [0|255.984375] "m"  IFV
 SG_ CAN_FR_DET_SD_RANGE_006 : 129|6@0+ (0.025,0) [0|1.5] "m"  IFV
 SG_ CAN_FR_DET_RANGE_RATE_006 : 139|14@0+ (0.015625,-128) [-128|127.984375] "m/s"  IFV
 SG_ CAN_FR_DET_SD_RANGE_RATE_006 : 157|6@0+ (0.02,0) [0|1.2] "m/s"  IFV
 SG_ CAN_FR_DET_AZIMUTH_006 : 167|13@0+ (0.0007668,-3.141593) [-3.141593|3.141593] "rad"  IFV
 SG_ CAN_FR_DET_SD_AZIMUTH_006 : 170|6@0+ (0.001745329,0) [0|0.104719755] "rad"  IFV
 SG_ CAN_FR_DET_ELEVATION_006 : 180|7@0+ (0.157449,-9.99812) [-9.99812|9.997903] "deg"  IFV
 SG_ CAN_FR_DET_SD_ELEVATION_006 : 189|6@0+ (0.003490659,0) [0|0.20943951] "rad"  IFV
 SG_ CAN_FR_DET_AMPLITUDE_006 : 199|7@0+ (1,-64) [-64|63] "dBsm"  IFV
 SG_ CAN_FR_DET_VALID_FLAG_006 : 192|1@0+ (1,0) [0|1] ""  IFV
 SG_ CAN_FR_DET_SUPER_RES_006 : 200|1@0+ (1,0) [0|1] ""  IFV
 SG_ CAN_FR_DET_LOW_SNR_FLAG_006 : 201|1@0+ (1,0) [0|1] ""  IFV
 SG_ CAN_FR_DET_MIXER_BIAS_FLAG_006 : 202|1@0+ (1,0) [0|1] ""  IFV
 SG_ CAN_FR_DET_RESERVED_FLAGS_006 : 207|5@0+ (1,0) [0|31] ""  IFV
 SG_ CAN_FR_DET_SNR_006 : 215|8@0+ (0.35156,0) [0|89.6478] "dB"  IFV
 SG_ CAN_FR_DET_MULTI_TARGET_PROB_006 : 219|4@0+ (0.06667,0) [0|1] ""  IFV
 SG_ CAN_FR_DET_CONFID_AZIMUTH_006 : 221|2@0+ (1,0) [0|3] ""  IFV
 SG_ CAN_FR_DET_CONFID_ELEVATION_006 : 223|2@0+ (1,0) [0|3] ""  IFV
 SG_ CAN_FR_DET_EXISTENCE_PROB_006 : 227|4@0+ (1,0) [0|15] ""  IFV
 SG_ CAN_FR_DET_CLASS_006 : 231|4@0+ (1,0) [0|15] ""  IFV
 SG_ CAN_FR_DET_RANGE_007 : 247|14@0+ (0.015625,0) [0|255.984375] "m"  IFV
 SG_ CAN_FR_DET_SD_RANGE_007 : 249|6@0+ (0.025,0) [0|1.5] "m"  IFV
 SG_ CAN_FR_DET_RANGE_RATE_007 : 259|14@0+ (0.015625,-128) [-128|127.984375] "m/s"  IFV
 SG_ CAN_FR_DET_SD_RANGE_RATE_007 : 277|6@0+ (0.02,0) [0|1.2] "m/s"  IFV
 SG_ CAN_FR_DET_AZIMUTH_007 : 287|13@0+ (0.0007668,-3.141593) [-3.141593|3.141593] "rad"  IFV
 SG_ CAN_FR_DET_SD_AZIMUTH_007 : 290|6@0+ (0.001745329,0) [0|0.104719755] "rad"  IFV
 SG_ CAN_FR_DET_ELEVATION_007 : 300|7@0+ (0.157449,-9.99812) [-9.99812|9.997903] "deg"  IFV
 SG_ CAN_FR_DET_SD_ELEVATION_007 : 309|6@0+ (0.003490659,0) [0|0.20943951] "rad"  IFV
 SG_ CAN_FR_DET_AMPLITUDE_007 : 319|7@0+ (1,-64) [-64|63] "dBsm"  IFV
 SG_ CAN_FR_DET_VALID_FLAG_007 : 312|1@0+ (1,0) [0|1] ""  IFV
 SG_ CAN_FR_DET_SUPER_RES_007 : 320|1@0+ (1,0) [0|1] ""  IFV
 SG_ CAN_FR_DET_LOW_SNR_FLAG_007 : 321|1@0+ (1,0) [0|1] ""  IFV
 SG_ CAN_FR_DET_MIXER_BIAS_FLAG_007 : 322|1@0+ (1,0) [0|1] ""  IFV
 SG_ CAN_FR_DET_RESERVED_FLAGS_007 : 327|5@0+ (1,0) [0|31] ""  IFV
 SG_ CAN_FR_DET_SNR_007 : 335|8@0+ (0.35156,0) [0|89.6478] "dB"  IFV
 SG_ CAN_FR_DET_MULTI_TARGET_PROB_007 : 339|4@0+ (0.06667,0) [0|1] ""  IFV
 SG_ CAN_FR_DET_CONFID_AZIMUTH_007 : 341|2@0+ (1,0) [0|3] ""  IFV
 SG_ CAN_FR_DET_CONFID_ELEVATION_007 : 343|2@0+ (1,0) [0|3] ""  IFV
 SG_ CAN_FR_DET_EXISTENCE_PROB_007 : 347|4@0+ (1,0) [0|15] ""  IFV
 SG_ CAN_FR_DET_CLASS_007 : 351|4@0+ (1,0) [0|15] ""  IFV
 SG_ CAN_FR_DET_RANGE_008 : 367|14@0+ (0.015625,0) [0|255.984375] "m"  IFV
 SG_ CAN_FR_DET_SD_RANGE_008 : 369|6@0+ (0.025,0) [0|1.5] "m"  IFV
 SG_ CAN_FR_DET_RANGE_RATE_008 : 379|14@0+ (0.015625,-128) [-128|127.984375] "m/s"  IFV
 SG_ CAN_FR_DET_SD_RANGE_RATE_008 : 397|6@0+ (0.02,0) [0|1.2] "m/s"  IFV
 SG_ CAN_FR_DET_AZIMUTH_008 : 407|13@0+ (0.0007668,-3.141593) [-3.141593|3.141593] "rad"  IFV
 SG_ CAN_FR_DET_SD_AZIMUTH_008 : 410|6@0+ (0.001745329,0) [0|0.104719755] "rad"  IFV
 SG_ CAN_FR_DET_ELEVATION_008 : 420|7@0+ (0.157449,-9.99812) [-9.99812|9.997903] "deg"  IFV
 SG_ CAN_FR_DET_SD_ELEVATION_008 : 429|6@0+ (0.003490659,0) [0|0.20943951] "rad"  IFV
 SG_ CAN_FR_DET_AMPLITUDE_008 : 439|7@0+ (1,-64) [-64|63] "dBsm"  IFV
 SG_ CAN_FR_DET_VALID_FLAG_008 : 432|1@0+ (1,0) [0|1] ""  IFV
 SG_ CAN_FR_DET_SUPER_RES_008 : 440|1@0+ (1,0) [0|1] ""  IFV
 SG_ CAN_FR_DET_LOW_SNR_FLAG_008 : 441|1@0+ (1,0) [0|1] ""  IFV
 SG_ CAN_FR_DET_MIXER_BIAS_FLAG_008 : 442|1@0+ (1,0) [0|1] ""  IFV
 SG_ CAN_FR_DET_RESERVED_FLAGS_008 : 447|5@0+ (1,0) [0|31] ""  IFV
 SG_ CAN_FR_DET_SNR_008 : 455|8@0+ (0.35156,0) [0|89.6478] "dB"  IFV
 SG_ CAN_FR_DET_MULTI_TARGET_PROB_008 : 459|4@0+ (0.06667,0) [0|1] ""  IFV
 SG_ CAN_FR_DET_CONFID_AZIMUTH_008 : 461|2@0+ (1,0) [0|3] ""  IFV
 SG_ CAN_FR_DET_CONFID_ELEVATION_008 : 463|2@0+ (1,0) [0|3] ""  IFV
 SG_ CAN_FR_DET_EXISTENCE_PROB_008 : 467|4@0+ (1,0) [0|15] ""  IFV
 SG_ CAN_FR_DET_CLASS_008 : 471|4@0+ (1,0) [0|15] ""  IFV

BO_ 1026 SODFR_DETECTION_009_012: 64 SODFR
 SG_ CAN_FR_DET_RANGE_009 : 7|14@0+ (0.015625,0) [0|255.984375] "m"  IFV
 SG_ CAN_FR_DET_SD_RANGE_009 : 9|6@0+ (0.025,0) [0|1.5] "m"  IFV
 SG_ CAN_FR_DET_RANGE_RATE_009 : 19|14@0+ (0.015625,-128) [-128|127.984375] "m/s"  IFV
 SG_ CAN_FR_DET_SD_RANGE_RATE_009 : 37|6@0+ (0.02,0) [0|1.2] "m/s"  IFV
 SG_ CAN_FR_DET_AZIMUTH_009 : 47|13@0+ (0.0007668,-3.141593) [-3.141593|3.141593] "rad"  IFV
 SG_ CAN_FR_DET_SD_AZIMUTH_009 : 50|6@0+ (0.001745329,0) [0|0.104719755] "rad"  IFV
 SG_ CAN_FR_DET_ELEVATION_009 : 60|7@0+ (0.157449,-9.99812) [-9.99812|9.997903] "deg"  IFV
 SG_ CAN_FR_DET_SD_ELEVATION_009 : 69|6@0+ (0.003490659,0) [0|0.20943951] "rad"  IFV
 SG_ CAN_FR_DET_AMPLITUDE_009 : 79|7@0+ (1,-64) [-64|63] "dBsm"  IFV
 SG_ CAN_FR_DET_VALID_FLAG_009 : 72|1@0+ (1,0) [0|1] ""  IFV
 SG_ CAN_FR_DET_SUPER_RES_009 : 80|1@0+ (1,0) [0|1] ""  IFV
 SG_ CAN_FR_DET_LOW_SNR_FLAG_009 : 81|1@0+ (1,0) [0|1] ""  IFV
 SG_ CAN_FR_DET_MIXER_BIAS_FLAG_009 : 82|1@0+ (1,0) [0|1] ""  IFV
 SG_ CAN_FR_DET_RESERVED_FLAGS_009 : 87|5@0+ (1,0) [0|31] ""  IFV
 SG_ CAN_FR_DET_SNR_009 : 95|8@0+ (0.35156,0) [0|89.6478] "dB"  IFV
 SG_ CAN_FR_DET_MULTI_TARGET_PROB_009 : 99|4@0+ (0.06667,0) [0|1] ""  IFV
 SG_ CAN_FR_DET_CONFID_AZIMUTH_009 : 101|2@0+ (1,0) [0|3] ""  IFV
 SG_ CAN_FR_DET_CONFID_ELEVATION_009 : 103|2@0+ (1,0) [0|3] ""  IFV
 SG_ CAN_FR_DET_EXISTENCE_PROB_009 : 107|4@0+ (1,0) [0|15] ""  IFV
 SG_ CAN_FR_DET_CLASS_009 : 111|4@0+ (1,0) [0|15] ""  IFV
 SG_ CAN_FR_DET_RANGE_010 : 127|14@0+ (0.015625,0) [0|255.984375] "m"  IFV
 SG_ CAN_FR_DET_SD_RANGE_010 : 129|6@0+ (0.025,0) [0|1.5] "m"  IFV
 SG_ CAN_FR_DET_RANGE_RATE_010 : 139|14@0+ (0.015625,-128) [-128|127.984375] "m/s"  IFV
 SG_ CAN_FR_DET_SD_RANGE_RATE_010 : 157|6@0+ (0.02,0) [0|1.2] "m/s"  IFV
 SG_ CAN_FR_DET_AZIMUTH_010 : 167|13@0+ (0.0007668,-3.141593) [-3.141593|3.141593] "rad"  IFV
 SG_ CAN_FR_DET_SD_AZIMUTH_010 : 170|6@0+ (0.001745329,0) [0|0.104719755] "rad"  IFV
 SG_ CAN_FR_DET_ELEVATION_010 : 180|7@0+ (0.157449,-9.99812) [-9.99812|9.997903] "deg"  IFV
 SG_ CAN_FR_DET_SD_ELEVATION_010 : 189|6@0+ (0.003490659,0) [0|0.20943951] "rad"  IFV
 SG_ CAN_FR_DET_AMPLITUDE_010 : 199|7@0+ (1,-64) [-64|63] "dBsm"  IFV
 SG_ CAN_FR_DET_VALID_FLAG_010 : 192|1@0+ (1,0) [0|1] ""  IFV
 SG_ CAN_FR_DET_SUPER_RES_010 : 200|1@0+ (1,0) [0|1] ""  IFV
 SG_ CAN_FR_DET_LOW_SNR_FLAG_010 : 201|1@0+ (1,0) [0|1] ""  IFV
 SG_ CAN_FR_DET_MIXER_BIAS_FLAG_010 : 202|1@0+ (1,0) [0|1] ""  IFV
 SG_ CAN_FR_DET_RESERVED_FLAGS_010 : 207|5@0+ (1,0) [0|31] ""  IFV
 SG_ CAN_FR_DET_SNR_010 : 215|8@0+ (0.35156,0) [0|89.6478] "dB"  IFV
 SG_ CAN_FR_DET_MULTI_TARGET_PROB_010 : 219|4@0+ (0.06667,0) [0|1] ""  IFV
 SG_ CAN_FR_DET_CONFID_AZIMUTH_010 : 221|2@0+ (1,0) [0|3] ""  IFV
 SG_ CAN_FR_DET_CONFID_ELEVATION_010 : 223|2@0+ (1,0) [0|3] ""  IFV
 SG_ CAN_FR_DET_EXISTENCE_PROB_010 : 227|4@0+ (1,0) [0|15] ""  IFV
 SG_ CAN_FR_DET_CLASS_010 : 231|4@0+ (1,0) [0|15] ""  IFV
 SG_ CAN_FR_DET_RANGE_011 : 247|14@0+ (0.015625,0) [0|255.984375] "m"  IFV
 SG_ CAN_FR_DET_SD_RANGE_011 : 249|6@0+ (0.025,0) [0|1.5] "m"  IFV
 SG_ CAN_FR_DET_RANGE_RATE_011 : 259|14@0+ (0.015625,-128) [-128|127.984375] "m/s"  IFV
 SG_ CAN_FR_DET_SD_RANGE_RATE_011 : 277|6@0+ (0.02,0) [0|1.2] "m/s"  IFV
 SG_ CAN_FR_DET_AZIMUTH_011 : 287|13@0+ (0.0007668,-3.141593) [-3.141593|3.141593] "rad"  IFV
 SG_ CAN_FR_DET_SD_AZIMUTH_011 : 290|6@0+ (0.001745329,0) [0|0.104719755] "rad"  IFV
 SG_ CAN_FR_DET_ELEVATION_011 : 300|7@0+ (0.157449,-9.99812) [-9.99812|9.997903] "deg"  IFV
 SG_ CAN_FR_DET_SD_ELEVATION_011 : 309|6@0+ (0.003490659,0) [0|0.20943951] "rad"  IFV
 SG_ CAN_FR_DET_AMPLITUDE_011 : 319|7@0+ (1,-64) [-64|63] "dBsm"  IFV
 SG_ CAN_FR_DET_VALID_FLAG_011 : 312|1@0+ (1,0) [0|1] ""  IFV
 SG_ CAN_FR_DET_SUPER_RES_011 : 320|1@0+ (1,0) [0|1] ""  IFV
 SG_ CAN_FR_DET_LOW_SNR_FLAG_011 : 321|1@0+ (1,0) [0|1] ""  IFV
 SG_ CAN_FR_DET_MIXER_BIAS_FLAG_011 : 322|1@0+ (1,0) [0|1] ""  IFV
 SG_ CAN_FR_DET_RESERVED_FLAGS_011 : 327|5@0+ (1,0) [0|31] ""  IFV
 SG_ CAN_FR_DET_SNR_011 : 335|8@0+ (0.35156,0) [0|89.6478] "dB"  IFV
 SG_ CAN_FR_DET_MULTI_TARGET_PROB_011 : 339|4@0+ (0.06667,0) [0|1] ""  IFV
 SG_ CAN_FR_DET_CONFID_AZIMUTH_011 : 341|2@0+ (1,0) [0|3] ""  IFV
 SG_ CAN_FR_DET_CONFID_ELEVATION_011 : 343|2@0+ (1,0) [0|3] ""  IFV
 SG_ CAN_FR_DET_EXISTENCE_PROB_011 : 347|4@0+ (1,0) [0|15] ""  IFV
 SG_ CAN_FR_DET_CLASS_011 : 351|4@0+ (1,0) [0|15] ""  IFV
 SG_ CAN_FR_DET_RANGE_012 : 367|14@0+ (0.015625,0) [0|255.984375] "m"  IFV
 SG_ CAN_FR_DET_SD_RANGE_012 : 369|6@0+ (0.025,0) [0|1.5] "m"  IFV
 SG_ CAN_FR_DET_RANGE_RATE_012 : 379|14@0+ (0.015625,-128) [-128|127.984375] "m/s"  IFV
 SG_ CAN_FR_DET_SD_RANGE_RATE_012 : 397|6@0+ (0.02,0) [0|1.2] "m/s"  IFV
 SG_ CAN_FR_DET_AZIMUTH_012 : 407|13@0+ (0.0007668,-3.141593) [-3.141593|3.141593] "rad"  IFV
 SG_ CAN_FR_DET_SD_AZIMUTH_012 : 410|6@0+ (0.001745329,0) [0|0.104719755] "rad"  IFV
 SG_ CAN_FR_DET_ELEVATION_012 : 420|7@0+ (0.157449,-9.99812) [-9.99812|9.997903] "deg"  IFV
 SG_ CAN_FR_DET_SD_ELEVATION_012 : 429|6@0+ (0.003490659,0) [0|0.20943951] "rad"  IFV
 SG_ CAN_FR_DET_AMPLITUDE_012 : 439|7@0+ (1,-64) [-64|63] "dBsm"  IFV
 SG_ CAN_FR_DET_VALID_FLAG_012 : 432|1@0+ (1,0) [0|1] ""  IFV
 SG_ CAN_FR_DET_SUPER_RES_012 : 440|1@0+ (1,0) [0|1] ""  IFV
 SG_ CAN_FR_DET_LOW_SNR_FLAG_012 : 441|1@0+ (1,0) [0|1] ""  IFV
 SG_ CAN_FR_DET_MIXER_BIAS_FLAG_012 : 442|1@0+ (1,0) [0|1] ""  IFV
 SG_ CAN_FR_DET_RESERVED_FLAGS_012 : 447|5@0+ (1,0) [0|31] ""  IFV
 SG_ CAN_FR_DET_SNR_012 : 455|8@0+ (0.35156,0) [0|89.6478] "dB"  IFV
 SG_ CAN_FR_DET_MULTI_TARGET_PROB_012 : 459|4@0+ (0.06667,0) [0|1] ""  IFV
 SG_ CAN_FR_DET_CONFID_AZIMUTH_012 : 461|2@0+ (1,0) [0|3] ""  IFV
 SG_ CAN_FR_DET_CONFID_ELEVATION_012 : 463|2@0+ (1,0) [0|3] ""  IFV
 SG_ CAN_FR_DET_EXISTENCE_PROB_012 : 467|4@0+ (1,0) [0|15] ""  IFV
 SG_ CAN_FR_DET_CLASS_012 : 471|4@0+ (1,0) [0|15] ""  IFV

BO_ 1027 SODFR_DETECTION_013_016: 64 SODFR
 SG_ CAN_FR_DET_RANGE_013 : 7|14@0+ (0.015625,0) [0|255.984375] "m"  IFV
 SG_ CAN_FR_DET_SD_RANGE_013 : 9|6@0+ (0.025,0) [0|1.5] "m"  IFV
 SG_ CAN_FR_DET_RANGE_RATE_013 : 19|14@0+ (0.015625,-128) [-128|127.984375] "m/s"  IFV
 SG_ CAN_FR_DET_SD_RANGE_RATE_013 : 37|6@0+ (0.02,0) [0|1.2] "m/s"  IFV
 SG_ CAN_FR_DET_AZIMUTH_013 : 47|13@0+ (0.0007668,-3.141593) [-3.141593|3.141593] "rad"  IFV
 SG_ CAN_FR_DET_SD_AZIMUTH_013 : 50|6@0+ (0.001745329,0) [0|0.104719755] "rad"  IFV
 SG_ CAN_FR_DET_ELEVATION_013 : 60|7@0+ (0.157449,-9.99812) [-9.99812|9.997903] "deg"  IFV
 SG_ CAN_FR_DET_SD_ELEVATION_013 : 69|6@0+ (0.003490659,0) [0|0.20943951] "rad"  IFV
 SG_ CAN_FR_DET_AMPLITUDE_013 : 79|7@0+ (1,-64) [-64|63] "dBsm"  IFV
 SG_ CAN_FR_DET_VALID_FLAG_013 : 72|1@0+ (1,0) [0|1] ""  IFV
 SG_ CAN_FR_DET_SUPER_RES_013 : 80|1@0+ (1,0) [0|1] ""  IFV
 SG_ CAN_FR_DET_LOW_SNR_FLAG_013 : 81|1@0+ (1,0) [0|1] ""  IFV
 SG_ CAN_FR_DET_MIXER_BIAS_FLAG_013 : 82|1@0+ (1,0) [0|1] ""  IFV
 SG_ CAN_FR_DET_RESERVED_FLAGS_013 : 87|5@0+ (1,0) [0|31] ""  IFV
 SG_ CAN_FR_DET_SNR_013 : 95|8@0+ (0.35156,0) [0|89.6478] "dB"  IFV
 SG_ CAN_FR_DET_MULTI_TARGET_PROB_013 : 99|4@0+ (0.06667,0) [0|1] ""  IFV
 SG_ CAN_FR_DET_CONFID_AZIMUTH_013 : 101|2@0+ (1,0) [0|3] ""  IFV
 SG_ CAN_FR_DET_CONFID_ELEVATION_013 : 103|2@0+ (1,0) [0|3] ""  IFV
 SG_ CAN_FR_DET_EXISTENCE_PROB_013 : 107|4@0+ (1,0) [0|15] ""  IFV
 SG_ CAN_FR_DET_CLASS_013 : 111|4@0+ (1,0) [0|15] ""  IFV
 SG_ CAN_FR_DET_RANGE_014 : 127|14@0+ (0.015625,0) [0|255.984375] "m"  IFV
 SG_ CAN_FR_DET_SD_RANGE_014 : 129|6@0+ (0.025,0) [0|1.5] "m"  IFV
 SG_ CAN_FR_DET_RANGE_RATE_014 : 139|14@0+ (0.015625,-128) [-128|127.984375] "m/s"  IFV
 SG_ CAN_FR_DET_SD_RANGE_RATE_014 : 157|6@0+ (0.02,0) [0|1.2] "m/s"  IFV
 SG_ CAN_FR_DET_AZIMUTH_014 : 167|13@0+ (0.0007668,-3.141593) [-3.141593|3.141593] "rad"  IFV
 SG_ CAN_FR_DET_SD_AZIMUTH_014 : 170|6@0+ (0.001745329,0) [0|0.104719755] "rad"  IFV
 SG_ CAN_FR_DET_ELEVATION_014 : 180|7@0+ (0.157449,-9.99812) [-9.99812|9.997903] "deg"  IFV
 SG_ CAN_FR_DET_SD_ELEVATION_014 : 189|6@0+ (0.003490659,0) [0|0.20943951] "rad"  IFV
 SG_ CAN_FR_DET_AMPLITUDE_014 : 199|7@0+ (1,-64) [-64|63] "dBsm"  IFV
 SG_ CAN_FR_DET_VALID_FLAG_014 : 192|1@0+ (1,0) [0|1] ""  IFV
 SG_ CAN_FR_DET_SUPER_RES_014 : 200|1@0+ (1,0) [0|1] ""  IFV
 SG_ CAN_FR_DET_LOW_SNR_FLAG_014 : 201|1@0+ (1,0) [0|1] ""  IFV
 SG_ CAN_FR_DET_MIXER_BIAS_FLAG_014 : 202|1@0+ (1,0) [0|1] ""  IFV
 SG_ CAN_FR_DET_RESERVED_FLAGS_014 : 207|5@0+ (1,0) [0|31] ""  IFV
 SG_ CAN_FR_DET_SNR_014 : 215|8@0+ (0.35156,0) [0|89.6478] "dB"  IFV
 SG_ CAN_FR_DET_MULTI_TARGET_PROB_014 : 219|4@0+ (0.06667,0) [0|1] ""  IFV
 SG_ CAN_FR_DET_CONFID_AZIMUTH_014 : 221|2@0+ (1,0) [0|3] ""  IFV
 SG_ CAN_FR_DET_CONFID_ELEVATION_014 : 223|2@0+ (1,0) [0|3] ""  IFV
 SG_ CAN_FR_DET_EXISTENCE_PROB_014 : 227|4@0+ (1,0) [0|15] ""  IFV
 SG_ CAN_FR_DET_CLASS_014 : 231|4@0+ (1,0) [0|15] ""  IFV
 SG_ CAN_FR_DET_RANGE_015 : 247|14@0+ (0.015625,0) [0|255.984375] "m"  IFV
 SG_ CAN_FR_DET_SD_RANGE_015 : 249|6@0+ (0.025,0) [0|1.5] "m"  IFV
 SG_ CAN_FR_DET_RANGE_RATE_015 : 259|14@0+ (0.015625,-128) [-128|127.984375] "m/s"  IFV
 SG_ CAN_FR_DET_SD_RANGE_RATE_015 : 277|6@0+ (0.02,0) [0|1.2] "m/s"  IFV
 SG_ CAN_FR_DET_AZIMUTH_015 : 287|13@0+ (0.0007668,-3.141593) [-3.141593|3.141593] "rad"  IFV
 SG_ CAN_FR_DET_SD_AZIMUTH_015 : 290|6@0+ (0.001745329,0) [0|0.104719755] "rad"  IFV
 SG_ CAN_FR_DET_ELEVATION_015 : 300|7@0+ (0.157449,-9.99812) [-9.99812|9.997903] "deg"  IFV
 SG_ CAN_FR_DET_SD_ELEVATION_015 : 309|6@0+ (0.003490659,0) [0|0.20943951] "rad"  IFV
 SG_ CAN_FR_DET_AMPLITUDE_015 : 319|7@0+ (1,-64) [-64|63] "dBsm"  IFV
 SG_ CAN_FR_DET_VALID_FLAG_015 : 312|1@0+ (1,0) [0|1] ""  IFV
 SG_ CAN_FR_DET_SUPER_RES_015 : 320|1@0+ (1,0) [0|1] ""  IFV
 SG_ CAN_FR_DET_LOW_SNR_FLAG_015 : 321|1@0+ (1,0) [0|1] ""  IFV
 SG_ CAN_FR_DET_MIXER_BIAS_FLAG_015 : 322|1@0+ (1,0) [0|1] ""  IFV
 SG_ CAN_FR_DET_RESERVED_FLAGS_015 : 327|5@0+ (1,0) [0|31] ""  IFV
 SG_ CAN_FR_DET_SNR_015 : 335|8@0+ (0.35156,0) [0|89.6478] "dB"  IFV
 SG_ CAN_FR_DET_MULTI_TARGET_PROB_015 : 339|4@0+ (0.06667,0) [0|1] ""  IFV
 SG_ CAN_FR_DET_CONFID_AZIMUTH_015 : 341|2@0+ (1,0) [0|3] ""  IFV
 SG_ CAN_FR_DET_CONFID_ELEVATION_015 : 343|2@0+ (1,0) [0|3] ""  IFV
 SG_ CAN_FR_DET_EXISTENCE_PROB_015 : 347|4@0+ (1,0) [0|15] ""  IFV
 SG_ CAN_FR_DET_CLASS_015 : 351|4@0+ (1,0) [0|15] ""  IFV
 SG_ CAN_FR_DET_RANGE_016 : 367|14@0+ (0.015625,0) [0|255.984375] "m"  IFV
 SG_ CAN_FR_DET_SD_RANGE_016 : 369|6@0+ (0.025,0) [0|1.5] "m"  IFV
 SG_ CAN_FR_DET_RANGE_RATE_016 : 379|14@0+ (0.015625,-128) [-128|127.984375] "m/s"  IFV
 SG_ CAN_FR_DET_SD_RANGE_RATE_016 : 397|6@0+ (0.02,0) [0|1.2] "m/s"  IFV
 SG_ CAN_FR_DET_AZIMUTH_016 : 407|13@0+ (0.0007668,-3.141593) [-3.141593|3.141593] "rad"  IFV
 SG_ CAN_FR_DET_SD_AZIMUTH_016 : 410|6@0+ (0.001745329,0) [0|0.104719755] "rad"  IFV
 SG_ CAN_FR_DET_ELEVATION_016 : 420|7@0+ (0.157449,-9.99812) [-9.99812|9.997903] "deg"  IFV
 SG_ CAN_FR_DET_SD_ELEVATION_016 : 429|6@0+ (0.003490659,0) [0|0.20943951] "rad"  IFV
 SG_ CAN_FR_DET_AMPLITUDE_016 : 439|7@0+ (1,-64) [-64|63] "dBsm"  IFV
 SG_ CAN_FR_DET_VALID_FLAG_016 : 432|1@0+ (1,0) [0|1] ""  IFV
 SG_ CAN_FR_DET_SUPER_RES_016 : 440|1@0+ (1,0) [0|1] ""  IFV
 SG_ CAN_FR_DET_LOW_SNR_FLAG_016 : 441|1@0+ (1,0) [0|1] ""  IFV
 SG_ CAN_FR_DET_MIXER_BIAS_FLAG_016 : 442|1@0+ (1,0) [0|1] ""  IFV
 SG_ CAN_FR_DET_RESERVED_FLAGS_016 : 447|5@0+ (1,0) [0|31] ""  IFV
 SG_ CAN_FR_DET_SNR_016 : 455|8@0+ (0.35156,0) [0|89.6478] "dB"  IFV
 SG_ CAN_FR_DET_MULTI_TARGET_PROB_016 : 459|4@0+ (0.06667,0) [0|1] ""  IFV
 SG_ CAN_FR_DET_CONFID_AZIMUTH_016 : 461|2@0+ (1,0) [0|3] ""  IFV
 SG_ CAN_FR_DET_CONFID_ELEVATION_016 : 463|2@0+ (1,0) [0|3] ""  IFV
 SG_ CAN_FR_DET_EXISTENCE_PROB_016 : 467|4@0+ (1,0) [0|15] ""  IFV
 SG_ CAN_FR_DET_CLASS_016 : 471|4@0+ (1,0) [0|15] ""  IFV

BO_ 1028 SODFR_DETECTION_017_020: 64 SODFR
 SG_ CAN_FR_DET_RANGE_017 : 7|14@0+ (0.015625,0) [0|255.984375] "m"  IFV
 SG_ CAN_FR_DET_SD_RANGE_017 : 9|6@0+ (0.025,0) [0|1.5] "m"  IFV
 SG_ CAN_FR_DET_RANGE_RATE_017 : 19|14@0+ (0.015625,-128) [-128|127.984375] "m/s"  IFV
 SG_ CAN_FR_DET_SD_RANGE_RATE_017 : 37|6@0+ (0.02,0) [0|1.2] "m/s"  IFV
 SG_ CAN_FR_DET_AZIMUTH_017 : 47|13@0+ (0.0007668,-3.141593) [-3.141593|3.141593] "rad"  IFV
 SG_ CAN_FR_DET_SD_AZIMUTH_017 : 50|6@0+ (0.001745329,0) [0|0.104719755] "rad"  IFV
 SG_ CAN_FR_DET_ELEVATION_017 : 60|7@0+ (0.157449,-9.99812) [-9.99812|9.997903] "deg"  IFV
 SG_ CAN_FR_DET_SD_ELEVATION_017 : 69|6@0+ (0.003490659,0) [0|0.20943951] "rad"  IFV
 SG_ CAN_FR_DET_AMPLITUDE_017 : 79|7@0+ (1,-64) [-64|63] "dBsm"  IFV
 SG_ CAN_FR_DET_VALID_FLAG_017 : 72|1@0+ (1,0) [0|1] ""  IFV
 SG_ CAN_FR_DET_SUPER_RES_017 : 80|1@0+ (1,0) [0|1] ""  IFV
 SG_ CAN_FR_DET_LOW_SNR_FLAG_017 : 81|1@0+ (1,0) [0|1] ""  IFV
 SG_ CAN_FR_DET_MIXER_BIAS_FLAG_017 : 82|1@0+ (1,0) [0|1] ""  IFV
 SG_ CAN_FR_DET_RESERVED_FLAGS_017 : 87|5@0+ (1,0) [0|31] ""  IFV
 SG_ CAN_FR_DET_SNR_017 : 95|8@0+ (0.35156,0) [0|89.6478] "dB"  IFV
 SG_ CAN_FR_DET_MULTI_TARGET_PROB_017 : 99|4@0+ (0.06667,0) [0|1] ""  IFV
 SG_ CAN_FR_DET_CONFID_AZIMUTH_017 : 101|2@0+ (1,0) [0|3] ""  IFV
 SG_ CAN_FR_DET_CONFID_ELEVATION_017 : 103|2@0+ (1,0) [0|3] ""  IFV
 SG_ CAN_FR_DET_EXISTENCE_PROB_017 : 107|4@0+ (1,0) [0|15] ""  IFV
 SG_ CAN_FR_DET_CLASS_017 : 111|4@0+ (1,0) [0|15] ""  IFV
 SG_ CAN_FR_DET_RANGE_018 : 127|14@0+ (0.015625,0) [0|255.984375] "m"  IFV
 SG_ CAN_FR_DET_SD_RANGE_018 : 129|6@0+ (0.025,0) [0|1.5] "m"  IFV
 SG_ CAN_FR_DET_RANGE_RATE_018 : 139|14@0+ (0.015625,-128) [-128|127.984375] "m/s"  IFV
 SG_ CAN_FR_DET_SD_RANGE_RATE_018 : 157|6@0+ (0.02,0) [0|1.2] "m/s"  IFV
 SG_ CAN_FR_DET_AZIMUTH_018 : 167|13@0+ (0.0007668,-3.141593) [-3.141593|3.141593] "rad"  IFV
 SG_ CAN_FR_DET_SD_AZIMUTH_018 : 170|6@0+ (0.001745329,0) [0|0.104719755] "rad"  IFV
 SG_ CAN_FR_DET_ELEVATION_018 : 180|7@0+ (0.157449,-9.99812) [-9.99812|9.997903] "deg"  IFV
 SG_ CAN_FR_DET_SD_ELEVATION_018 : 189|6@0+ (0.003490659,0) [0|0.20943951] "rad"  IFV
 SG_ CAN_FR_DET_AMPLITUDE_018 : 199|7@0+ (1,-64) [-64|63] "dBsm"  IFV
 SG_ CAN_FR_DET_VALID_FLAG_018 : 192|1@0+ (1,0) [0|1] ""  IFV
 SG_ CAN_FR_DET_SUPER_RES_018 : 200|1@0+ (1,0) [0|1] ""  IFV
 SG_ CAN_FR_DET_LOW_SNR_FLAG_018 : 201|1@0+ (1,0) [0|1] ""  IFV
 SG_ CAN_FR_DET_MIXER_BIAS_FLAG_018 : 202|1@0+ (1,0) [0|1] ""  IFV
 SG_ CAN_FR_DET_RESERVED_FLAGS_018 : 207|5@0+ (1,0) [0|31] ""  IFV
 SG_ CAN_FR_DET_SNR_018 : 215|8@0+ (0.35156,0) [0|89.6478] "dB"  IFV
 SG_ CAN_FR_DET_MULTI_TARGET_PROB_018 : 219|4@0+ (0.06667,0) [0|1] ""  IFV
 SG_ CAN_FR_DET_CONFID_AZIMUTH_018 : 221|2@0+ (1,0) [0|3] ""  IFV
 SG_ CAN_FR_DET_CONFID_ELEVATION_018 : 223|2@0+ (1,0) [0|3] ""  IFV
 SG_ CAN_FR_DET_EXISTENCE_PROB_018 : 227|4@0+ (1,0) [0|15] ""  IFV
 SG_ CAN_FR_DET_CLASS_018 : 231|4@0+ (1,0) [0|15] ""  IFV
 SG_ CAN_FR_DET_RANGE_019 : 247|14@0+ (0.015625,0) [0|255.984375] "m"  IFV
 SG_ CAN_FR_DET_SD_RANGE_019 : 249|6@0+ (0.025,0) [0|1.5] "m"  IFV
 SG_ CAN_FR_DET_RANGE_RATE_019 : 259|14@0+ (0.015625,-128) [-128|127.984375] "m/s"  IFV
 SG_ CAN_FR_DET_SD_RANGE_RATE_019 : 277|6@0+ (0.02,0) [0|1.2] "m/s"  IFV
 SG_ CAN_FR_DET_AZIMUTH_019 : 287|13@0+ (0.0007668,-3.141593) [-3.141593|3.141593] "rad"  IFV
 SG_ CAN_FR_DET_SD_AZIMUTH_019 : 290|6@0+ (0.001745329,0) [0|0.104719755] "rad"  IFV
 SG_ CAN_FR_DET_ELEVATION_019 : 300|7@0+ (0.157449,-9.99812) [-9.99812|9.997903] "deg"  IFV
 SG_ CAN_FR_DET_SD_ELEVATION_019 : 309|6@0+ (0.003490659,0) [0|0.20943951] "rad"  IFV
 SG_ CAN_FR_DET_AMPLITUDE_019 : 319|7@0+ (1,-64) [-64|63] "dBsm"  IFV
 SG_ CAN_FR_DET_VALID_FLAG_019 : 312|1@0+ (1,0) [0|1] ""  IFV
 SG_ CAN_FR_DET_SUPER_RES_019 : 320|1@0+ (1,0) [0|1] ""  IFV
 SG_ CAN_FR_DET_LOW_SNR_FLAG_019 : 321|1@0+ (1,0) [0|1] ""  IFV
 SG_ CAN_FR_DET_MIXER_BIAS_FLAG_019 : 322|1@0+ (1,0) [0|1] ""  IFV
 SG_ CAN_FR_DET_RESERVED_FLAGS_019 : 327|5@0+ (1,0) [0|31] ""  IFV
 SG_ CAN_FR_DET_SNR_019 : 335|8@0+ (0.35156,0) [0|89.6478] "dB"  IFV
 SG_ CAN_FR_DET_MULTI_TARGET_PROB_019 : 339|4@0+ (0.06667,0) [0|1] ""  IFV
 SG_ CAN_FR_DET_CONFID_AZIMUTH_019 : 341|2@0+ (1,0) [0|3] ""  IFV
 SG_ CAN_FR_DET_CONFID_ELEVATION_019 : 343|2@0+ (1,0) [0|3] ""  IFV
 SG_ CAN_FR_DET_EXISTENCE_PROB_019 : 347|4@0+ (1,0) [0|15] ""  IFV
 SG_ CAN_FR_DET_CLASS_019 : 351|4@0+ (1,0) [0|15] ""  IFV
 SG_ CAN_FR_DET_RANGE_020 : 367|14@0+ (0.015625,0) [0|255.984375] "m"  IFV
 SG_ CAN_FR_DET_SD_RANGE_020 : 369|6@0+ (0.025,0) [0|1.5] "m"  IFV
 SG_ CAN_FR_DET_RANGE_RATE_020 : 379|14@0+ (0.015625,-128) [-128|127.984375] "m/s"  IFV
 SG_ CAN_FR_DET_SD_RANGE_RATE_020 : 397|6@0+ (0.02,0) [0|1.2] "m/s"  IFV
 SG_ CAN_FR_DET_AZIMUTH_020 : 407|13@0+ (0.0007668,-3.141593) [-3.141593|3.141593] "rad"  IFV
 SG_ CAN_FR_DET_SD_AZIMUTH_020 : 410|6@0+ (0.001745329,0) [0|0.104719755] "rad"  IFV
 SG_ CAN_FR_DET_ELEVATION_020 : 420|7@0+ (0.157449,-9.99812) [-9.99812|9.997903] "deg"  IFV
 SG_ CAN_FR_DET_SD_ELEVATION_020 : 429|6@0+ (0.003490659,0) [0|0.20943951] "rad"  IFV
 SG_ CAN_FR_DET_AMPLITUDE_020 : 439|7@0+ (1,-64) [-64|63] "dBsm"  IFV
 SG_ CAN_FR_DET_VALID_FLAG_020 : 432|1@0+ (1,0) [0|1] ""  IFV
 SG_ CAN_FR_DET_SUPER_RES_020 : 440|1@0+ (1,0) [0|1] ""  IFV
 SG_ CAN_FR_DET_LOW_SNR_FLAG_020 : 441|1@0+ (1,0) [0|1] ""  IFV
 SG_ CAN_FR_DET_MIXER_BIAS_FLAG_020 : 442|1@0+ (1,0) [0|1] ""  IFV
 SG_ CAN_FR_DET_RESERVED_FLAGS_020 : 447|5@0+ (1,0) [0|31] ""  IFV
 SG_ CAN_FR_DET_SNR_020 : 455|8@0+ (0.35156,0) [0|89.6478] "dB"  IFV
 SG_ CAN_FR_DET_MULTI_TARGET_PROB_020 : 459|4@0+ (0.06667,0) [0|1] ""  IFV
 SG_ CAN_FR_DET_CONFID_AZIMUTH_020 : 461|2@0+ (1,0) [0|3] ""  IFV
 SG_ CAN_FR_DET_CONFID_ELEVATION_020 : 463|2@0+ (1,0) [0|3] ""  IFV
 SG_ CAN_FR_DET_EXISTENCE_PROB_020 : 467|4@0+ (1,0) [0|15] ""  IFV
 SG_ CAN_FR_DET_CLASS_020 : 471|4@0+ (1,0) [0|15] ""  IFV

BO_ 1029 SODFR_DETECTION_021_024: 64 SODFR
 SG_ CAN_FR_DET_RANGE_021 : 7|14@0+ (0.015625,0) [0|255.984375] "m"  IFV
 SG_ CAN_FR_DET_SD_RANGE_021 : 9|6@0+ (0.025,0) [0|1.5] "m"  IFV
 SG_ CAN_FR_DET_RANGE_RATE_021 : 19|14@0+ (0.015625,-128) [-128|127.984375] "m/s"  IFV
 SG_ CAN_FR_DET_SD_RANGE_RATE_021 : 37|6@0+ (0.02,0) [0|1.2] "m/s"  IFV
 SG_ CAN_FR_DET_AZIMUTH_021 : 47|13@0+ (0.0007668,-3.141593) [-3.141593|3.141593] "rad"  IFV
 SG_ CAN_FR_DET_SD_AZIMUTH_021 : 50|6@0+ (0.001745329,0) [0|0.104719755] "rad"  IFV
 SG_ CAN_FR_DET_ELEVATION_021 : 60|7@0+ (0.157449,-9.99812) [-9.99812|9.997903] "deg"  IFV
 SG_ CAN_FR_DET_SD_ELEVATION_021 : 69|6@0+ (0.003490659,0) [0|0.20943951] "rad"  IFV
 SG_ CAN_FR_DET_AMPLITUDE_021 : 79|7@0+ (1,-64) [-64|63] "dBsm"  IFV
 SG_ CAN_FR_DET_VALID_FLAG_021 : 72|1@0+ (1,0) [0|1] ""  IFV
 SG_ CAN_FR_DET_SUPER_RES_021 : 80|1@0+ (1,0) [0|1] ""  IFV
 SG_ CAN_FR_DET_LOW_SNR_FLAG_021 : 81|1@0+ (1,0) [0|1] ""  IFV
 SG_ CAN_FR_DET_MIXER_BIAS_FLAG_021 : 82|1@0+ (1,0) [0|1] ""  IFV
 SG_ CAN_FR_DET_RESERVED_FLAGS_021 : 87|5@0+ (1,0) [0|31] ""  IFV
 SG_ CAN_FR_DET_SNR_021 : 95|8@0+ (0.35156,0) [0|89.6478] "dB"  IFV
 SG_ CAN_FR_DET_MULTI_TARGET_PROB_021 : 99|4@0+ (0.06667,0) [0|1] ""  IFV
 SG_ CAN_FR_DET_CONFID_AZIMUTH_021 : 101|2@0+ (1,0) [0|3] ""  IFV
 SG_ CAN_FR_DET_CONFID_ELEVATION_021 : 103|2@0+ (1,0) [0|3] ""  IFV
 SG_ CAN_FR_DET_EXISTENCE_PROB_021 : 107|4@0+ (1,0) [0|15] ""  IFV
 SG_ CAN_FR_DET_CLASS_021 : 111|4@0+ (1,0) [0|15] ""  IFV
 SG_ CAN_FR_DET_RANGE_022 : 127|14@0+ (0.015625,0) [0|255.984375] "m"  IFV
 SG_ CAN_FR_DET_SD_RANGE_022 : 129|6@0+ (0.025,0) [0|1.5] "m"  IFV
 SG_ CAN_FR_DET_RANGE_RATE_022 : 139|14@0+ (0.015625,-128) [-128|127.984375] "m/s"  IFV
 SG_ CAN_FR_DET_SD_RANGE_RATE_022 : 157|6@0+ (0.02,0) [0|1.2] "m/s"  IFV
 SG_ CAN_FR_DET_AZIMUTH_022 : 167|13@0+ (0.0007668,-3.141593) [-3.141593|3.141593] "rad"  IFV
 SG_ CAN_FR_DET_SD_AZIMUTH_022 : 170|6@0+ (0.001745329,0) [0|0.104719755] "rad"  IFV
 SG_ CAN_FR_DET_ELEVATION_022 : 180|7@0+ (0.157449,-9.99812) [-9.99812|9.997903] "deg"  IFV
 SG_ CAN_FR_DET_SD_ELEVATION_022 : 189|6@0+ (0.003490659,0) [0|0.20943951] "rad"  IFV
 SG_ CAN_FR_DET_AMPLITUDE_022 : 199|7@0+ (1,-64) [-64|63] "dBsm"  IFV
 SG_ CAN_FR_DET_VALID_FLAG_022 : 192|1@0+ (1,0) [0|1] ""  IFV
 SG_ CAN_FR_DET_SUPER_RES_022 : 200|1@0+ (1,0) [0|1] ""  IFV
 SG_ CAN_FR_DET_LOW_SNR_FLAG_022 : 201|1@0+ (1,0) [0|1] ""  IFV
 SG_ CAN_FR_DET_MIXER_BIAS_FLAG_022 : 202|1@0+ (1,0) [0|1] ""  IFV
 SG_ CAN_FR_DET_RESERVED_FLAGS_022 : 207|5@0+ (1,0) [0|31] ""  IFV
 SG_ CAN_FR_DET_SNR_022 : 215|8@0+ (0.35156,0) [0|89.6478] "dB"  IFV
 SG_ CAN_FR_DET_MULTI_TARGET_PROB_022 : 219|4@0+ (0.06667,0) [0|1] ""  IFV
 SG_ CAN_FR_DET_CONFID_AZIMUTH_022 : 221|2@0+ (1,0) [0|3] ""  IFV
 SG_ CAN_FR_DET_CONFID_ELEVATION_022 : 223|2@0+ (1,0) [0|3] ""  IFV
 SG_ CAN_FR_DET_EXISTENCE_PROB_022 : 227|4@0+ (1,0) [0|15] ""  IFV
 SG_ CAN_FR_DET_CLASS_022 : 231|4@0+ (1,0) [0|15] ""  IFV
 SG_ CAN_FR_DET_RANGE_023 : 247|14@0+ (0.015625,0) [0|255.984375] "m"  IFV
 SG_ CAN_FR_DET_SD_RANGE_023 : 249|6@0+ (0.025,0) [0|1.5] "m"  IFV
 SG_ CAN_FR_DET_RANGE_RATE_023 : 259|14@0+ (0.015625,-128) [-128|127.984375] "m/s"  IFV
 SG_ CAN_FR_DET_SD_RANGE_RATE_023 : 277|6@0+ (0.02,0) [0|1.2] "m/s"  IFV
 SG_ CAN_FR_DET_AZIMUTH_023 : 287|13@0+ (0.0007668,-3.141593) [-3.141593|3.141593] "rad"  IFV
 SG_ CAN_FR_DET_SD_AZIMUTH_023 : 290|6@0+ (0.001745329,0) [0|0.104719755] "rad"  IFV
 SG_ CAN_FR_DET_ELEVATION_023 : 300|7@0+ (0.157449,-9.99812) [-9.99812|9.997903] "deg"  IFV
 SG_ CAN_FR_DET_SD_ELEVATION_023 : 309|6@0+ (0.003490659,0) [0|0.20943951] "rad"  IFV
 SG_ CAN_FR_DET_AMPLITUDE_023 : 319|7@0+ (1,-64) [-64|63] "dBsm"  IFV
 SG_ CAN_FR_DET_VALID_FLAG_023 : 312|1@0+ (1,0) [0|1] ""  IFV
 SG_ CAN_FR_DET_SUPER_RES_023 : 320|1@0+ (1,0) [0|1] ""  IFV
 SG_ CAN_FR_DET_LOW_SNR_FLAG_023 : 321|1@0+ (1,0) [0|1] ""  IFV
 SG_ CAN_FR_DET_MIXER_BIAS_FLAG_023 : 322|1@0+ (1,0) [0|1] ""  IFV
 SG_ CAN_FR_DET_RESERVED_FLAGS_023 : 327|5@0+ (1,0) [0|31] ""  IFV
 SG_ CAN_FR_DET_SNR_023 : 335|8@0+ (0.35156,0) [0|89.6478] "dB"  IFV
 SG_ CAN_FR_DET_MULTI_TARGET_PROB_023 : 339|4@0+ (0.06667,0) [0|1] ""  IFV
 SG_ CAN_FR_DET_CONFID_AZIMUTH_023 : 341|2@0+ (1,0) [0|3] ""  IFV
 SG_ CAN_FR_DET_CONFID_ELEVATION_023 : 343|2@0+ (1,0) [0|3] ""  IFV
 SG_ CAN_FR_DET_EXISTENCE_PROB_023 : 347|4@0+ (1,0) [0|15] ""  IFV
 SG_ CAN_FR_DET_CLASS_023 : 351|4@0+ (1,0) [0|15] ""  IFV
 SG_ CAN_FR_DET_RANGE_024 : 367|14@0+ (0.015625,0) [0|255.984375] "m"  IFV
 SG_ CAN_FR_DET_SD_RANGE_024 : 369|6@0+ (0.025,0) [0|1.5] "m"  IFV
 SG_ CAN_FR_DET_RANGE_RATE_024 : 379|14@0+ (0.015625,-128) [-128|127.984375] "m/s"  IFV
 SG_ CAN_FR_DET_SD_RANGE_RATE_024 : 397|6@0+ (0.02,0) [0|1.2] "m/s"  IFV
 SG_ CAN_FR_DET_AZIMUTH_024 : 407|13@0+ (0.0007668,-3.141593) [-3.141593|3.141593] "rad"  IFV
 SG_ CAN_FR_DET_SD_AZIMUTH_024 : 410|6@0+ (0.001745329,0) [0|0.104719755] "rad"  IFV
 SG_ CAN_FR_DET_ELEVATION_024 : 420|7@0+ (0.157449,-9.99812) [-9.99812|9.997903] "deg"  IFV
 SG_ CAN_FR_DET_SD_ELEVATION_024 : 429|6@0+ (0.003490659,0) [0|0.20943951] "rad"  IFV
 SG_ CAN_FR_DET_AMPLITUDE_024 : 439|7@0+ (1,-64) [-64|63] "dBsm"  IFV
 SG_ CAN_FR_DET_VALID_FLAG_024 : 432|1@0+ (1,0) [0|1] ""  IFV
 SG_ CAN_FR_DET_SUPER_RES_024 : 440|1@0+ (1,0) [0|1] ""  IFV
 SG_ CAN_FR_DET_LOW_SNR_FLAG_024 : 441|1@0+ (1,0) [0|1] ""  IFV
 SG_ CAN_FR_DET_MIXER_BIAS_FLAG_024 : 442|1@0+ (1,0) [0|1] ""  IFV
 SG_ CAN_FR_DET_RESERVED_FLAGS_024 : 447|5@0+ (1,0) [0|31] ""  IFV
 SG_ CAN_FR_DET_SNR_024 : 455|8@0+ (0.35156,0) [0|89.6478] "dB"  IFV
 SG_ CAN_FR_DET_MULTI_TARGET_PROB_024 : 459|4@0+ (0.06667,0) [0|1] ""  IFV
 SG_ CAN_FR_DET_CONFID_AZIMUTH_024 : 461|2@0+ (1,0) [0|3] ""  IFV
 SG_ CAN_FR_DET_CONFID_ELEVATION_024 : 463|2@0+ (1,0) [0|3] ""  IFV
 SG_ CAN_FR_DET_EXISTENCE_PROB_024 : 467|4@0+ (1,0) [0|15] ""  IFV
 SG_ CAN_FR_DET_CLASS_024 : 471|4@0+ (1,0) [0|15] ""  IFV

BO_ 1030 SODFR_DETECTION_025_028: 64 SODFR
 SG_ CAN_FR_DET_RANGE_025 : 7|14@0+ (0.015625,0) [0|255.984375] "m"  IFV
 SG_ CAN_FR_DET_SD_RANGE_025 : 9|6@0+ (0.025,0) [0|1.5] "m"  IFV
 SG_ CAN_FR_DET_RANGE_RATE_025 : 19|14@0+ (0.015625,-128) [-128|127.984375] "m/s"  IFV
 SG_ CAN_FR_DET_SD_RANGE_RATE_025 : 37|6@0+ (0.02,0) [0|1.2] "m/s"  IFV
 SG_ CAN_FR_DET_AZIMUTH_025 : 47|13@0+ (0.0007668,-3.141593) [-3.141593|3.141593] "rad"  IFV
 SG_ CAN_FR_DET_SD_AZIMUTH_025 : 50|6@0+ (0.001745329,0) [0|0.104719755] "rad"  IFV
 SG_ CAN_FR_DET_ELEVATION_025 : 60|7@0+ (0.157449,-9.99812) [-9.99812|9.997903] "deg"  IFV
 SG_ CAN_FR_DET_SD_ELEVATION_025 : 69|6@0+ (0.003490659,0) [0|0.20943951] "rad"  IFV
 SG_ CAN_FR_DET_AMPLITUDE_025 : 79|7@0+ (1,-64) [-64|63] "dBsm"  IFV
 SG_ CAN_FR_DET_VALID_FLAG_025 : 72|1@0+ (1,0) [0|1] ""  IFV
 SG_ CAN_FR_DET_SUPER_RES_025 : 80|1@0+ (1,0) [0|1] ""  IFV
 SG_ CAN_FR_DET_LOW_SNR_FLAG_025 : 81|1@0+ (1,0) [0|1] ""  IFV
 SG_ CAN_FR_DET_MIXER_BIAS_FLAG_025 : 82|1@0+ (1,0) [0|1] ""  IFV
 SG_ CAN_FR_DET_RESERVED_FLAGS_025 : 87|5@0+ (1,0) [0|31] ""  IFV
 SG_ CAN_FR_DET_SNR_025 : 95|8@0+ (0.35156,0) [0|89.6478] "dB"  IFV
 SG_ CAN_FR_DET_MULTI_TARGET_PROB_025 : 99|4@0+ (0.06667,0) [0|1] ""  IFV
 SG_ CAN_FR_DET_CONFID_AZIMUTH_025 : 101|2@0+ (1,0) [0|3] ""  IFV
 SG_ CAN_FR_DET_CONFID_ELEVATION_025 : 103|2@0+ (1,0) [0|3] ""  IFV
 SG_ CAN_FR_DET_EXISTENCE_PROB_025 : 107|4@0+ (1,0) [0|15] ""  IFV
 SG_ CAN_FR_DET_CLASS_025 : 111|4@0+ (1,0) [0|15] ""  IFV
 SG_ CAN_FR_DET_RANGE_026 : 127|14@0+ (0.015625,0) [0|255.984375] "m"  IFV
 SG_ CAN_FR_DET_SD_RANGE_026 : 129|6@0+ (0.025,0) [0|1.5] "m"  IFV
 SG_ CAN_FR_DET_RANGE_RATE_026 : 139|14@0+ (0.015625,-128) [-128|127.984375] "m/s"  IFV
 SG_ CAN_FR_DET_SD_RANGE_RATE_026 : 157|6@0+ (0.02,0) [0|1.2] "m/s"  IFV
 SG_ CAN_FR_DET_AZIMUTH_026 : 167|13@0+ (0.0007668,-3.141593) [-3.141593|3.141593] "rad"  IFV
 SG_ CAN_FR_DET_SD_AZIMUTH_026 : 170|6@0+ (0.001745329,0) [0|0.104719755] "rad"  IFV
 SG_ CAN_FR_DET_ELEVATION_026 : 180|7@0+ (0.157449,-9.99812) [-9.99812|9.997903] "deg"  IFV
 SG_ CAN_FR_DET_SD_ELEVATION_026 : 189|6@0+ (0.003490659,0) [0|0.20943951] "rad"  IFV
 SG_ CAN_FR_DET_AMPLITUDE_026 : 199|7@0+ (1,-64) [-64|63] "dBsm"  IFV
 SG_ CAN_FR_DET_VALID_FLAG_026 : 192|1@0+ (1,0) [0|1] ""  IFV
 SG_ CAN_FR_DET_SUPER_RES_026 : 200|1@0+ (1,0) [0|1] ""  IFV
 SG_ CAN_FR_DET_LOW_SNR_FLAG_026 : 201|1@0+ (1,0) [0|1] ""  IFV
 SG_ CAN_FR_DET_MIXER_BIAS_FLAG_026 : 202|1@0+ (1,0) [0|1] ""  IFV
 SG_ CAN_FR_DET_RESERVED_FLAGS_026 : 207|5@0+ (1,0) [0|31] ""  IFV
 SG_ CAN_FR_DET_SNR_026 : 215|8@0+ (0.35156,0) [0|89.6478] "dB"  IFV
 SG_ CAN_FR_DET_MULTI_TARGET_PROB_026 : 219|4@0+ (0.06667,0) [0|1] ""  IFV
 SG_ CAN_FR_DET_CONFID_AZIMUTH_026 : 221|2@0+ (1,0) [0|3] ""  IFV
 SG_ CAN_FR_DET_CONFID_ELEVATION_026 : 223|2@0+ (1,0) [0|3] ""  IFV
 SG_ CAN_FR_DET_EXISTENCE_PROB_026 : 227|4@0+ (1,0) [0|15] ""  IFV
 SG_ CAN_FR_DET_CLASS_026 : 231|4@0+ (1,0) [0|15] ""  IFV
 SG_ CAN_FR_DET_RANGE_027 : 247|14@0+ (0.015625,0) [0|255.984375] "m"  IFV
 SG_ CAN_FR_DET_SD_RANGE_027 : 249|6@0+ (0.025,0) [0|1.5] "m"  IFV
 SG_ CAN_FR_DET_RANGE_RATE_027 : 259|14@0+ (0.015625,-128) [-128|127.984375] "m/s"  IFV
 SG_ CAN_FR_DET_SD_RANGE_RATE_027 : 277|6@0+ (0.02,0) [0|1.2] "m/s"  IFV
 SG_ CAN_FR_DET_AZIMUTH_027 : 287|13@0+ (0.0007668,-3.141593) [-3.141593|3.141593] "rad"  IFV
 SG_ CAN_FR_DET_SD_AZIMUTH_027 : 290|6@0+ (0.001745329,0) [0|0.104719755] "rad"  IFV
 SG_ CAN_FR_DET_ELEVATION_027 : 300|7@0+ (0.157449,-9.99812) [-9.99812|9.997903] "deg"  IFV
 SG_ CAN_FR_DET_SD_ELEVATION_027 : 309|6@0+ (0.003490659,0) [0|0.20943951] "rad"  IFV
 SG_ CAN_FR_DET_AMPLITUDE_027 : 319|7@0+ (1,-64) [-64|63] "dBsm"  IFV
 SG_ CAN_FR_DET_VALID_FLAG_027 : 312|1@0+ (1,0) [0|1] ""  IFV
 SG_ CAN_FR_DET_SUPER_RES_027 : 320|1@0+ (1,0) [0|1] ""  IFV
 SG_ CAN_FR_DET_LOW_SNR_FLAG_027 : 321|1@0+ (1,0) [0|1] ""  IFV
 SG_ CAN_FR_DET_MIXER_BIAS_FLAG_027 : 322|1@0+ (1,0) [0|1] ""  IFV
 SG_ CAN_FR_DET_RESERVED_FLAGS_027 : 327|5@0+ (1,0) [0|31] ""  IFV
 SG_ CAN_FR_DET_SNR_027 : 335|8@0+ (0.35156,0) [0|89.6478] "dB"  IFV
 SG_ CAN_FR_DET_MULTI_TARGET_PROB_027 : 339|4@0+ (0.06667,0) [0|1] ""  IFV
 SG_ CAN_FR_DET_CONFID_AZIMUTH_027 : 341|2@0+ (1,0) [0|3] ""  IFV
 SG_ CAN_FR_DET_CONFID_ELEVATION_027 : 343|2@0+ (1,0) [0|3] ""  IFV
 SG_ CAN_FR_DET_EXISTENCE_PROB_027 : 347|4@0+ (1,0) [0|15] ""  IFV
 SG_ CAN_FR_DET_CLASS_027 : 351|4@0+ (1,0) [0|15] ""  IFV
 SG_ CAN_FR_DET_RANGE_028 : 367|14@0+ (0.015625,0) [0|255.984375] "m"  IFV
 SG_ CAN_FR_DET_SD_RANGE_028 : 369|6@0+ (0.025,0) [0|1.5] "m"  IFV
 SG_ CAN_FR_DET_RANGE_RATE_028 : 379|14@0+ (0.015625,-128) [-128|127.984375] "m/s"  IFV
 SG_ CAN_FR_DET_SD_RANGE_RATE_028 : 397|6@0+ (0.02,0) [0|1.2] "m/s"  IFV
 SG_ CAN_FR_DET_AZIMUTH_028 : 407|13@0+ (0.0007668,-3.141593) [-3.141593|3.141593] "rad"  IFV
 SG_ CAN_FR_DET_SD_AZIMUTH_028 : 410|6@0+ (0.001745329,0) [0|0.104719755] "rad"  IFV
 SG_ CAN_FR_DET_ELEVATION_028 : 420|7@0+ (0.157449,-9.99812) [-9.99812|9.997903] "deg"  IFV
 SG_ CAN_FR_DET_SD_ELEVATION_028 : 429|6@0+ (0.003490659,0) [0|0.20943951] "rad"  IFV
 SG_ CAN_FR_DET_AMPLITUDE_028 : 439|7@0+ (1,-64) [-64|63] "dBsm"  IFV
 SG_ CAN_FR_DET_VALID_FLAG_028 : 432|1@0+ (1,0) [0|1] ""  IFV
 SG_ CAN_FR_DET_SUPER_RES_028 : 440|1@0+ (1,0) [0|1] ""  IFV
 SG_ CAN_FR_DET_LOW_SNR_FLAG_028 : 441|1@0+ (1,0) [0|1] ""  IFV
 SG_ CAN_FR_DET_MIXER_BIAS_FLAG_028 : 442|1@0+ (1,0) [0|1] ""  IFV
 SG_ CAN_FR_DET_RESERVED_FLAGS_028 : 447|5@0+ (1,0) [0|31] ""  IFV
 SG_ CAN_FR_DET_SNR_028 : 455|8@0+ (0.35156,0) [0|89.6478] "dB"  IFV
 SG_ CAN_FR_DET_MULTI_TARGET_PROB_028 : 459|4@0+ (0.06667,0) [0|1] ""  IFV
 SG_ CAN_FR_DET_CONFID_AZIMUTH_028 : 461|2@0+ (1,0) [0|3] ""  IFV
 SG_ CAN_FR_DET_CONFID_ELEVATION_028 : 463|2@0+ (1,0) [0|3] ""  IFV
 SG_ CAN_FR_DET_EXISTENCE_PROB_028 : 467|4@0+ (1,0) [0|15] ""  IFV
 SG_ CAN_FR_DET_CLASS_028 : 471|4@0+ (1,0) [0|15] ""  IFV

BO_ 1031 SODFR_DETECTION_029_032: 64 SODFR
 SG_ CAN_FR_DET_RANGE_029 : 7|14@0+ (0.015625,0) [0|255.984375] "m"  IFV
 SG_ CAN_FR_DET_SD_RANGE_029 : 9|6@0+ (0.025,0) [0|1.5] "m"  IFV
 SG_ CAN_FR_DET_RANGE_RATE_029 : 19|14@0+ (0.015625,-128) [-128|127.984375] "m/s"  IFV
 SG_ CAN_FR_DET_SD_RANGE_RATE_029 : 37|6@0+ (0.02,0) [0|1.2] "m/s"  IFV
 SG_ CAN_FR_DET_AZIMUTH_029 : 47|13@0+ (0.0007668,-3.141593) [-3.141593|3.141593] "rad"  IFV
 SG_ CAN_FR_DET_SD_AZIMUTH_029 : 50|6@0+ (0.001745329,0) [0|0.104719755] "rad"  IFV
 SG_ CAN_FR_DET_ELEVATION_029 : 60|7@0+ (0.157449,-9.99812) [-9.99812|9.997903] "deg"  IFV
 SG_ CAN_FR_DET_SD_ELEVATION_029 : 69|6@0+ (0.003490659,0) [0|0.20943951] "rad"  IFV
 SG_ CAN_FR_DET_AMPLITUDE_029 : 79|7@0+ (1,-64) [-64|63] "dBsm"  IFV
 SG_ CAN_FR_DET_VALID_FLAG_029 : 72|1@0+ (1,0) [0|1] ""  IFV
 SG_ CAN_FR_DET_SUPER_RES_029 : 80|1@0+ (1,0) [0|1] ""  IFV
 SG_ CAN_FR_DET_LOW_SNR_FLAG_029 : 81|1@0+ (1,0) [0|1] ""  IFV
 SG_ CAN_FR_DET_MIXER_BIAS_FLAG_029 : 82|1@0+ (1,0) [0|1] ""  IFV
 SG_ CAN_FR_DET_RESERVED_FLAGS_029 : 87|5@0+ (1,0) [0|31] ""  IFV
 SG_ CAN_FR_DET_SNR_029 : 95|8@0+ (0.35156,0) [0|89.6478] "dB"  IFV
 SG_ CAN_FR_DET_MULTI_TARGET_PROB_029 : 99|4@0+ (0.06667,0) [0|1] ""  IFV
 SG_ CAN_FR_DET_CONFID_AZIMUTH_029 : 101|2@0+ (1,0) [0|3] ""  IFV
 SG_ CAN_FR_DET_CONFID_ELEVATION_029 : 103|2@0+ (1,0) [0|3] ""  IFV
 SG_ CAN_FR_DET_EXISTENCE_PROB_029 : 107|4@0+ (1,0) [0|15] ""  IFV
 SG_ CAN_FR_DET_CLASS_029 : 111|4@0+ (1,0) [0|15] ""  IFV
 SG_ CAN_FR_DET_RANGE_030 : 127|14@0+ (0.015625,0) [0|255.984375] "m"  IFV
 SG_ CAN_FR_DET_SD_RANGE_030 : 129|6@0+ (0.025,0) [0|1.5] "m"  IFV
 SG_ CAN_FR_DET_RANGE_RATE_030 : 139|14@0+ (0.015625,-128) [-128|127.984375] "m/s"  IFV
 SG_ CAN_FR_DET_SD_RANGE_RATE_030 : 157|6@0+ (0.02,0) [0|1.2] "m/s"  IFV
 SG_ CAN_FR_DET_AZIMUTH_030 : 167|13@0+ (0.0007668,-3.141593) [-3.141593|3.141593] "rad"  IFV
 SG_ CAN_FR_DET_SD_AZIMUTH_030 : 170|6@0+ (0.001745329,0) [0|0.104719755] "rad"  IFV
 SG_ CAN_FR_DET_ELEVATION_030 : 180|7@0+ (0.157449,-9.99812) [-9.99812|9.997903] "deg"  IFV
 SG_ CAN_FR_DET_SD_ELEVATION_030 : 189|6@0+ (0.003490659,0) [0|0.20943951] "rad"  IFV
 SG_ CAN_FR_DET_AMPLITUDE_030 : 199|7@0+ (1,-64) [-64|63] "dBsm"  IFV
 SG_ CAN_FR_DET_VALID_FLAG_030 : 192|1@0+ (1,0) [0|1] ""  IFV
 SG_ CAN_FR_DET_SUPER_RES_030 : 200|1@0+ (1,0) [0|1] ""  IFV
 SG_ CAN_FR_DET_LOW_SNR_FLAG_030 : 201|1@0+ (1,0) [0|1] ""  IFV
 SG_ CAN_FR_DET_MIXER_BIAS_FLAG_030 : 202|1@0+ (1,0) [0|1] ""  IFV
 SG_ CAN_FR_DET_RESERVED_FLAGS_030 : 207|5@0+ (1,0) [0|31] ""  IFV
 SG_ CAN_FR_DET_SNR_030 : 215|8@0+ (0.35156,0) [0|89.6478] "dB"  IFV
 SG_ CAN_FR_DET_MULTI_TARGET_PROB_030 : 219|4@0+ (0.06667,0) [0|1] ""  IFV
 SG_ CAN_FR_DET_CONFID_AZIMUTH_030 : 221|2@0+ (1,0) [0|3] ""  IFV
 SG_ CAN_FR_DET_CONFID_ELEVATION_030 : 223|2@0+ (1,0) [0|3] ""  IFV
 SG_ CAN_FR_DET_EXISTENCE_PROB_030 : 227|4@0+ (1,0) [0|15] ""  IFV
 SG_ CAN_FR_DET_CLASS_030 : 231|4@0+ (1,0) [0|15] ""  IFV
 SG_ CAN_FR_DET_RANGE_031 : 247|14@0+ (0.015625,0) [0|255.984375] "m"  IFV
 SG_ CAN_FR_DET_SD_RANGE_031 : 249|6@0+ (0.025,0) [0|1.5] "m"  IFV
 SG_ CAN_FR_DET_RANGE_RATE_031 : 259|14@0+ (0.015625,-128) [-128|127.984375] "m/s"  IFV
 SG_ CAN_FR_DET_SD_RANGE_RATE_031 : 277|6@0+ (0.02,0) [0|1.2] "m/s"  IFV
 SG_ CAN_FR_DET_AZIMUTH_031 : 287|13@0+ (0.0007668,-3.141593) [-3.141593|3.141593] "rad"  IFV
 SG_ CAN_FR_DET_SD_AZIMUTH_031 : 290|6@0+ (0.001745329,0) [0|0.104719755] "rad"  IFV
 SG_ CAN_FR_DET_ELEVATION_031 : 300|7@0+ (0.157449,-9.99812) [-9.99812|9.997903] "deg"  IFV
 SG_ CAN_FR_DET_SD_ELEVATION_031 : 309|6@0+ (0.003490659,0) [0|0.20943951] "rad"  IFV
 SG_ CAN_FR_DET_AMPLITUDE_031 : 319|7@0+ (1,-64) [-64|63] "dBsm"  IFV
 SG_ CAN_FR_DET_VALID_FLAG_031 : 312|1@0+ (1,0) [0|1] ""  IFV
 SG_ CAN_FR_DET_SUPER_RES_031 : 320|1@0+ (1,0) [0|1] ""  IFV
 SG_ CAN_FR_DET_LOW_SNR_FLAG_031 : 321|1@0+ (1,0) [0|1] ""  IFV
 SG_ CAN_FR_DET_MIXER_BIAS_FLAG_031 : 322|1@0+ (1,0) [0|1] ""  IFV
 SG_ CAN_FR_DET_RESERVED_FLAGS_031 : 327|5@0+ (1,0) [0|31] ""  IFV
 SG_ CAN_FR_DET_SNR_031 : 335|8@0+ (0.35156,0) [0|89.6478] "dB"  IFV
 SG_ CAN_FR_DET_MULTI_TARGET_PROB_031 : 339|4@0+ (0.06667,0) [0|1] ""  IFV
 SG_ CAN_FR_DET_CONFID_AZIMUTH_031 : 341|2@0+ (1,0) [0|3] ""  IFV
 SG_ CAN_FR_DET_CONFID_ELEVATION_031 : 343|2@0+ (1,0) [0|3] ""  IFV
 SG_ CAN_FR_DET_EXISTENCE_PROB_031 : 347|4@0+ (1,0) [0|15] ""  IFV
 SG_ CAN_FR_DET_CLASS_031 : 351|4@0+ (1,0) [0|15] ""  IFV
 SG_ CAN_FR_DET_RANGE_032 : 367|14@0+ (0.015625,0) [0|255.984375] "m"  IFV
 SG_ CAN_FR_DET_SD_RANGE_032 : 369|6@0+ (0.025,0) [0|1.5] "m"  IFV
 SG_ CAN_FR_DET_RANGE_RATE_032 : 379|14@0+ (0.015625,-128) [-128|127.984375] "m/s"  IFV
 SG_ CAN_FR_DET_SD_RANGE_RATE_032 : 397|6@0+ (0.02,0) [0|1.2] "m/s"  IFV
 SG_ CAN_FR_DET_AZIMUTH_032 : 407|13@0+ (0.0007668,-3.141593) [-3.141593|3.141593] "rad"  IFV
 SG_ CAN_FR_DET_SD_AZIMUTH_032 : 410|6@0+ (0.001745329,0) [0|0.104719755] "rad"  IFV
 SG_ CAN_FR_DET_ELEVATION_032 : 420|7@0+ (0.157449,-9.99812) [-9.99812|9.997903] "deg"  IFV
 SG_ CAN_FR_DET_SD_ELEVATION_032 : 429|6@0+ (0.003490659,0) [0|0.20943951] "rad"  IFV
 SG_ CAN_FR_DET_AMPLITUDE_032 : 439|7@0+ (1,-64) [-64|63] "dBsm"  IFV
 SG_ CAN_FR_DET_VALID_FLAG_032 : 432|1@0+ (1,0) [0|1] ""  IFV
 SG_ CAN_FR_DET_SUPER_RES_032 : 440|1@0+ (1,0) [0|1] ""  IFV
 SG_ CAN_FR_DET_LOW_SNR_FLAG_032 : 441|1@0+ (1,0) [0|1] ""  IFV
 SG_ CAN_FR_DET_MIXER_BIAS_FLAG_032 : 442|1@0+ (1,0) [0|1] ""  IFV
 SG_ CAN_FR_DET_RESERVED_FLAGS_032 : 447|5@0+ (1,0) [0|31] ""  IFV
 SG_ CAN_FR_DET_SNR_032 : 455|8@0+ (0.35156,0) [0|89.6478] "dB"  IFV
 SG_ CAN_FR_DET_MULTI_TARGET_PROB_032 : 459|4@0+ (0.06667,0) [0|1] ""  IFV
 SG_ CAN_FR_DET_CONFID_AZIMUTH_032 : 461|2@0+ (1,0) [0|3] ""  IFV
 SG_ CAN_FR_DET_CONFID_ELEVATION_032 : 463|2@0+ (1,0) [0|3] ""  IFV
 SG_ CAN_FR_DET_EXISTENCE_PROB_032 : 467|4@0+ (1,0) [0|15] ""  IFV
 SG_ CAN_FR_DET_CLASS_032 : 471|4@0+ (1,0) [0|15] ""  IFV

BO_ 1032 SODFR_DETECTION_033_036: 64 SODFR
 SG_ CAN_FR_DET_RANGE_033 : 7|14@0+ (0.015625,0) [0|255.984375] "m"  IFV
 SG_ CAN_FR_DET_SD_RANGE_033 : 9|6@0+ (0.025,0) [0|1.5] "m"  IFV
 SG_ CAN_FR_DET_RANGE_RATE_033 : 19|14@0+ (0.015625,-128) [-128|127.984375] "m/s"  IFV
 SG_ CAN_FR_DET_SD_RANGE_RATE_033 : 37|6@0+ (0.02,0) [0|1.2] "m/s"  IFV
 SG_ CAN_FR_DET_AZIMUTH_033 : 47|13@0+ (0.0007668,-3.141593) [-3.141593|3.141593] "rad"  IFV
 SG_ CAN_FR_DET_SD_AZIMUTH_033 : 50|6@0+ (0.001745329,0) [0|0.104719755] "rad"  IFV
 SG_ CAN_FR_DET_ELEVATION_033 : 60|7@0+ (0.157449,-9.99812) [-9.99812|9.997903] "deg"  IFV
 SG_ CAN_FR_DET_SD_ELEVATION_033 : 69|6@0+ (0.003490659,0) [0|0.20943951] "rad"  IFV
 SG_ CAN_FR_DET_AMPLITUDE_033 : 79|7@0+ (1,-64) [-64|63] "dBsm"  IFV
 SG_ CAN_FR_DET_VALID_FLAG_033 : 72|1@0+ (1,0) [0|1] ""  IFV
 SG_ CAN_FR_DET_SUPER_RES_033 : 80|1@0+ (1,0) [0|1] ""  IFV
 SG_ CAN_FR_DET_LOW_SNR_FLAG_033 : 81|1@0+ (1,0) [0|1] ""  IFV
 SG_ CAN_FR_DET_MIXER_BIAS_FLAG_033 : 82|1@0+ (1,0) [0|1] ""  IFV
 SG_ CAN_FR_DET_RESERVED_FLAGS_033 : 87|5@0+ (1,0) [0|31] ""  IFV
 SG_ CAN_FR_DET_SNR_033 : 95|8@0+ (0.35156,0) [0|89.6478] "dB"  IFV
 SG_ CAN_FR_DET_MULTI_TARGET_PROB_033 : 99|4@0+ (0.06667,0) [0|1] ""  IFV
 SG_ CAN_FR_DET_CONFID_AZIMUTH_033 : 101|2@0+ (1,0) [0|3] ""  IFV
 SG_ CAN_FR_DET_CONFID_ELEVATION_033 : 103|2@0+ (1,0) [0|3] ""  IFV
 SG_ CAN_FR_DET_EXISTENCE_PROB_033 : 107|4@0+ (1,0) [0|15] ""  IFV
 SG_ CAN_FR_DET_CLASS_033 : 111|4@0+ (1,0) [0|15] ""  IFV
 SG_ CAN_FR_DET_RANGE_034 : 127|14@0+ (0.015625,0) [0|255.984375] "m"  IFV
 SG_ CAN_FR_DET_SD_RANGE_034 : 129|6@0+ (0.025,0) [0|1.5] "m"  IFV
 SG_ CAN_FR_DET_RANGE_RATE_034 : 139|14@0+ (0.015625,-128) [-128|127.984375] "m/s"  IFV
 SG_ CAN_FR_DET_SD_RANGE_RATE_034 : 157|6@0+ (0.02,0) [0|1.2] "m/s"  IFV
 SG_ CAN_FR_DET_AZIMUTH_034 : 167|13@0+ (0.0007668,-3.141593) [-3.141593|3.141593] "rad"  IFV
 SG_ CAN_FR_DET_SD_AZIMUTH_034 : 170|6@0+ (0.001745329,0) [0|0.104719755] "rad"  IFV
 SG_ CAN_FR_DET_ELEVATION_034 : 180|7@0+ (0.157449,-9.99812) [-9.99812|9.997903] "deg"  IFV
 SG_ CAN_FR_DET_SD_ELEVATION_034 : 189|6@0+ (0.003490659,0) [0|0.20943951] "rad"  IFV
 SG_ CAN_FR_DET_AMPLITUDE_034 : 199|7@0+ (1,-64) [-64|63] "dBsm"  IFV
 SG_ CAN_FR_DET_VALID_FLAG_034 : 192|1@0+ (1,0) [0|1] ""  IFV
 SG_ CAN_FR_DET_SUPER_RES_034 : 200|1@0+ (1,0) [0|1] ""  IFV
 SG_ CAN_FR_DET_LOW_SNR_FLAG_034 : 201|1@0+ (1,0) [0|1] ""  IFV
 SG_ CAN_FR_DET_MIXER_BIAS_FLAG_034 : 202|1@0+ (1,0) [0|1] ""  IFV
 SG_ CAN_FR_DET_RESERVED_FLAGS_034 : 207|5@0+ (1,0) [0|31] ""  IFV
 SG_ CAN_FR_DET_SNR_034 : 215|8@0+ (0.35156,0) [0|89.6478] "dB"  IFV
 SG_ CAN_FR_DET_MULTI_TARGET_PROB_034 : 219|4@0+ (0.06667,0) [0|1] ""  IFV
 SG_ CAN_FR_DET_CONFID_AZIMUTH_034 : 221|2@0+ (1,0) [0|3] ""  IFV
 SG_ CAN_FR_DET_CONFID_ELEVATION_034 : 223|2@0+ (1,0) [0|3] ""  IFV
 SG_ CAN_FR_DET_EXISTENCE_PROB_034 : 227|4@0+ (1,0) [0|15] ""  IFV
 SG_ CAN_FR_DET_CLASS_034 : 231|4@0+ (1,0) [0|15] ""  IFV
 SG_ CAN_FR_DET_RANGE_035 : 247|14@0+ (0.015625,0) [0|255.984375] "m"  IFV
 SG_ CAN_FR_DET_SD_RANGE_035 : 249|6@0+ (0.025,0) [0|1.5] "m"  IFV
 SG_ CAN_FR_DET_RANGE_RATE_035 : 259|14@0+ (0.015625,-128) [-128|127.984375] "m/s"  IFV
 SG_ CAN_FR_DET_SD_RANGE_RATE_035 : 277|6@0+ (0.02,0) [0|1.2] "m/s"  IFV
 SG_ CAN_FR_DET_AZIMUTH_035 : 287|13@0+ (0.0007668,-3.141593) [-3.141593|3.141593] "rad"  IFV
 SG_ CAN_FR_DET_SD_AZIMUTH_035 : 290|6@0+ (0.001745329,0) [0|0.104719755] "rad"  IFV
 SG_ CAN_FR_DET_ELEVATION_035 : 300|7@0+ (0.157449,-9.99812) [-9.99812|9.997903] "deg"  IFV
 SG_ CAN_FR_DET_SD_ELEVATION_035 : 309|6@0+ (0.003490659,0) [0|0.20943951] "rad"  IFV
 SG_ CAN_FR_DET_AMPLITUDE_035 : 319|7@0+ (1,-64) [-64|63] "dBsm"  IFV
 SG_ CAN_FR_DET_VALID_FLAG_035 : 312|1@0+ (1,0) [0|1] ""  IFV
 SG_ CAN_FR_DET_SUPER_RES_035 : 320|1@0+ (1,0) [0|1] ""  IFV
 SG_ CAN_FR_DET_LOW_SNR_FLAG_035 : 321|1@0+ (1,0) [0|1] ""  IFV
 SG_ CAN_FR_DET_MIXER_BIAS_FLAG_035 : 322|1@0+ (1,0) [0|1] ""  IFV
 SG_ CAN_FR_DET_RESERVED_FLAGS_035 : 327|5@0+ (1,0) [0|31] ""  IFV
 SG_ CAN_FR_DET_SNR_035 : 335|8@0+ (0.35156,0) [0|89.6478] "dB"  IFV
 SG_ CAN_FR_DET_MULTI_TARGET_PROB_035 : 339|4@0+ (0.06667,0) [0|1] ""  IFV
 SG_ CAN_FR_DET_CONFID_AZIMUTH_035 : 341|2@0+ (1,0) [0|3] ""  IFV
 SG_ CAN_FR_DET_CONFID_ELEVATION_035 : 343|2@0+ (1,0) [0|3] ""  IFV
 SG_ CAN_FR_DET_EXISTENCE_PROB_035 : 347|4@0+ (1,0) [0|15] ""  IFV
 SG_ CAN_FR_DET_CLASS_035 : 351|4@0+ (1,0) [0|15] ""  IFV
 SG_ CAN_FR_DET_RANGE_036 : 367|14@0+ (0.015625,0) [0|255.984375] "m"  IFV
 SG_ CAN_FR_DET_SD_RANGE_036 : 369|6@0+ (0.025,0) [0|1.5] "m"  IFV
 SG_ CAN_FR_DET_RANGE_RATE_036 : 379|14@0+ (0.015625,-128) [-128|127.984375] "m/s"  IFV
 SG_ CAN_FR_DET_SD_RANGE_RATE_036 : 397|6@0+ (0.02,0) [0|1.2] "m/s"  IFV
 SG_ CAN_FR_DET_AZIMUTH_036 : 407|13@0+ (0.0007668,-3.141593) [-3.141593|3.141593] "rad"  IFV
 SG_ CAN_FR_DET_SD_AZIMUTH_036 : 410|6@0+ (0.001745329,0) [0|0.104719755] "rad"  IFV
 SG_ CAN_FR_DET_ELEVATION_036 : 420|7@0+ (0.157449,-9.99812) [-9.99812|9.997903] "deg"  IFV
 SG_ CAN_FR_DET_SD_ELEVATION_036 : 429|6@0+ (0.003490659,0) [0|0.20943951] "rad"  IFV
 SG_ CAN_FR_DET_AMPLITUDE_036 : 439|7@0+ (1,-64) [-64|63] "dBsm"  IFV
 SG_ CAN_FR_DET_VALID_FLAG_036 : 432|1@0+ (1,0) [0|1] ""  IFV
 SG_ CAN_FR_DET_SUPER_RES_036 : 440|1@0+ (1,0) [0|1] ""  IFV
 SG_ CAN_FR_DET_LOW_SNR_FLAG_036 : 441|1@0+ (1,0) [0|1] ""  IFV
 SG_ CAN_FR_DET_MIXER_BIAS_FLAG_036 : 442|1@0+ (1,0) [0|1] ""  IFV
 SG_ CAN_FR_DET_RESERVED_FLAGS_036 : 447|5@0+ (1,0) [0|31] ""  IFV
 SG_ CAN_FR_DET_SNR_036 : 455|8@0+ (0.35156,0) [0|89.6478] "dB"  IFV
 SG_ CAN_FR_DET_MULTI_TARGET_PROB_036 : 459|4@0+ (0.06667,0) [0|1] ""  IFV
 SG_ CAN_FR_DET_CONFID_AZIMUTH_036 : 461|2@0+ (1,0) [0|3] ""  IFV
 SG_ CAN_FR_DET_CONFID_ELEVATION_036 : 463|2@0+ (1,0) [0|3] ""  IFV
 SG_ CAN_FR_DET_EXISTENCE_PROB_036 : 467|4@0+ (1,0) [0|15] ""  IFV
 SG_ CAN_FR_DET_CLASS_036 : 471|4@0+ (1,0) [0|15] ""  IFV

BO_ 1033 SODFR_DETECTION_037_040: 64 SODFR
 SG_ CAN_FR_DET_RANGE_037 : 7|14@0+ (0.015625,0) [0|255.984375] "m"  IFV
 SG_ CAN_FR_DET_SD_RANGE_037 : 9|6@0+ (0.025,0) [0|1.5] "m"  IFV
 SG_ CAN_FR_DET_RANGE_RATE_037 : 19|14@0+ (0.015625,-128) [-128|127.984375] "m/s"  IFV
 SG_ CAN_FR_DET_SD_RANGE_RATE_037 : 37|6@0+ (0.02,0) [0|1.2] "m/s"  IFV
 SG_ CAN_FR_DET_AZIMUTH_037 : 47|13@0+ (0.0007668,-3.141593) [-3.141593|3.141593] "rad"  IFV
 SG_ CAN_FR_DET_SD_AZIMUTH_037 : 50|6@0+ (0.001745329,0) [0|0.104719755] "rad"  IFV
 SG_ CAN_FR_DET_ELEVATION_037 : 60|7@0+ (0.157449,-9.99812) [-9.99812|9.997903] "deg"  IFV
 SG_ CAN_FR_DET_SD_ELEVATION_037 : 69|6@0+ (0.003490659,0) [0|0.20943951] "rad"  IFV
 SG_ CAN_FR_DET_AMPLITUDE_037 : 79|7@0+ (1,-64) [-64|63] "dBsm"  IFV
 SG_ CAN_FR_DET_VALID_FLAG_037 : 72|1@0+ (1,0) [0|1] ""  IFV
 SG_ CAN_FR_DET_SUPER_RES_037 : 80|1@0+ (1,0) [0|1] ""  IFV
 SG_ CAN_FR_DET_LOW_SNR_FLAG_037 : 81|1@0+ (1,0) [0|1] ""  IFV
 SG_ CAN_FR_DET_MIXER_BIAS_FLAG_037 : 82|1@0+ (1,0) [0|1] ""  IFV
 SG_ CAN_FR_DET_RESERVED_FLAGS_037 : 87|5@0+ (1,0) [0|31] ""  IFV
 SG_ CAN_FR_DET_SNR_037 : 95|8@0+ (0.35156,0) [0|89.6478] "dB"  IFV
 SG_ CAN_FR_DET_MULTI_TARGET_PROB_037 : 99|4@0+ (0.06667,0) [0|1] ""  IFV
 SG_ CAN_FR_DET_CONFID_AZIMUTH_037 : 101|2@0+ (1,0) [0|3] ""  IFV
 SG_ CAN_FR_DET_CONFID_ELEVATION_037 : 103|2@0+ (1,0) [0|3] ""  IFV
 SG_ CAN_FR_DET_EXISTENCE_PROB_037 : 107|4@0+ (1,0) [0|15] ""  IFV
 SG_ CAN_FR_DET_CLASS_037 : 111|4@0+ (1,0) [0|15] ""  IFV
 SG_ CAN_FR_DET_RANGE_038 : 127|14@0+ (0.015625,0) [0|255.984375] "m"  IFV
 SG_ CAN_FR_DET_SD_RANGE_038 : 129|6@0+ (0.025,0) [0|1.5] "m"  IFV
 SG_ CAN_FR_DET_RANGE_RATE_038 : 139|14@0+ (0.015625,-128) [-128|127.984375] "m/s"  IFV
 SG_ CAN_FR_DET_SD_RANGE_RATE_038 : 157|6@0+ (0.02,0) [0|1.2] "m/s"  IFV
 SG_ CAN_FR_DET_AZIMUTH_038 : 167|13@0+ (0.0007668,-3.141593) [-3.141593|3.141593] "rad"  IFV
 SG_ CAN_FR_DET_SD_AZIMUTH_038 : 170|6@0+ (0.001745329,0) [0|0.104719755] "rad"  IFV
 SG_ CAN_FR_DET_ELEVATION_038 : 180|7@0+ (0.157449,-9.99812) [-9.99812|9.997903] "deg"  IFV
 SG_ CAN_FR_DET_SD_ELEVATION_038 : 189|6@0+ (0.003490659,0) [0|0.20943951] "rad"  IFV
 SG_ CAN_FR_DET_AMPLITUDE_038 : 199|7@0+ (1,-64) [-64|63] "dBsm"  IFV
 SG_ CAN_FR_DET_VALID_FLAG_038 : 192|1@0+ (1,0) [0|1] ""  IFV
 SG_ CAN_FR_DET_SUPER_RES_038 : 200|1@0+ (1,0) [0|1] ""  IFV
 SG_ CAN_FR_DET_LOW_SNR_FLAG_038 : 201|1@0+ (1,0) [0|1] ""  IFV
 SG_ CAN_FR_DET_MIXER_BIAS_FLAG_038 : 202|1@0+ (1,0) [0|1] ""  IFV
 SG_ CAN_FR_DET_RESERVED_FLAGS_038 : 207|5@0+ (1,0) [0|31] ""  IFV
 SG_ CAN_FR_DET_SNR_038 : 215|8@0+ (0.35156,0) [0|89.6478] "dB"  IFV
 SG_ CAN_FR_DET_MULTI_TARGET_PROB_038 : 219|4@0+ (0.06667,0) [0|1] ""  IFV
 SG_ CAN_FR_DET_CONFID_AZIMUTH_038 : 221|2@0+ (1,0) [0|3] ""  IFV
 SG_ CAN_FR_DET_CONFID_ELEVATION_038 : 223|2@0+ (1,0) [0|3] ""  IFV
 SG_ CAN_FR_DET_EXISTENCE_PROB_038 : 227|4@0+ (1,0) [0|15] ""  IFV
 SG_ CAN_FR_DET_CLASS_038 : 231|4@0+ (1,0) [0|15] ""  IFV
 SG_ CAN_FR_DET_RANGE_039 : 247|14@0+ (0.015625,0) [0|255.984375] "m"  IFV
 SG_ CAN_FR_DET_SD_RANGE_039 : 249|6@0+ (0.025,0) [0|1.5] "m"  IFV
 SG_ CAN_FR_DET_RANGE_RATE_039 : 259|14@0+ (0.015625,-128) [-128|127.984375] "m/s"  IFV
 SG_ CAN_FR_DET_SD_RANGE_RATE_039 : 277|6@0+ (0.02,0) [0|1.2] "m/s"  IFV
 SG_ CAN_FR_DET_AZIMUTH_039 : 287|13@0+ (0.0007668,-3.141593) [-3.141593|3.141593] "rad"  IFV
 SG_ CAN_FR_DET_SD_AZIMUTH_039 : 290|6@0+ (0.001745329,0) [0|0.104719755] "rad"  IFV
 SG_ CAN_FR_DET_ELEVATION_039 : 300|7@0+ (0.157449,-9.99812) [-9.99812|9.997903] "deg"  IFV
 SG_ CAN_FR_DET_SD_ELEVATION_039 : 309|6@0+ (0.003490659,0) [0|0.20943951] "rad"  IFV
 SG_ CAN_FR_DET_AMPLITUDE_039 : 319|7@0+ (1,-64) [-64|63] "dBsm"  IFV
 SG_ CAN_FR_DET_VALID_FLAG_039 : 312|1@0+ (1,0) [0|1] ""  IFV
 SG_ CAN_FR_DET_SUPER_RES_039 : 320|1@0+ (1,0) [0|1] ""  IFV
 SG_ CAN_FR_DET_LOW_SNR_FLAG_039 : 321|1@0+ (1,0) [0|1] ""  IFV
 SG_ CAN_FR_DET_MIXER_BIAS_FLAG_039 : 322|1@0+ (1,0) [0|1] ""  IFV
 SG_ CAN_FR_DET_RESERVED_FLAGS_039 : 327|5@0+ (1,0) [0|31] ""  IFV
 SG_ CAN_FR_DET_SNR_039 : 335|8@0+ (0.35156,0) [0|89.6478] "dB"  IFV
 SG_ CAN_FR_DET_MULTI_TARGET_PROB_039 : 339|4@0+ (0.06667,0) [0|1] ""  IFV
 SG_ CAN_FR_DET_CONFID_AZIMUTH_039 : 341|2@0+ (1,0) [0|3] ""  IFV
 SG_ CAN_FR_DET_CONFID_ELEVATION_039 : 343|2@0+ (1,0) [0|3] ""  IFV
 SG_ CAN_FR_DET_EXISTENCE_PROB_039 : 347|4@0+ (1,0) [0|15] ""  IFV
 SG_ CAN_FR_DET_CLASS_039 : 351|4@0+ (1,0) [0|15] ""  IFV
 SG_ CAN_FR_DET_RANGE_040 : 367|14@0+ (0.015625,0) [0|255.984375] "m"  IFV
 SG_ CAN_FR_DET_SD_RANGE_040 : 369|6@0+ (0.025,0) [0|1.5] "m"  IFV
 SG_ CAN_FR_DET_RANGE_RATE_040 : 379|14@0+ (0.015625,-128) [-128|127.984375] "m/s"  IFV
 SG_ CAN_FR_DET_SD_RANGE_RATE_040 : 397|6@0+ (0.02,0) [0|1.2] "m/s"  IFV
 SG_ CAN_FR_DET_AZIMUTH_040 : 407|13@0+ (0.0007668,-3.141593) [-3.141593|3.141593] "rad"  IFV
 SG_ CAN_FR_DET_SD_AZIMUTH_040 : 410|6@0+ (0.001745329,0) [0|0.104719755] "rad"  IFV
 SG_ CAN_FR_DET_ELEVATION_040 : 420|7@0+ (0.157449,-9.99812) [-9.99812|9.997903] "deg"  IFV
 SG_ CAN_FR_DET_SD_ELEVATION_040 : 429|6@0+ (0.003490659,0) [0|0.20943951] "rad"  IFV
 SG_ CAN_FR_DET_AMPLITUDE_040 : 439|7@0+ (1,-64) [-64|63] "dBsm"  IFV
 SG_ CAN_FR_DET_VALID_FLAG_040 : 432|1@0+ (1,0) [0|1] ""  IFV
 SG_ CAN_FR_DET_SUPER_RES_040 : 440|1@0+ (1,0) [0|1] ""  IFV
 SG_ CAN_FR_DET_LOW_SNR_FLAG_040 : 441|1@0+ (1,0) [0|1] ""  IFV
 SG_ CAN_FR_DET_MIXER_BIAS_FLAG_040 : 442|1@0+ (1,0) [0|1] ""  IFV
 SG_ CAN_FR_DET_RESERVED_FLAGS_040 : 447|5@0+ (1,0) [0|31] ""  IFV
 SG_ CAN_FR_DET_SNR_040 : 455|8@0+ (0.35156,0) [0|89.6478] "dB"  IFV
 SG_ CAN_FR_DET_MULTI_TARGET_PROB_040 : 459|4@0+ (0.06667,0) [0|1] ""  IFV
 SG_ CAN_FR_DET_CONFID_AZIMUTH_040 : 461|2@0+ (1,0) [0|3] ""  IFV
 SG_ CAN_FR_DET_CONFID_ELEVATION_040 : 463|2@0+ (1,0) [0|3] ""  IFV
 SG_ CAN_FR_DET_EXISTENCE_PROB_040 : 467|4@0+ (1,0) [0|15] ""  IFV
 SG_ CAN_FR_DET_CLASS_040 : 471|4@0+ (1,0) [0|15] ""  IFV

BA_DEF_ BO_  "VFrameFormat" ENUM  "StandardCAN","ExtendedCAN","reserved","reserved","reserved","reserved","reserved","reserved","reserved","reserved","reserved","reserved","reserved","reserved","StandardCAN_FD","ExtendedCAN_FD";
BA_DEF_ BO_  "CanTpBs" INT 0 255;
BA_DEF_ BO_  "EventRateOfChange" INT 10 10000;
BA_DEF_ SG_  "GenSigTimeoutTime_SRR01RR" INT 0 0;
BA_DEF_ SG_  "GenSigCycleTime" INT 0 0;
BA_DEF_ SG_  "GenSigVtName" STRING ;
BA_DEF_ SG_  "GenSigVtEn" STRING ;
BA_DEF_ SG_  "GenSigCmt" STRING ;
BA_DEF_ SG_  "GenSigSendType" ENUM  "Cyclic","OnWrite","vector_leerstring","OnChange","vector_leerstring","IfActive","vector_leerstring","NoSigSendType";
BA_DEF_ SG_  "GenSigStartValue" INT 0 1000000000;
BA_DEF_ BO_  "GenMsgILSupport" ENUM  "No","Yes";
BA_DEF_ BO_  "GenMsgSendType" ENUM  "FixedPeriodic","Event","EnabledPeriodic","NotUsed","NotUsed","EventPeriodic","NotUsed","NotUsed","NoMsgSendType";
BA_DEF_ BO_  "GenMsgCycleTime" INT 0 100000;
BA_DEF_ BO_  "GenMsgNrOfRepetition" INT 0 100;
BA_DEF_ BO_  "NetworkInitialization" ENUM  "No","Yes";
BA_DEF_DEF_  "VFrameFormat" "StandardCAN_FD";
BA_DEF_DEF_  "CanTpBs" 255;
BA_DEF_DEF_  "EventRateOfChange" 10000;
BA_DEF_DEF_  "GenSigTimeoutTime_SRR01RR" 0;
BA_DEF_DEF_  "GenSigCycleTime" 0;
BA_DEF_DEF_  "GenSigVtName" "";
BA_DEF_DEF_  "GenSigVtEn" "";
BA_DEF_DEF_  "GenSigCmt" "";
BA_DEF_DEF_  "GenSigSendType" "NoSigSendType";
BA_DEF_DEF_  "GenSigStartValue" 0;
BA_DEF_DEF_  "GenMsgILSupport" "Yes";
BA_DEF_DEF_  "GenMsgSendType" "NoMsgSendType";
BA_DEF_DEF_  "GenMsgCycleTime" 0;
BA_DEF_DEF_  "GenMsgNrOfRepetition" 0;
BA_DEF_DEF_  "NetworkInitialization" "Yes";
BA_ "GenMsgCycleTime" BO_ 798 50;
BA_ "GenMsgCycleTime" BO_ 799 50;
BA_ "GenMsgCycleTime" BO_ 800 50;
BA_ "GenMsgCycleTime" BO_ 801 50;
BA_ "GenMsgCycleTime" BO_ 802 50;
BA_ "GenMsgCycleTime" BO_ 803 50;
BA_ "GenMsgCycleTime" BO_ 804 50;
BA_ "GenMsgCycleTime" BO_ 805 50;
BA_ "GenMsgCycleTime" BO_ 806 50;
BA_ "GenMsgCycleTime" BO_ 807 50;
BA_ "GenMsgCycleTime" BO_ 808 50;
BA_ "GenMsgCycleTime" BO_ 809 50;
BA_ "GenMsgCycleTime" BO_ 810 50;
BA_ "GenMsgCycleTime" BO_ 811 50;
BA_ "GenMsgCycleTime" BO_ 812 50;
BA_ "GenMsgCycleTime" BO_ 813 50;
BA_ "GenMsgCycleTime" BO_ 814 50;
BA_ "GenMsgCycleTime" BO_ 815 50;
BA_ "GenMsgCycleTime" BO_ 816 50;
BA_ "GenMsgCycleTime" BO_ 817 50;
BA_ "GenMsgCycleTime" BO_ 1024 50;
BA_ "GenMsgCycleTime" BO_ 1025 50;
BA_ "GenMsgCycleTime" BO_ 1026 50;
BA_ "GenMsgCycleTime" BO_ 1027 50;
BA_ "GenMsgCycleTime" BO_ 1028 50;
BA_ "GenMsgCycleTime" BO_ 1029 50;
BA_ "GenMsgCycleTime" BO_ 1030 50;
BA_ "GenMsgCycleTime" BO_ 1031 50;
BA_ "GenMsgCycleTime" BO_ 1032 50;
BA_ "GenMsgCycleTime" BO_ 1033 50;
