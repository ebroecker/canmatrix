VERSION ""

NS_ :

BS_:

BU_: External_Tool IFV SODFR SODFL

BO_ 1034 SODFR_DETECTION_041_044: 64 SODFR
 SG_ CAN_FR_DET_RANGE_041 : 7|14@0+ (0.015625,0) [0|255.984375] "m"  IFV
 SG_ CAN_FR_DET_SD_RANGE_041 : 9|6@0+ (0.025,0) [0|1.5] "m"  IFV
 SG_ CAN_FR_DET_RANGE_RATE_041 : 19|14@0+ (0.015625,-128) [-128|127.984375] "m/s"  IFV
 SG_ CAN_FR_DET_SD_RANGE_RATE_041 : 37|6@0+ (0.02,0) [0|1.2] "m/s"  IFV
 SG_ CAN_FR_DET_AZIMUTH_041 : 47|13@0+ (0.0007668,-3.141593) [-3.141593|3.141593] "rad"  IFV
 SG_ CAN_FR_DET_SD_AZIMUTH_041 : 50|6@0+ (0.001745329,0) [0|0.104719755] "rad"  IFV
 SG_ CAN_FR_DET_ELEVATION_041 : 60|7@0+ (0.157449,-9.99812) [-9.99812|9.997903] "deg"  IFV
 SG_ CAN_FR_DET_SD_ELEVATION_041 : 69|6@0+ (0.003490659,0) [0|0.20943951] "rad"  IFV
 SG_ CAN_FR_DET_AMPLITUDE_041 : 79|7@0+ (1,-64) [-64|63] "dBsm"  IFV
 SG_ CAN_FR_DET_VALID_FLAG_041 : 72|1@0+ (1,0) [0|1] ""  IFV
 SG_ CAN_FR_DET_SUPER_RES_041 : 80|1@0+ (1,0) [0|1] ""  IFV
 SG_ CAN_FR_DET_LOW_SNR_FLAG_041 : 81|1@0+ (1,0) [0|1] ""  IFV
 SG_ CAN_FR_DET_MIXER_BIAS_FLAG_041 : 82|1@0+ (1,0) [0|1] ""  IFV
 SG_ CAN_FR_DET_RESERVED_FLAGS_041 : 87|5@0+ (1,0) [0|31] ""  IFV
 SG_ CAN_FR_DET_SNR_041 : 95|8@0+ (0.35156,0) [0|89.6478] "dB"  IFV
 SG_ CAN_FR_DET_MULTI_TARGET_PROB_041 : 99|4@0+ (0.06667,0) [0|1] ""  IFV
 SG_ CAN_FR_DET_CONFID_AZIMUTH_041 : 101|2@0+ (1,0) [0|3] ""  IFV
 SG_ CAN_FR_DET_CONFID_ELEVATION_041 : 103|2@0+ (1,0) [0|3] ""  IFV
 SG_ CAN_FR_DET_EXISTENCE_PROB_041 : 107|4@0+ (1,0) [0|15] ""  IFV
 SG_ CAN_FR_DET_CLASS_041 : 111|4@0+ (1,0) [0|15] ""  IFV
 SG_ CAN_FR_DET_RANGE_042 : 127|14@0+ (0.015625,0) [0|255.984375] "m"  IFV
 SG_ CAN_FR_DET_SD_RANGE_042 : 129|6@0+ (0.025,0) [0|1.5] "m"  IFV
 SG_ CAN_FR_DET_RANGE_RATE_042 : 139|14@0+ (0.015625,-128) [-128|127.984375] "m/s"  IFV
 SG_ CAN_FR_DET_SD_RANGE_RATE_042 : 157|6@0+ (0.02,0) [0|1.2] "m/s"  IFV
 SG_ CAN_FR_DET_AZIMUTH_042 : 167|13@0+ (0.0007668,-3.141593) [-3.141593|3.141593] "rad"  IFV
 SG_ CAN_FR_DET_SD_AZIMUTH_042 : 170|6@0+ (0.001745329,0) [0|0.104719755] "rad"  IFV
 SG_ CAN_FR_DET_ELEVATION_042 : 180|7@0+ (0.157449,-9.99812) [-9.99812|9.997903] "deg"  IFV
 SG_ CAN_FR_DET_SD_ELEVATION_042 : 189|6@0+ (0.003490659,0) [0|0.20943951] "rad"  IFV
 SG_ CAN_FR_DET_AMPLITUDE_042 : 199|7@0+ (1,-64) [-64|63] "dBsm"  IFV
 SG_ CAN_FR_DET_VALID_FLAG_042 : 192|1@0+ (1,0) [0|1] ""  IFV
 SG_ CAN_FR_DET_SUPER_RES_042 : 200|1@0+ (1,0) [0|1] ""  IFV
 SG_ CAN_FR_DET_LOW_SNR_FLAG_042 : 201|1@0+ (1,0) [0|1] ""  IFV
 SG_ CAN_FR_DET_MIXER_BIAS_FLAG_042 : 202|1@0+ (1,0) [0|1] ""  IFV
 SG_ CAN_FR_DET_RESERVED_FLAGS_042 : 207|5@0+ (1,0) [0|31] ""  IFV
 SG_ CAN_FR_DET_SNR_042 : 215|8@0+ (0.35156,0) [0|89.6478] "dB"  IFV
 SG_ CAN_FR_DET_MULTI_TARGET_PROB_042 : 219|4@0+ (0.06667,0) [0|1] ""  IFV
 SG_ CAN_FR_DET_CONFID_AZIMUTH_042 : 221|2@0+ (1,0) [0|3] ""  IFV
 SG_ CAN_FR_DET_CONFID_ELEVATION_042 : 223|2@0+ (1,0) [0|3] ""  IFV
 SG_ CAN_FR_DET_EXISTENCE_PROB_042 : 227|4@0+ (1,0) [0|15] ""  IFV
 SG_ CAN_FR_DET_CLASS_042 : 231|4@0+ (1,0) [0|15] ""  IFV
 SG_ CAN_FR_DET_RANGE_043 : 247|14@0+ (0.015625,0) [0|255.984375] "m"  IFV
 SG_ CAN_FR_DET_SD_RANGE_043 : 249|6@0+ (0.025,0) [0|1.5] "m"  IFV
 SG_ CAN_FR_DET_RANGE_RATE_043 : 259|14@0+ (0.015625,-128) [-128|127.984375] "m/s"  IFV
 SG_ CAN_FR_DET_SD_RANGE_RATE_043 : 277|6@0+ (0.02,0) [0|1.2] "m/s"  IFV
 SG_ CAN_FR_DET_AZIMUTH_043 : 287|13@0+ (0.0007668,-3.141593) [-3.141593|3.141593] "rad"  IFV
 SG_ CAN_FR_DET_SD_AZIMUTH_043 : 290|6@0+ (0.001745329,0) [0|0.104719755] "rad"  IFV
 SG_ CAN_FR_DET_ELEVATION_043 : 300|7@0+ (0.157449,-9.99812) [-9.99812|9.997903] "deg"  IFV
 SG_ CAN_FR_DET_SD_ELEVATION_043 : 309|6@0+ (0.003490659,0) [0|0.20943951] "rad"  IFV
 SG_ CAN_FR_DET_AMPLITUDE_043 : 319|7@0+ (1,-64) [-64|63] "dBsm"  IFV
 SG_ CAN_FR_DET_VALID_FLAG_043 : 312|1@0+ (1,0) [0|1] ""  IFV
 SG_ CAN_FR_DET_SUPER_RES_043 : 320|1@0+ (1,0) [0|1] ""  IFV
 SG_ CAN_FR_DET_LOW_SNR_FLAG_043 : 321|1@0+ (1,0) [0|1] ""  IFV
 SG_ CAN_FR_DET_MIXER_BIAS_FLAG_043 : 322|1@0+ (1,0) [0|1] ""  IFV
 SG_ CAN_FR_DET_RESERVED_FLAGS_043 : 327|5@0+ (1,0) [0|31] ""  IFV
 SG_ CAN_FR_DET_SNR_043 : 335|8@0+ (0.35156,0) [0|89.6478] "dB"  IFV
 SG_ CAN_FR_DET_MULTI_TARGET_PROB_043 : 339|4@0+ (0.06667,0) [0|1] ""  IFV
 SG_ CAN_FR_DET_CONFID_AZIMUTH_043 : 341|2@0+ (1,0) [0|3] ""  IFV
 SG_ CAN_FR_DET_CONFID_ELEVATION_043 : 343|2@0+ (1,0) [0|3] ""  IFV
 SG_ CAN_FR_DET_EXISTENCE_PROB_043 : 347|4@0+ (1,0) [0|15] ""  IFV
 SG_ CAN_FR_DET_CLASS_043 : 351|4@0+ (1,0) [0|15] ""  IFV
 SG_ CAN_FR_DET_RANGE_044 : 367|14@0+ (0.015625,0) [0|255.984375] "m"  IFV
 SG_ CAN_FR_DET_SD_RANGE_044 : 369|6@0+ (0.025,0) [0|1.5] "m"  IFV
 SG_ CAN_FR_DET_RANGE_RATE_044 : 379|14@0+ (0.015625,-128) [-128|127.984375] "m/s"  IFV
 SG_ CAN_FR_DET_SD_RANGE_RATE_044 : 397|6@0+ (0.02,0) [0|1.2] "m/s"  IFV
 SG_ CAN_FR_DET_AZIMUTH_044 : 407|13@0+ (0.0007668,-3.141593) [-3.141593|3.141593] "rad"  IFV
 SG_ CAN_FR_DET_SD_AZIMUTH_044 : 410|6@0+ (0.001745329,0) [0|0.104719755] "rad"  IFV
 SG_ CAN_FR_DET_ELEVATION_044 : 420|7@0+ (0.157449,-9.99812) [-9.99812|9.997903] "deg"  IFV
 SG_ CAN_FR_DET_SD_ELEVATION_044 : 429|6@0+ (0.003490659,0) [0|0.20943951] "rad"  IFV
 SG_ CAN_FR_DET_AMPLITUDE_044 : 439|7@0+ (1,-64) [-64|63] "dBsm"  IFV
 SG_ CAN_FR_DET_VALID_FLAG_044 : 432|1@0+ (1,0) [0|1] ""  IFV
 SG_ CAN_FR_DET_SUPER_RES_044 : 440|1@0+ (1,0) [0|1] ""  IFV
 SG_ CAN_FR_DET_LOW_SNR_FLAG_044 : 441|1@0+ (1,0) [0|1] ""  IFV
 SG_ CAN_FR_DET_MIXER_BIAS_FLAG_044 : 442|1@0+ (1,0) [0|1] ""  IFV
 SG_ CAN_FR_DET_RESERVED_FLAGS_044 : 447|5@0+ (1,0) [0|31] ""  IFV
 SG_ CAN_FR_DET_SNR_044 : 455|8@0+ (0.35156,0) [0|89.6478] "dB"  IFV
 SG_ CAN_FR_DET_MULTI_TARGET_PROB_044 : 459|4@0+ (0.06667,0) [0|1] ""  IFV
 SG_ CAN_FR_DET_CONFID_AZIMUTH_044 : 461|2@0+ (1,0) [0|3] ""  IFV
 SG_ CAN_FR_DET_CONFID_ELEVATION_044 : 463|2@0+ (1,0) [0|3] ""  IFV
 SG_ CAN_FR_DET_EXISTENCE_PROB_044 : 467|4@0+ (1,0) [0|15] ""  IFV
 SG_ CAN_FR_DET_CLASS_044 : 471|4@0+ (1,0) [0|15] ""  IFV

BO_ 1035 SODFR_DETECTION_045_048: 64 SODFR
 SG_ CAN_FR_DET_RANGE_045 : 7|14@0+ (0.015625,0) [0|255.984375] "m"  IFV
 SG_ CAN_FR_DET_SD_RANGE_045 : 9|6@0+ (0.025,0) [0|1.5] "m"  IFV
 SG_ CAN_FR_DET_RANGE_RATE_045 : 19|14@0+ (0.015625,-128) [-128|127.984375] "m/s"  IFV
 SG_ CAN_FR_DET_SD_RANGE_RATE_045 : 37|6@0+ (0.02,0) [0|1.2] "m/s"  IFV
 SG_ CAN_FR_DET_AZIMUTH_045 : 47|13@0+ (0.0007668,-3.141593) [-3.141593|3.141593] "rad"  IFV
 SG_ CAN_FR_DET_SD_AZIMUTH_045 : 50|6@0+ (0.001745329,0) [0|0.104719755] "rad"  IFV
 SG_ CAN_FR_DET_ELEVATION_045 : 60|7@0+ (0.157449,-9.99812) [-9.99812|9.997903] "deg"  IFV
 SG_ CAN_FR_DET_SD_ELEVATION_045 : 69|6@0+ (0.003490659,0) [0|0.20943951] "rad"  IFV
 SG_ CAN_FR_DET_AMPLITUDE_045 : 79|7@0+ (1,-64) [-64|63] "dBsm"  IFV
 SG_ CAN_FR_DET_VALID_FLAG_045 : 72|1@0+ (1,0) [0|1] ""  IFV
 SG_ CAN_FR_DET_SUPER_RES_045 : 80|1@0+ (1,0) [0|1] ""  IFV
 SG_ CAN_FR_DET_LOW_SNR_FLAG_045 : 81|1@0+ (1,0) [0|1] ""  IFV
 SG_ CAN_FR_DET_MIXER_BIAS_FLAG_045 : 82|1@0+ (1,0) [0|1] ""  IFV
 SG_ CAN_FR_DET_RESERVED_FLAGS_045 : 87|5@0+ (1,0) [0|31] ""  IFV
 SG_ CAN_FR_DET_SNR_045 : 95|8@0+ (0.35156,0) [0|89.6478] "dB"  IFV
 SG_ CAN_FR_DET_MULTI_TARGET_PROB_045 : 99|4@0+ (0.06667,0) [0|1] ""  IFV
 SG_ CAN_FR_DET_CONFID_AZIMUTH_045 : 101|2@0+ (1,0) [0|3] ""  IFV
 SG_ CAN_FR_DET_CONFID_ELEVATION_045 : 103|2@0+ (1,0) [0|3] ""  IFV
 SG_ CAN_FR_DET_EXISTENCE_PROB_045 : 107|4@0+ (1,0) [0|15] ""  IFV
 SG_ CAN_FR_DET_CLASS_045 : 111|4@0+ (1,0) [0|15] ""  IFV
 SG_ CAN_FR_DET_RANGE_046 : 127|14@0+ (0.015625,0) [0|255.984375] "m"  IFV
 SG_ CAN_FR_DET_SD_RANGE_046 : 129|6@0+ (0.025,0) [0|1.5] "m"  IFV
 SG_ CAN_FR_DET_RANGE_RATE_046 : 139|14@0+ (0.015625,-128) [-128|127.984375] "m/s"  IFV
 SG_ CAN_FR_DET_SD_RANGE_RATE_046 : 157|6@0+ (0.02,0) [0|1.2] "m/s"  IFV
 SG_ CAN_FR_DET_AZIMUTH_046 : 167|13@0+ (0.0007668,-3.141593) [-3.141593|3.141593] "rad"  IFV
 SG_ CAN_FR_DET_SD_AZIMUTH_046 : 170|6@0+ (0.001745329,0) [0|0.104719755] "rad"  IFV
 SG_ CAN_FR_DET_ELEVATION_046 : 180|7@0+ (0.157449,-9.99812) [-9.99812|9.997903] "deg"  IFV
 SG_ CAN_FR_DET_SD_ELEVATION_046 : 189|6@0+ (0.003490659,0) [0|0.20943951] "rad"  IFV
 SG_ CAN_FR_DET_AMPLITUDE_046 : 199|7@0+ (1,-64) [-64|63] "dBsm"  IFV
 SG_ CAN_FR_DET_VALID_FLAG_046 : 192|1@0+ (1,0) [0|1] ""  IFV
 SG_ CAN_FR_DET_SUPER_RES_046 : 200|1@0+ (1,0) [0|1] ""  IFV
 SG_ CAN_FR_DET_LOW_SNR_FLAG_046 : 201|1@0+ (1,0) [0|1] ""  IFV
 SG_ CAN_FR_DET_MIXER_BIAS_FLAG_046 : 202|1@0+ (1,0) [0|1] ""  IFV
 SG_ CAN_FR_DET_RESERVED_FLAGS_046 : 207|5@0+ (1,0) [0|31] ""  IFV
 SG_ CAN_FR_DET_SNR_046 : 215|8@0+ (0.35156,0) [0|89.6478] "dB"  IFV
 SG_ CAN_FR_DET_MULTI_TARGET_PROB_046 : 219|4@0+ (0.06667,0) [0|1] ""  IFV
 SG_ CAN_FR_DET_CONFID_AZIMUTH_046 : 221|2@0+ (1,0) [0|3] ""  IFV
 SG_ CAN_FR_DET_CONFID_ELEVATION_046 : 223|2@0+ (1,0) [0|3] ""  IFV
 SG_ CAN_FR_DET_EXISTENCE_PROB_046 : 227|4@0+ (1,0) [0|15] ""  IFV
 SG_ CAN_FR_DET_CLASS_046 : 231|4@0+ (1,0) [0|15] ""  IFV
 SG_ CAN_FR_DET_RANGE_047 : 247|14@0+ (0.015625,0) [0|255.984375] "m"  IFV
 SG_ CAN_FR_DET_SD_RANGE_047 : 249|6@0+ (0.025,0) [0|1.5] "m"  IFV
 SG_ CAN_FR_DET_RANGE_RATE_047 : 259|14@0+ (0.015625,-128) [-128|127.984375] "m/s"  IFV
 SG_ CAN_FR_DET_SD_RANGE_RATE_047 : 277|6@0+ (0.02,0) [0|1.2] "m/s"  IFV
 SG_ CAN_FR_DET_AZIMUTH_047 : 287|13@0+ (0.0007668,-3.141593) [-3.141593|3.141593] "rad"  IFV
 SG_ CAN_FR_DET_SD_AZIMUTH_047 : 290|6@0+ (0.001745329,0) [0|0.104719755] "rad"  IFV
 SG_ CAN_FR_DET_ELEVATION_047 : 300|7@0+ (0.157449,-9.99812) [-9.99812|9.997903] "deg"  IFV
 SG_ CAN_FR_DET_SD_ELEVATION_047 : 309|6@0+ (0.003490659,0) [0|0.20943951] "rad"  IFV
 SG_ CAN_FR_DET_AMPLITUDE_047 : 319|7@0+ (1,-64) [-64|63] "dBsm"  IFV
 SG_ CAN_FR_DET_VALID_FLAG_047 : 312|1@0+ (1,0) [0|1] ""  IFV
 SG_ CAN_FR_DET_SUPER_RES_047 : 320|1@0+ (1,0) [0|1] ""  IFV
 SG_ CAN_FR_DET_LOW_SNR_FLAG_047 : 321|1@0+ (1,0) [0|1] ""  IFV
 SG_ CAN_FR_DET_MIXER_BIAS_FLAG_047 : 322|1@0+ (1,0) [0|1] ""  IFV
 SG_ CAN_FR_DET_RESERVED_FLAGS_047 : 327|5@0+ (1,0) [0|31] ""  IFV
 SG_ CAN_FR_DET_SNR_047 : 335|8@0+ (0.35156,0) [0|89.6478] "dB"  IFV
 SG_ CAN_FR_DET_MULTI_TARGET_PROB_047 : 339|4@0+ (0.06667,0) [0|1] ""  IFV
 SG_ CAN_FR_DET_CONFID_AZIMUTH_047 : 341|2@0+ (1,0) [0|3] ""  IFV
 SG_ CAN_FR_DET_CONFID_ELEVATION_047 : 343|2@0+ (1,0) [0|3] ""  IFV
 SG_ CAN_FR_DET_EXISTENCE_PROB_047 : 347|4@0+ (1,0) [0|15] ""  IFV
 SG_ CAN_FR_DET_CLASS_047 : 351|4@0+ (1,0) [0|15] ""  IFV
 SG_ CAN_FR_DET_RANGE_048 : 367|14@0+ (0.015625,0) [0|255.984375] "m"  IFV
 SG_ CAN_FR_DET_SD_RANGE_048 : 369|6@0+ (0.025,0) [0|1.5] "m"  IFV
 SG_ CAN_FR_DET_RANGE_RATE_048 : 379|14@0+ (0.015625,-128) [-128|127.984375] "m/s"  IFV
 SG_ CAN_FR_DET_SD_RANGE_RATE_048 : 397|6@0+ (0.02,0) [0|1.2] "m/s"  IFV
 SG_ CAN_FR_DET_AZIMUTH_048 : 407|13@0+ (0.0007668,-3.141593) [-3.141593|3.141593] "rad"  IFV
 SG_ CAN_FR_DET_SD_AZIMUTH_048 : 410|6@0+ (0.001745329,0) [0|0.104719755] "rad"  IFV
 SG_ CAN_FR_DET_ELEVATION_048 : 420|7@0+ (0.157449,-9.99812) [-9.99812|9.997903] "deg"  IFV
 SG_ CAN_FR_DET_SD_ELEVATION_048 : 429|6@0+ (0.003490659,0) [0|0.20943951] "rad"  IFV
 SG_ CAN_FR_DET_AMPLITUDE_048 : 439|7@0+ (1,-64) [-64|63] "dBsm"  IFV
 SG_ CAN_FR_DET_VALID_FLAG_048 : 432|1@0+ (1,0) [0|1] ""  IFV
 SG_ CAN_FR_DET_SUPER_RES_048 : 440|1@0+ (1,0) [0|1] ""  IFV
 SG_ CAN_FR_DET_LOW_SNR_FLAG_048 : 441|1@0+ (1,0) [0|1] ""  IFV
 SG_ CAN_FR_DET_MIXER_BIAS_FLAG_048 : 442|1@0+ (1,0) [0|1] ""  IFV
 SG_ CAN_FR_DET_RESERVED_FLAGS_048 : 447|5@0+ (1,0) [0|31] ""  IFV
 SG_ CAN_FR_DET_SNR_048 : 455|8@0+ (0.35156,0) [0|89.6478] "dB"  IFV
 SG_ CAN_FR_DET_MULTI_TARGET_PROB_048 : 459|4@0+ (0.06667,0) [0|1] ""  IFV
 SG_ CAN_FR_DET_CONFID_AZIMUTH_048 : 461|2@0+ (1,0) [0|3] ""  IFV
 SG_ CAN_FR_DET_CONFID_ELEVATION_048 : 463|2@0+ (1,0) [0|3] ""  IFV
 SG_ CAN_FR_DET_EXISTENCE_PROB_048 : 467|4@0+ (1,0) [0|15] ""  IFV
 SG_ CAN_FR_DET_CLASS_048 : 471|4@0+ (1,0) [0|15] ""  IFV

BO_ 1036 SODFR_DETECTION_049_052: 64 SODFR
 SG_ CAN_FR_DET_RANGE_049 : 7|14@0+ (0.015625,0) [0|255.984375] "m"  IFV
 SG_ CAN_FR_DET_SD_RANGE_049 : 9|6@0+ (0.025,0) [0|1.5] "m"  IFV
 SG_ CAN_FR_DET_RANGE_RATE_049 : 19|14@0+ (0.015625,-128) [-128|127.984375] "m/s"  IFV
 SG_ CAN_FR_DET_SD_RANGE_RATE_049 : 37|6@0+ (0.02,0) [0|1.2] "m/s"  IFV
 SG_ CAN_FR_DET_AZIMUTH_049 : 47|13@0+ (0.0007668,-3.141593) [-3.141593|3.141593] "rad"  IFV
 SG_ CAN_FR_DET_SD_AZIMUTH_049 : 50|6@0+ (0.001745329,0) [0|0.104719755] "rad"  IFV
 SG_ CAN_FR_DET_ELEVATION_049 : 60|7@0+ (0.157449,-9.99812) [-9.99812|9.997903] "deg"  IFV
 SG_ CAN_FR_DET_SD_ELEVATION_049 : 69|6@0+ (0.003490659,0) [0|0.20943951] "rad"  IFV
 SG_ CAN_FR_DET_AMPLITUDE_049 : 79|7@0+ (1,-64) [-64|63] "dBsm"  IFV
 SG_ CAN_FR_DET_VALID_FLAG_049 : 72|1@0+ (1,0) [0|1] ""  IFV
 SG_ CAN_FR_DET_SUPER_RES_049 : 80|1@0+ (1,0) [0|1] ""  IFV
 SG_ CAN_FR_DET_LOW_SNR_FLAG_049 : 81|1@0+ (1,0) [0|1] ""  IFV
 SG_ CAN_FR_DET_MIXER_BIAS_FLAG_049 : 82|1@0+ (1,0) [0|1] ""  IFV
 SG_ CAN_FR_DET_RESERVED_FLAGS_049 : 87|5@0+ (1,0) [0|31] ""  IFV
 SG_ CAN_FR_DET_SNR_049 : 95|8@0+ (0.35156,0) [0|89.6478] "dB"  IFV
 SG_ CAN_FR_DET_MULTI_TARGET_PROB_049 : 99|4@0+ (0.06667,0) [0|1] ""  IFV
 SG_ CAN_FR_DET_CONFID_AZIMUTH_049 : 101|2@0+ (1,0) [0|3] ""  IFV
 SG_ CAN_FR_DET_CONFID_ELEVATION_049 : 103|2@0+ (1,0) [0|3] ""  IFV
 SG_ CAN_FR_DET_EXISTENCE_PROB_049 : 107|4@0+ (1,0) [0|15] ""  IFV
 SG_ CAN_FR_DET_CLASS_049 : 111|4@0+ (1,0) [0|15] ""  IFV
 SG_ CAN_FR_DET_RANGE_050 : 127|14@0+ (0.015625,0) [0|255.984375] "m"  IFV
 SG_ CAN_FR_DET_SD_RANGE_050 : 129|6@0+ (0.025,0) [0|1.5] "m"  IFV
 SG_ CAN_FR_DET_RANGE_RATE_050 : 139|14@0+ (0.015625,-128) [-128|127.984375] "m/s"  IFV
 SG_ CAN_FR_DET_SD_RANGE_RATE_050 : 157|6@0+ (0.02,0) [0|1.2] "m/s"  IFV
 SG_ CAN_FR_DET_AZIMUTH_050 : 167|13@0+ (0.0007668,-3.141593) [-3.141593|3.141593] "rad"  IFV
 SG_ CAN_FR_DET_SD_AZIMUTH_050 : 170|6@0+ (0.001745329,0) [0|0.104719755] "rad"  IFV
 SG_ CAN_FR_DET_ELEVATION_050 : 180|7@0+ (0.157449,-9.99812) [-9.99812|9.997903] "deg"  IFV
 SG_ CAN_FR_DET_SD_ELEVATION_050 : 189|6@0+ (0.003490659,0) [0|0.20943951] "rad"  IFV
 SG_ CAN_FR_DET_AMPLITUDE_050 : 199|7@0+ (1,-64) [-64|63] "dBsm"  IFV
 SG_ CAN_FR_DET_VALID_FLAG_050 : 192|1@0+ (1,0) [0|1] ""  IFV
 SG_ CAN_FR_DET_SUPER_RES_050 : 200|1@0+ (1,0) [0|1] ""  IFV
 SG_ CAN_FR_DET_LOW_SNR_FLAG_050 : 201|1@0+ (1,0) [0|1] ""  IFV
 SG_ CAN_FR_DET_MIXER_BIAS_FLAG_050 : 202|1@0+ (1,0) [0|1] ""  IFV
 SG_ CAN_FR_DET_RESERVED_FLAGS_050 : 207|5@0+ (1,0) [0|31] ""  IFV
 SG_ CAN_FR_DET_SNR_050 : 215|8@0+ (0.35156,0) [0|89.6478] "dB"  IFV
 SG_ CAN_FR_DET_MULTI_TARGET_PROB_050 : 219|4@0+ (0.06667,0) [0|1] ""  IFV
 SG_ CAN_FR_DET_CONFID_AZIMUTH_050 : 221|2@0+ (1,0) [0|3] ""  IFV
 SG_ CAN_FR_DET_CONFID_ELEVATION_050 : 223|2@0+ (1,0) [0|3] ""  IFV
 SG_ CAN_FR_DET_EXISTENCE_PROB_050 : 227|4@0+ (1,0) [0|15] ""  IFV
 SG_ CAN_FR_DET_CLASS_050 : 231|4@0+ (1,0) [0|15] ""  IFV
 SG_ CAN_FR_DET_RANGE_051 : 247|14@0+ (0.015625,0) [0|255.984375] "m"  IFV
 SG_ CAN_FR_DET_SD_RANGE_051 : 249|6@0+ (0.025,0) [0|1.5] "m"  IFV
 SG_ CAN_FR_DET_RANGE_RATE_051 : 259|14@0+ (0.015625,-128) [-128|127.984375] "m/s"  IFV
 SG_ CAN_FR_DET_SD_RANGE_RATE_051 : 277|6@0+ (0.02,0) [0|1.2] "m/s"  IFV
 SG_ CAN_FR_DET_AZIMUTH_051 : 287|13@0+ (0.0007668,-3.141593) [-3.141593|3.141593] "rad"  IFV
 SG_ CAN_FR_DET_SD_AZIMUTH_051 : 290|6@0+ (0.001745329,0) [0|0.104719755] "rad"  IFV
 SG_ CAN_FR_DET_ELEVATION_051 : 300|7@0+ (0.157449,-9.99812) [-9.99812|9.997903] "deg"  IFV
 SG_ CAN_FR_DET_SD_ELEVATION_051 : 309|6@0+ (0.003490659,0) [0|0.20943951] "rad"  IFV
 SG_ CAN_FR_DET_AMPLITUDE_051 : 319|7@0+ (1,-64) [-64|63] "dBsm"  IFV
 SG_ CAN_FR_DET_VALID_FLAG_051 : 312|1@0+ (1,0) [0|1] ""  IFV
 SG_ CAN_FR_DET_SUPER_RES_051 : 320|1@0+ (1,0) [0|1] ""  IFV
 SG_ CAN_FR_DET_LOW_SNR_FLAG_051 : 321|1@0+ (1,0) [0|1] ""  IFV
 SG_ CAN_FR_DET_MIXER_BIAS_FLAG_051 : 322|1@0+ (1,0) [0|1] ""  IFV
 SG_ CAN_FR_DET_RESERVED_FLAGS_051 : 327|5@0+ (1,0) [0|31] ""  IFV
 SG_ CAN_FR_DET_SNR_051 : 335|8@0+ (0.35156,0) [0|89.6478] "dB"  IFV
 SG_ CAN_FR_DET_MULTI_TARGET_PROB_051 : 339|4@0+ (0.06667,0) [0|1] ""  IFV
 SG_ CAN_FR_DET_CONFID_AZIMUTH_051 : 341|2@0+ (1,0) [0|3] ""  IFV
 SG_ CAN_FR_DET_CONFID_ELEVATION_051 : 343|2@0+ (1,0) [0|3] ""  IFV
 SG_ CAN_FR_DET_EXISTENCE_PROB_051 : 347|4@0+ (1,0) [0|15] ""  IFV
 SG_ CAN_FR_DET_CLASS_051 : 351|4@0+ (1,0) [0|15] ""  IFV
 SG_ CAN_FR_DET_RANGE_052 : 367|14@0+ (0.015625,0) [0|255.984375] "m"  IFV
 SG_ CAN_FR_DET_SD_RANGE_052 : 369|6@0+ (0.025,0) [0|1.5] "m"  IFV
 SG_ CAN_FR_DET_RANGE_RATE_052 : 379|14@0+ (0.015625,-128) [-128|127.984375] "m/s"  IFV
 SG_ CAN_FR_DET_SD_RANGE_RATE_052 : 397|6@0+ (0.02,0) [0|1.2] "m/s"  IFV
 SG_ CAN_FR_DET_AZIMUTH_052 : 407|13@0+ (0.0007668,-3.141593) [-3.141593|3.141593] "rad"  IFV
 SG_ CAN_FR_DET_SD_AZIMUTH_052 : 410|6@0+ (0.001745329,0) [0|0.104719755] "rad"  IFV
 SG_ CAN_FR_DET_ELEVATION_052 : 420|7@0+ (0.157449,-9.99812) [-9.99812|9.997903] "deg"  IFV
 SG_ CAN_FR_DET_SD_ELEVATION_052 : 429|6@0+ (0.003490659,0) [0|0.20943951] "rad"  IFV
 SG_ CAN_FR_DET_AMPLITUDE_052 : 439|7@0+ (1,-64) [-64|63] "dBsm"  IFV
 SG_ CAN_FR_DET_VALID_FLAG_052 : 432|1@0+ (1,0) [0|1] ""  IFV
 SG_ CAN_FR_DET_SUPER_RES_052 : 440|1@0+ (1,0) [0|1] ""  IFV
 SG_ CAN_FR_DET_LOW_SNR_FLAG_052 : 441|1@0+ (1,0) [0|1] ""  IFV
 SG_ CAN_FR_DET_MIXER_BIAS_FLAG_052 : 442|1@0+ (1,0) [0|1] ""  IFV
 SG_ CAN_FR_DET_RESERVED_FLAGS_052 : 447|5@0+ (1,0) [0|31] ""  IFV
 SG_ CAN_FR_DET_SNR_052 : 455|8@0+ (0.35156,0) [0|89.6478] "dB"  IFV
 SG_ CAN_FR_DET_MULTI_TARGET_PROB_052 : 459|4@0+ (0.06667,0) [0|1] ""  IFV
 SG_ CAN_FR_DET_CONFID_AZIMUTH_052 : 461|2@0+ (1,0) [0|3] ""  IFV
 SG_ CAN_FR_DET_CONFID_ELEVATION_052 : 463|2@0+ (1,0) [0|3] ""  IFV
 SG_ CAN_FR_DET_EXISTENCE_PROB_052 : 467|4@0+ (1,0) [0|15] ""  IFV
 SG_ CAN_FR_DET_CLASS_052 : 471|4@0+ (1,0) [0|15] ""  IFV

BO_ 1037 SODFR_DETECTION_053_056: 64 SODFR
 SG_ CAN_FR_DET_RANGE_053 : 7|14@0+ (0.015625,0) [0|255.984375] "m"  IFV
 SG_ CAN_FR_DET_SD_RANGE_053 : 9|6@0+ (0.025,0) [0|1.5] "m"  IFV
 SG_ CAN_FR_DET_RANGE_RATE_053 : 19|14@0+ (0.015625,-128) [-128|127.984375] "m/s"  IFV
 SG_ CAN_FR_DET_SD_RANGE_RATE_053 : 37|6@0+ (0.02,0) [0|1.2] "m/s"  IFV
 SG_ CAN_FR_DET_AZIMUTH_053 : 47|13@0+ (0.0007668,-3.141593) [-3.141593|3.141593] "rad"  IFV
 SG_ CAN_FR_DET_SD_AZIMUTH_053 : 50|6@0+ (0.001745329,0) [0|0.104719755] "rad"  IFV
 SG_ CAN_FR_DET_ELEVATION_053 : 60|7@0+ (0.157449,-9.99812) [-9.99812|9.997903] "deg"  IFV
 SG_ CAN_FR_DET_SD_ELEVATION_053 : 69|6@0+ (0.003490659,0) [0|0.20943951] "rad"  IFV
 SG_ CAN_FR_DET_AMPLITUDE_053 : 79|7@0+ (1,-64) [-64|63] "dBsm"  IFV
 SG_ CAN_FR_DET_VALID_FLAG_053 : 72|1@0+ (1,0) [0|1] ""  IFV
 SG_ CAN_FR_DET_SUPER_RES_053 : 80|1@0+ (1,0) [0|1] ""  IFV
 SG_ CAN_FR_DET_LOW_SNR_FLAG_053 : 81|1@0+ (1,0) [0|1] ""  IFV
 SG_ CAN_FR_DET_MIXER_BIAS_FLAG_053 : 82|1@0+ (1,0) [0|1] ""  IFV
 SG_ CAN_FR_DET_RESERVED_FLAGS_053 : 87|5@0+ (1,0) [0|31] ""  IFV
 SG_ CAN_FR_DET_SNR_053 : 95|8@0+ (0.35156,0) [0|89.6478] "dB"  IFV
 SG_ CAN_FR_DET_MULTI_TARGET_PROB_053 : 99|4@0+ (0.06667,0) [0|1] ""  IFV
 SG_ CAN_FR_DET_CONFID_AZIMUTH_053 : 101|2@0+ (1,0) [0|3] ""  IFV
 SG_ CAN_FR_DET_CONFID_ELEVATION_053 : 103|2@0+ (1,0) [0|3] ""  IFV
 SG_ CAN_FR_DET_EXISTENCE_PROB_053 : 107|4@0+ (1,0) [0|15] ""  IFV
 SG_ CAN_FR_DET_CLASS_053 : 111|4@0+ (1,0) [0|15] ""  IFV
 SG_ CAN_FR_DET_RANGE_054 : 127|14@0+ (0.015625,0) [0|255.984375] "m"  IFV
 SG_ CAN_FR_DET_SD_RANGE_054 : 129|6@0+ (0.025,0) [0|1.5] "m"  IFV
 SG_ CAN_FR_DET_RANGE_RATE_054 : 139|14@0+ (0.015625,-128) [-128|127.984375] "m/s"  IFV
 SG_ CAN_FR_DET_SD_RANGE_RATE_054 : 157|6@0+ (0.02,0) [0|1.2] "m/s"  IFV
 SG_ CAN_FR_DET_AZIMUTH_054 : 167|13@0+ (0.0007668,-3.141593) [-3.141593|3.141593] "rad"  IFV
 SG_ CAN_FR_DET_SD_AZIMUTH_054 : 170|6@0+ (0.001745329,0) [0|0.104719755] "rad"  IFV
 SG_ CAN_FR_DET_ELEVATION_054 : 180|7@0+ (0.157449,-9.99812) [-9.99812|9.997903] "deg"  IFV
 SG_ CAN_FR_DET_SD_ELEVATION_054 : 189|6@0+ (0.003490659,0) [0|0.20943951] "rad"  IFV
 SG_ CAN_FR_DET_AMPLITUDE_054 : 199|7@0+ (1,-64) [-64|63] "dBsm"  IFV
 SG_ CAN_FR_DET_VALID_FLAG_054 : 192|1@0+ (1,0) [0|1] ""  IFV
 SG_ CAN_FR_DET_SUPER_RES_054 : 200|1@0+ (1,0) [0|1] ""  IFV
 SG_ CAN_FR_DET_LOW_SNR_FLAG_054 : 201|1@0+ (1,0) [0|1] ""  IFV
 SG_ CAN_FR_DET_MIXER_BIAS_FLAG_054 : 202|1@0+ (1,0) [0|1] ""  IFV
 SG_ CAN_FR_DET_RESERVED_FLAGS_054 : 207|5@0+ (1,0) [0|31] ""  IFV
 SG_ CAN_FR_DET_SNR_054 : 215|8@0+ (0.35156,0) [0|89.6478] "dB"  IFV
 SG_ CAN_FR_DET_MULTI_TARGET_PROB_054 : 219|4@0+ (0.06667,0) [0|1] ""  IFV
 SG_ CAN_FR_DET_CONFID_AZIMUTH_054 : 221|2@0+ (1,0) [0|3] ""  IFV
 SG_ CAN_FR_DET_CONFID_ELEVATION_054 : 223|2@0+ (1,0) [0|3] ""  IFV
 SG_ CAN_FR_DET_EXISTENCE_PROB_054 : 227|4@0+ (1,0) [0|15] ""  IFV
 SG_ CAN_FR_DET_CLASS_054 : 231|4@0+ (1,0) [0|15] ""  IFV
 SG_ CAN_FR_DET_RANGE_055 : 247|14@0+ (0.015625,0) [0|255.984375] "m"  IFV
 SG_ CAN_FR_DET_SD_RANGE_055 : 249|6@0+ (0.025,0) [0|1.5] "m"  IFV
 SG_ CAN_FR_DET_RANGE_RATE_055 : 259|14@0+ (0.015625,-128) [-128|127.984375] "m/s"  IFV
 SG_ CAN_FR_DET_SD_RANGE_RATE_055 : 277|6@0+ (0.02,0) [0|1.2] "m/s"  IFV
 SG_ CAN_FR_DET_AZIMUTH_055 : 287|13@0+ (0.0007668,-3.141593) [-3.141593|3.141593] "rad"  IFV
 SG_ CAN_FR_DET_SD_AZIMUTH_055 : 290|6@0+ (0.001745329,0) [0|0.104719755] "rad"  IFV
 SG_ CAN_FR_DET_ELEVATION_055 : 300|7@0+ (0.157449,-9.99812) [-9.99812|9.997903] "deg"  IFV
 SG_ CAN_FR_DET_SD_ELEVATION_055 : 309|6@0+ (0.003490659,0) [0|0.20943951] "rad"  IFV
 SG_ CAN_FR_DET_AMPLITUDE_055 : 319|7@0+ (1,-64) [-64|63] "dBsm"  IFV
 SG_ CAN_FR_DET_VALID_FLAG_055 : 312|1@0+ (1,0) [0|1] ""  IFV
 SG_ CAN_FR_DET_SUPER_RES_055 : 320|1@0+ (1,0) [0|1] ""  IFV
 SG_ CAN_FR_DET_LOW_SNR_FLAG_055 : 321|1@0+ (1,0) [0|1] ""  IFV
 SG_ CAN_FR_DET_MIXER_BIAS_FLAG_055 : 322|1@0+ (1,0) [0|1] ""  IFV
 SG_ CAN_FR_DET_RESERVED_FLAGS_055 : 327|5@0+ (1,0) [0|31] ""  IFV
 SG_ CAN_FR_DET_SNR_055 : 335|8@0+ (0.35156,0) [0|89.6478] "dB"  IFV
 SG_ CAN_FR_DET_MULTI_TARGET_PROB_055 : 339|4@0+ (0.06667,0) [0|1] ""  IFV
 SG_ CAN_FR_DET_CONFID_AZIMUTH_055 : 341|2@0+ (1,0) [0|3] ""  IFV
 SG_ CAN_FR_DET_CONFID_ELEVATION_055 : 343|2@0+ (1,0) [0|3] ""  IFV
 SG_ CAN_FR_DET_EXISTENCE_PROB_055 : 347|4@0+ (1,0) [0|15] ""  IFV
 SG_ CAN_FR_DET_CLASS_055 : 351|4@0+ (1,0) [0|15] ""  IFV
 SG_ CAN_FR_DET_RANGE_056 : 367|14@0+ (0.015625,0) [0|255.984375] "m"  IFV
 SG_ CAN_FR_DET_SD_RANGE_056 : 369|6@0+ (0.025,0) [0|1.5] "m"  IFV
 SG_ CAN_FR_DET_RANGE_RATE_056 : 379|14@0+ (0.015625,-128) [-128|127.984375] "m/s"  IFV
 SG_ CAN_FR_DET_SD_RANGE_RATE_056 : 397|6@0+ (0.02,0) [0|1.2] "m/s"  IFV
 SG_ CAN_FR_DET_AZIMUTH_056 : 407|13@0+ (0.0007668,-3.141593) [-3.141593|3.141593] "rad"  IFV
 SG_ CAN_FR_DET_SD_AZIMUTH_056 : 410|6@0+ (0.001745329,0) [0|0.104719755] "rad"  IFV
 SG_ CAN_FR_DET_ELEVATION_056 : 420|7@0+ (0.157449,-9.99812) [-9.99812|9.997903] "deg"  IFV
 SG_ CAN_FR_DET_SD_ELEVATION_056 : 429|6@0+ (0.003490659,0) [0|0.20943951] "rad"  IFV
 SG_ CAN_FR_DET_AMPLITUDE_056 : 439|7@0+ (1,-64) [-64|63] "dBsm"  IFV
 SG_ CAN_FR_DET_VALID_FLAG_056 : 432|1@0+ (1,0) [0|1] ""  IFV
 SG_ CAN_FR_DET_SUPER_RES_056 : 440|1@0+ (1,0) [0|1] ""  IFV
 SG_ CAN_FR_DET_LOW_SNR_FLAG_056 : 441|1@0+ (1,0) [0|1] ""  IFV
 SG_ CAN_FR_DET_MIXER_BIAS_FLAG_056 : 442|1@0+ (1,0) [0|1] ""  IFV
 SG_ CAN_FR_DET_RESERVED_FLAGS_056 : 447|5@0+ (1,0) [0|31] ""  IFV
 SG_ CAN_FR_DET_SNR_056 : 455|8@0+ (0.35156,0) [0|89.6478] "dB"  IFV
 SG_ CAN_FR_DET_MULTI_TARGET_PROB_056 : 459|4@0+ (0.06667,0) [0|1] ""  IFV
 SG_ CAN_FR_DET_CONFID_AZIMUTH_056 : 461|2@0+ (1,0) [0|3] ""  IFV
 SG_ CAN_FR_DET_CONFID_ELEVATION_056 : 463|2@0+ (1,0) [0|3] ""  IFV
 SG_ CAN_FR_DET_EXISTENCE_PROB_056 : 467|4@0+ (1,0) [0|15] ""  IFV
 SG_ CAN_FR_DET_CLASS_056 : 471|4@0+ (1,0) [0|15] ""  IFV

BO_ 1038 SODFR_DETECTION_057_060: 64 SODFR
 SG_ CAN_FR_DET_RANGE_057 : 7|14@0+ (0.015625,0) [0|255.984375] "m"  IFV
 SG_ CAN_FR_DET_SD_RANGE_057 : 9|6@0+ (0.025,0) [0|1.5] "m"  IFV
 SG_ CAN_FR_DET_RANGE_RATE_057 : 19|14@0+ (0.015625,-128) [-128|127.984375] "m/s"  IFV
 SG_ CAN_FR_DET_SD_RANGE_RATE_057 : 37|6@0+ (0.02,0) [0|1.2] "m/s"  IFV
 SG_ CAN_FR_DET_AZIMUTH_057 : 47|13@0+ (0.0007668,-3.141593) [-3.141593|3.141593] "rad"  IFV
 SG_ CAN_FR_DET_SD_AZIMUTH_057 : 50|6@0+ (0.001745329,0) [0|0.104719755] "rad"  IFV
 SG_ CAN_FR_DET_ELEVATION_057 : 60|7@0+ (0.157449,-9.99812) [-9.99812|9.997903] "deg"  IFV
 SG_ CAN_FR_DET_SD_ELEVATION_057 : 69|6@0+ (0.003490659,0) [0|0.20943951] "rad"  IFV
 SG_ CAN_FR_DET_AMPLITUDE_057 : 79|7@0+ (1,-64) [-64|63] "dBsm"  IFV
 SG_ CAN_FR_DET_VALID_FLAG_057 : 72|1@0+ (1,0) [0|1] ""  IFV
 SG_ CAN_FR_DET_SUPER_RES_057 : 80|1@0+ (1,0) [0|1] ""  IFV
 SG_ CAN_FR_DET_LOW_SNR_FLAG_057 : 81|1@0+ (1,0) [0|1] ""  IFV
 SG_ CAN_FR_DET_MIXER_BIAS_FLAG_057 : 82|1@0+ (1,0) [0|1] ""  IFV
 SG_ CAN_FR_DET_RESERVED_FLAGS_057 : 87|5@0+ (1,0) [0|31] ""  IFV
 SG_ CAN_FR_DET_SNR_057 : 95|8@0+ (0.35156,0) [0|89.6478] "dB"  IFV
 SG_ CAN_FR_DET_MULTI_TARGET_PROB_057 : 99|4@0+ (0.06667,0) [0|1] ""  IFV
 SG_ CAN_FR_DET_CONFID_AZIMUTH_057 : 101|2@0+ (1,0) [0|3] ""  IFV
 SG_ CAN_FR_DET_CONFID_ELEVATION_057 : 103|2@0+ (1,0) [0|3] ""  IFV
 SG_ CAN_FR_DET_EXISTENCE_PROB_057 : 107|4@0+ (1,0) [0|15] ""  IFV
 SG_ CAN_FR_DET_CLASS_057 : 111|4@0+ (1,0) [0|15] ""  IFV
 SG_ CAN_FR_DET_RANGE_058 : 127|14@0+ (0.015625,0) [0|255.984375] "m"  IFV
 SG_ CAN_FR_DET_SD_RANGE_058 : 129|6@0+ (0.025,0) [0|1.5] "m"  IFV
 SG_ CAN_FR_DET_RANGE_RATE_058 : 139|14@0+ (0.015625,-128) [-128|127.984375] "m/s"  IFV
 SG_ CAN_FR_DET_SD_RANGE_RATE_058 : 157|6@0+ (0.02,0) [0|1.2] "m/s"  IFV
 SG_ CAN_FR_DET_AZIMUTH_058 : 167|13@0+ (0.0007668,-3.141593) [-3.141593|3.141593] "rad"  IFV
 SG_ CAN_FR_DET_SD_AZIMUTH_058 : 170|6@0+ (0.001745329,0) [0|0.104719755] "rad"  IFV
 SG_ CAN_FR_DET_ELEVATION_058 : 180|7@0+ (0.157449,-9.99812) [-9.99812|9.997903] "deg"  IFV
 SG_ CAN_FR_DET_SD_ELEVATION_058 : 189|6@0+ (0.003490659,0) [0|0.20943951] "rad"  IFV
 SG_ CAN_FR_DET_AMPLITUDE_058 : 199|7@0+ (1,-64) [-64|63] "dBsm"  IFV
 SG_ CAN_FR_DET_VALID_FLAG_058 : 192|1@0+ (1,0) [0|1] ""  IFV
 SG_ CAN_FR_DET_SUPER_RES_058 : 200|1@0+ (1,0) [0|1] ""  IFV
 SG_ CAN_FR_DET_LOW_SNR_FLAG_058 : 201|1@0+ (1,0) [0|1] ""  IFV
 SG_ CAN_FR_DET_MIXER_BIAS_FLAG_058 : 202|1@0+ (1,0) [0|1] ""  IFV
 SG_ CAN_FR_DET_RESERVED_FLAGS_058 : 207|5@0+ (1,0) [0|31] ""  IFV
 SG_ CAN_FR_DET_SNR_058 : 215|8@0+ (0.35156,0) [0|89.6478] "dB"  IFV
 SG_ CAN_FR_DET_MULTI_TARGET_PROB_058 : 219|4@0+ (0.06667,0) [0|1] ""  IFV
 SG_ CAN_FR_DET_CONFID_AZIMUTH_058 : 221|2@0+ (1,0) [0|3] ""  IFV
 SG_ CAN_FR_DET_CONFID_ELEVATION_058 : 223|2@0+ (1,0) [0|3] ""  IFV
 SG_ CAN_FR_DET_EXISTENCE_PROB_058 : 227|4@0+ (1,0) [0|15] ""  IFV
 SG_ CAN_FR_DET_CLASS_058 : 231|4@0+ (1,0) [0|15] ""  IFV
 SG_ CAN_FR_DET_RANGE_059 : 247|14@0+ (0.015625,0) [0|255.984375] "m"  IFV
 SG_ CAN_FR_DET_SD_RANGE_059 : 249|6@0+ (0.025,0) [0|1.5] "m"  IFV
 SG_ CAN_FR_DET_RANGE_RATE_059 : 259|14@0+ (0.015625,-128) [-128|127.984375] "m/s"  IFV
 SG_ CAN_FR_DET_SD_RANGE_RATE_059 : 277|6@0+ (0.02,0) [0|1.2] "m/s"  IFV
 SG_ CAN_FR_DET_AZIMUTH_059 : 287|13@0+ (0.0007668,-3.141593) [-3.141593|3.141593] "rad"  IFV
 SG_ CAN_FR_DET_SD_AZIMUTH_059 : 290|6@0+ (0.001745329,0) [0|0.104719755] "rad"  IFV
 SG_ CAN_FR_DET_ELEVATION_059 : 300|7@0+ (0.157449,-9.99812) [-9.99812|9.997903] "deg"  IFV
 SG_ CAN_FR_DET_SD_ELEVATION_059 : 309|6@0+ (0.003490659,0) [0|0.20943951] "rad"  IFV
 SG_ CAN_FR_DET_AMPLITUDE_059 : 319|7@0+ (1,-64) [-64|63] "dBsm"  IFV
 SG_ CAN_FR_DET_VALID_FLAG_059 : 312|1@0+ (1,0) [0|1] ""  IFV
 SG_ CAN_FR_DET_SUPER_RES_059 : 320|1@0+ (1,0) [0|1] ""  IFV
 SG_ CAN_FR_DET_LOW_SNR_FLAG_059 : 321|1@0+ (1,0) [0|1] ""  IFV
 SG_ CAN_FR_DET_MIXER_BIAS_FLAG_059 : 322|1@0+ (1,0) [0|1] ""  IFV
 SG_ CAN_FR_DET_RESERVED_FLAGS_059 : 327|5@0+ (1,0) [0|31] ""  IFV
 SG_ CAN_FR_DET_SNR_059 : 335|8@0+ (0.35156,0) [0|89.6478] "dB"  IFV
 SG_ CAN_FR_DET_MULTI_TARGET_PROB_059 : 339|4@0+ (0.06667,0) [0|1] ""  IFV
 SG_ CAN_FR_DET_CONFID_AZIMUTH_059 : 341|2@0+ (1,0) [0|3] ""  IFV
 SG_ CAN_FR_DET_CONFID_ELEVATION_059 : 343|2@0+ (1,0) [0|3] ""  IFV
 SG_ CAN_FR_DET_EXISTENCE_PROB_059 : 347|4@0+ (1,0) [0|15] ""  IFV
 SG_ CAN_FR_DET_CLASS_059 : 351|4@0+ (1,0) [0|15] ""  IFV
 SG_ CAN_FR_DET_RANGE_060 : 367|14@0+ (0.015625,0) [0|255.984375] "m"  IFV
 SG_ CAN_FR_DET_SD_RANGE_060 : 369|6@0+ (0.025,0) [0|1.5] "m"  IFV
 SG_ CAN_FR_DET_RANGE_RATE_060 : 379|14@0+ (0.015625,-128) [-128|127.984375] "m/s"  IFV
 SG_ CAN_FR_DET_SD_RANGE_RATE_060 : 397|6@0+ (0.02,0) [0|1.2] "m/s"  IFV
 SG_ CAN_FR_DET_AZIMUTH_060 : 407|13@0+ (0.0007668,-3.141593) [-3.141593|3.141593] "rad"  IFV
 SG_ CAN_FR_DET_SD_AZIMUTH_060 : 410|6@0+ (0.001745329,0) [0|0.104719755] "rad"  IFV
 SG_ CAN_FR_DET_ELEVATION_060 : 420|7@0+ (0.157449,-9.99812) [-9.99812|9.997903] "deg"  IFV
 SG_ CAN_FR_DET_SD_ELEVATION_060 : 429|6@0+ (0.003490659,0) [0|0.20943951] "rad"  IFV
 SG_ CAN_FR_DET_AMPLITUDE_060 : 439|7@0+ (1,-64) [-64|63] "dBsm"  IFV
 SG_ CAN_FR_DET_VALID_FLAG_060 : 432|1@0+ (1,0) [0|1] ""  IFV
 SG_ CAN_FR_DET_SUPER_RES_060 : 440|1@0+ (1,0) [0|1] ""  IFV
 SG_ CAN_FR_DET_LOW_SNR_FLAG_060 : 441|1@0+ (1,0) [0|1] ""  IFV
 SG_ CAN_FR_DET_MIXER_BIAS_FLAG_060 : 442|1@0+ (1,0) [0|1] ""  IFV
 SG_ CAN_FR_DET_RESERVED_FLAGS_060 : 447|5@0+ (1,0) [0|31] ""  IFV
 SG_ CAN_FR_DET_SNR_060 : 455|8@0+ (0.35156,0) [0|89.6478] "dB"  IFV
 SG_ CAN_FR_DET_MULTI_TARGET_PROB_060 : 459|4@0+ (0.06667,0) [0|1] ""  IFV
 SG_ CAN_FR_DET_CONFID_AZIMUTH_060 : 461|2@0+ (1,0) [0|3] ""  IFV
 SG_ CAN_FR_DET_CONFID_ELEVATION_060 : 463|2@0+ (1,0) [0|3] ""  IFV
 SG_ CAN_FR_DET_EXISTENCE_PROB_060 : 467|4@0+ (1,0) [0|15] ""  IFV
 SG_ CAN_FR_DET_CLASS_060 : 471|4@0+ (1,0) [0|15] ""  IFV

BO_ 1039 SODFR_DETECTION_061_064: 64 SODFR
 SG_ CAN_FR_DET_RANGE_061 : 7|14@0+ (0.015625,0) [0|255.984375] "m"  IFV
 SG_ CAN_FR_DET_SD_RANGE_061 : 9|6@0+ (0.025,0) [0|1.5] "m"  IFV
 SG_ CAN_FR_DET_RANGE_RATE_061 : 19|14@0+ (0.015625,-128) [-128|127.984375] "m/s"  IFV
 SG_ CAN_FR_DET_SD_RANGE_RATE_061 : 37|6@0+ (0.02,0) [0|1.2] "m/s"  IFV
 SG_ CAN_FR_DET_AZIMUTH_061 : 47|13@0+ (0.0007668,-3.141593) [-3.141593|3.141593] "rad"  IFV
 SG_ CAN_FR_DET_SD_AZIMUTH_061 : 50|6@0+ (0.001745329,0) [0|0.104719755] "rad"  IFV
 SG_ CAN_FR_DET_ELEVATION_061 : 60|7@0+ (0.157449,-9.99812) [-9.99812|9.997903] "deg"  IFV
 SG_ CAN_FR_DET_SD_ELEVATION_061 : 69|6@0+ (0.003490659,0) [0|0.20943951] "rad"  IFV
 SG_ CAN_FR_DET_AMPLITUDE_061 : 79|7@0+ (1,-64) [-64|63] "dBsm"  IFV
 SG_ CAN_FR_DET_VALID_FLAG_061 : 72|1@0+ (1,0) [0|1] ""  IFV
 SG_ CAN_FR_DET_SUPER_RES_061 : 80|1@0+ (1,0) [0|1] ""  IFV
 SG_ CAN_FR_DET_LOW_SNR_FLAG_061 : 81|1@0+ (1,0) [0|1] ""  IFV
 SG_ CAN_FR_DET_MIXER_BIAS_FLAG_061 : 82|1@0+ (1,0) [0|1] ""  IFV
 SG_ CAN_FR_DET_RESERVED_FLAGS_061 : 87|5@0+ (1,0) [0|31] ""  IFV
 SG_ CAN_FR_DET_SNR_061 : 95|8@0+ (0.35156,0) [0|89.6478] "dB"  IFV
 SG_ CAN_FR_DET_MULTI_TARGET_PROB_061 : 99|4@0+ (0.06667,0) [0|1] ""  IFV
 SG_ CAN_FR_DET_CONFID_AZIMUTH_061 : 101|2@0+ (1,0) [0|3] ""  IFV
 SG_ CAN_FR_DET_CONFID_ELEVATION_061 : 103|2@0+ (1,0) [0|3] ""  IFV
 SG_ CAN_FR_DET_EXISTENCE_PROB_061 : 107|4@0+ (1,0) [0|15] ""  IFV
 SG_ CAN_FR_DET_CLASS_061 : 111|4@0+ (1,0) [0|15] ""  IFV
 SG_ CAN_FR_DET_RANGE_062 : 127|14@0+ (0.015625,0) [0|255.984375] "m"  IFV
 SG_ CAN_FR_DET_SD_RANGE_062 : 129|6@0+ (0.025,0) [0|1.5] "m"  IFV
 SG_ CAN_FR_DET_RANGE_RATE_062 : 139|14@0+ (0.015625,-128) [-128|127.984375] "m/s"  IFV
 SG_ CAN_FR_DET_SD_RANGE_RATE_062 : 157|6@0+ (0.02,0) [0|1.2] "m/s"  IFV
 SG_ CAN_FR_DET_AZIMUTH_062 : 167|13@0+ (0.0007668,-3.141593) [-3.141593|3.141593] "rad"  IFV
 SG_ CAN_FR_DET_SD_AZIMUTH_062 : 170|6@0+ (0.001745329,0) [0|0.104719755] "rad"  IFV
 SG_ CAN_FR_DET_ELEVATION_062 : 180|7@0+ (0.157449,-9.99812) [-9.99812|9.997903] "deg"  IFV
 SG_ CAN_FR_DET_SD_ELEVATION_062 : 189|6@0+ (0.003490659,0) [0|0.20943951] "rad"  IFV
 SG_ CAN_FR_DET_AMPLITUDE_062 : 199|7@0+ (1,-64) [-64|63] "dBsm"  IFV
 SG_ CAN_FR_DET_VALID_FLAG_062 : 192|1@0+ (1,0) [0|1] ""  IFV
 SG_ CAN_FR_DET_SUPER_RES_062 : 200|1@0+ (1,0) [0|1] ""  IFV
 SG_ CAN_FR_DET_LOW_SNR_FLAG_062 : 201|1@0+ (1,0) [0|1] ""  IFV
 SG_ CAN_FR_DET_MIXER_BIAS_FLAG_062 : 202|1@0+ (1,0) [0|1] ""  IFV
 SG_ CAN_FR_DET_RESERVED_FLAGS_062 : 207|5@0+ (1,0) [0|31] ""  IFV
 SG_ CAN_FR_DET_SNR_062 : 215|8@0+ (0.35156,0) [0|89.6478] "dB"  IFV
 SG_ CAN_FR_DET_MULTI_TARGET_PROB_062 : 219|4@0+ (0.06667,0) [0|1] ""  IFV
 SG_ CAN_FR_DET_CONFID_AZIMUTH_062 : 221|2@0+ (1,0) [0|3] ""  IFV
 SG_ CAN_FR_DET_CONFID_ELEVATION_062 : 223|2@0+ (1,0) [0|3] ""  IFV
 SG_ CAN_FR_DET_EXISTENCE_PROB_062 : 227|4@0+ (1,0) [0|15] ""  IFV
 SG_ CAN_FR_DET_CLASS_062 : 231|4@0+ (1,0) [0|15] ""  IFV
 SG_ CAN_FR_DET_RANGE_063 : 247|14@0+ (0.015625,0) [0|255.984375] "m"  IFV
 SG_ CAN_FR_DET_SD_RANGE_063 : 249|6@0+ (0.025,0) [0|1.5] "m"  IFV
 SG_ CAN_FR_DET_RANGE_RATE_063 : 259|14@0+ (0.015625,-128) [-128|127.984375] "m/s"  IFV
 SG_ CAN_FR_DET_SD_RANGE_RATE_063 : 277|6@0+ (0.02,0) [0|1.2] "m/s"  IFV
 SG_ CAN_FR_DET_AZIMUTH_063 : 287|13@0+ (0.0007668,-3.141593) [-3.141593|3.141593] "rad"  IFV
 SG_ CAN_FR_DET_SD_AZIMUTH_063 : 290|6@0+ (0.001745329,0) [0|0.104719755] "rad"  IFV
 SG_ CAN_FR_DET_ELEVATION_063 : 300|7@0+ (0.157449,-9.99812) [-9.99812|9.997903] "deg"  IFV
 SG_ CAN_FR_DET_SD_ELEVATION_063 : 309|6@0+ (0.003490659,0) [0|0.20943951] "rad"  IFV
 SG_ CAN_FR_DET_AMPLITUDE_063 : 319|7@0+ (1,-64) [-64|63] "dBsm"  IFV
 SG_ CAN_FR_DET_VALID_FLAG_063 : 312|1@0+ (1,0) [0|1] ""  IFV
 SG_ CAN_FR_DET_SUPER_RES_063 : 320|1@0+ (1,0) [0|1] ""  IFV
 SG_ CAN_FR_DET_LOW_SNR_FLAG_063 : 321|1@0+ (1,0) [0|1] ""  IFV
 SG_ CAN_FR_DET_MIXER_BIAS_FLAG_063 : 322|1@0+ (1,0) [0|1] ""  IFV
 SG_ CAN_FR_DET_RESERVED_FLAGS_063 : 327|5@0+ (1,0) [0|31] ""  IFV
 SG_ CAN_FR_DET_SNR_063 : 335|8@0+ (0.35156,0) [0|89.6478] "dB"  IFV
 SG_ CAN_FR_DET_MULTI_TARGET_PROB_063 : 339|4@0+ (0.06667,0) [0|1] ""  IFV
 SG_ CAN_FR_DET_CONFID_AZIMUTH_063 : 341|2@0+ (1,0) [0|3] ""  IFV
 SG_ CAN_FR_DET_CONFID_ELEVATION_063 : 343|2@0+ (1,0) [0|3] ""  IFV
 SG_ CAN_FR_DET_EXISTENCE_PROB_063 : 347|4@0+ (1,0) [0|15] ""  IFV
 SG_ CAN_FR_DET_CLASS_063 : 351|4@0+ (1,0) [0|15] ""  IFV
 SG_ CAN_FR_DET_RANGE_064 : 367|14@0+ (0.015625,0) [0|255.984375] "m"  IFV
 SG_ CAN_FR_DET_SD_RANGE_064 : 369|6@0+ (0.025,0) [0|1.5] "m"  IFV
 SG_ CAN_FR_DET_RANGE_RATE_064 : 379|14@0+ (0.015625,-128) [-128|127.984375] "m/s"  IFV
 SG_ CAN_FR_DET_SD_RANGE_RATE_064 : 397|6@0+ (0.02,0) [0|1.2] "m/s"  IFV
 SG_ CAN_FR_DET_AZIMUTH_064 : 407|13@0+ (0.0007668,-3.141593) [-3.141593|3.141593] "rad"  IFV
 SG_ CAN_FR_DET_SD_AZIMUTH_064 : 410|6@0+ (0.001745329,0) [0|0.104719755] "rad"  IFV
 SG_ CAN_FR_DET_ELEVATION_064 : 420|7@0+ (0.157449,-9.99812) [-9.99812|9.997903] "deg"  IFV
 SG_ CAN_FR_DET_SD_ELEVATION_064 : 429|6@0+ (0.003490659,0) [0|0.20943951] "rad"  IFV
 SG_ CAN_FR_DET_AMPLITUDE_064 : 439|7@0+ (1,-64) [-64|63] "dBsm"  IFV
 SG_ CAN_FR_DET_VALID_FLAG_064 : 432|1@0+ (1,0) [0|1] ""  IFV
 SG_ CAN_FR_DET_SUPER_RES_064 : 440|1@0+ (1,0) [0|1] ""  IFV
 SG_ CAN_FR_DET_LOW_SNR_FLAG_064 : 441|1@0+ (1,0) [0|1] ""  IFV
 SG_ CAN_FR_DET_MIXER_BIAS_FLAG_064 : 442|1@0+ (1,0) [0|1] ""  IFV
 SG_ CAN_FR_DET_RESERVED_FLAGS_064 : 447|5@0+ (1,0) [0|31] ""  IFV
 SG_ CAN_FR_DET_SNR_064 : 455|8@0+ (0.35156,0) [0|89.6478] "dB"  IFV
 SG_ CAN_FR_DET_MULTI_TARGET_PROB_064 : 459|4@0+ (0.06667,0) [0|1] ""  IFV
 SG_ CAN_FR_DET_CONFID_AZIMUTH_064 : 461|2@0+ (1,0) [0|3] ""  IFV
 SG_ CAN_FR_DET_CONFID_ELEVATION_064 : 463|2@0+ (1,0) [0|3] ""  IFV
 SG_ CAN_FR_DET_EXISTENCE_PROB_064 : 467|4@0+ (1,0) [0|15] ""  IFV
 SG_ CAN_FR_DET_CLASS_064 : 471|4@0+ (1,0) [0|15] ""  IFV

BO_ 1040 SODFR_DETECTION_065_068: 64 SODFR
 SG_ CAN_FR_DET_RANGE_065 : 7|14@0+ (0.015625,0) [0|255.984375] "m"  IFV
 SG_ CAN_FR_DET_SD_RANGE_065 : 9|6@0+ (0.025,0) [0|1.5] "m"  IFV
 SG_ CAN_FR_DET_RANGE_RATE_065 : 19|14@0+ (0.015625,-128) [-128|127.984375] "m/s"  IFV
 SG_ CAN_FR_DET_SD_RANGE_RATE_065 : 37|6@0+ (0.02,0) [0|1.2] "m/s"  IFV
 SG_ CAN_FR_DET_AZIMUTH_065 : 47|13@0+ (0.0007668,-3.141593) [-3.141593|3.141593] "rad"  IFV
 SG_ CAN_FR_DET_SD_AZIMUTH_065 : 50|6@0+ (0.001745329,0) [0|0.104719755] "rad"  IFV
 SG_ CAN_FR_DET_ELEVATION_065 : 60|7@0+ (0.157449,-9.99812) [-9.99812|9.997903] "deg"  IFV
 SG_ CAN_FR_DET_SD_ELEVATION_065 : 69|6@0+ (0.003490659,0) [0|0.20943951] "rad"  IFV
 SG_ CAN_FR_DET_AMPLITUDE_065 : 79|7@0+ (1,-64) [-64|63] "dBsm"  IFV
 SG_ CAN_FR_DET_VALID_FLAG_065 : 72|1@0+ (1,0) [0|1] ""  IFV
 SG_ CAN_FR_DET_SUPER_RES_065 : 80|1@0+ (1,0) [0|1] ""  IFV
 SG_ CAN_FR_DET_LOW_SNR_FLAG_065 : 81|1@0+ (1,0) [0|1] ""  IFV
 SG_ CAN_FR_DET_MIXER_BIAS_FLAG_065 : 82|1@0+ (1,0) [0|1] ""  IFV
 SG_ CAN_FR_DET_RESERVED_FLAGS_065 : 87|5@0+ (1,0) [0|31] ""  IFV
 SG_ CAN_FR_DET_SNR_065 : 95|8@0+ (0.35156,0) [0|89.6478] "dB"  IFV
 SG_ CAN_FR_DET_MULTI_TARGET_PROB_065 : 99|4@0+ (0.06667,0) [0|1] ""  IFV
 SG_ CAN_FR_DET_CONFID_AZIMUTH_065 : 101|2@0+ (1,0) [0|3] ""  IFV
 SG_ CAN_FR_DET_CONFID_ELEVATION_065 : 103|2@0+ (1,0) [0|3] ""  IFV
 SG_ CAN_FR_DET_EXISTENCE_PROB_065 : 107|4@0+ (1,0) [0|15] ""  IFV
 SG_ CAN_FR_DET_CLASS_065 : 111|4@0+ (1,0) [0|15] ""  IFV
 SG_ CAN_FR_DET_RANGE_066 : 127|14@0+ (0.015625,0) [0|255.984375] "m"  IFV
 SG_ CAN_FR_DET_SD_RANGE_066 : 129|6@0+ (0.025,0) [0|1.5] "m"  IFV
 SG_ CAN_FR_DET_RANGE_RATE_066 : 139|14@0+ (0.015625,-128) [-128|127.984375] "m/s"  IFV
 SG_ CAN_FR_DET_SD_RANGE_RATE_066 : 157|6@0+ (0.02,0) [0|1.2] "m/s"  IFV
 SG_ CAN_FR_DET_AZIMUTH_066 : 167|13@0+ (0.0007668,-3.141593) [-3.141593|3.141593] "rad"  IFV
 SG_ CAN_FR_DET_SD_AZIMUTH_066 : 170|6@0+ (0.001745329,0) [0|0.104719755] "rad"  IFV
 SG_ CAN_FR_DET_ELEVATION_066 : 180|7@0+ (0.157449,-9.99812) [-9.99812|9.997903] "deg"  IFV
 SG_ CAN_FR_DET_SD_ELEVATION_066 : 189|6@0+ (0.003490659,0) [0|0.20943951] "rad"  IFV
 SG_ CAN_FR_DET_AMPLITUDE_066 : 199|7@0+ (1,-64) [-64|63] "dBsm"  IFV
 SG_ CAN_FR_DET_VALID_FLAG_066 : 192|1@0+ (1,0) [0|1] ""  IFV
 SG_ CAN_FR_DET_SUPER_RES_066 : 200|1@0+ (1,0) [0|1] ""  IFV
 SG_ CAN_FR_DET_LOW_SNR_FLAG_066 : 201|1@0+ (1,0) [0|1] ""  IFV
 SG_ CAN_FR_DET_MIXER_BIAS_FLAG_066 : 202|1@0+ (1,0) [0|1] ""  IFV
 SG_ CAN_FR_DET_RESERVED_FLAGS_066 : 207|5@0+ (1,0) [0|31] ""  IFV
 SG_ CAN_FR_DET_SNR_066 : 215|8@0+ (0.35156,0) [0|89.6478] "dB"  IFV
 SG_ CAN_FR_DET_MULTI_TARGET_PROB_066 : 219|4@0+ (0.06667,0) [0|1] ""  IFV
 SG_ CAN_FR_DET_CONFID_AZIMUTH_066 : 221|2@0+ (1,0) [0|3] ""  IFV
 SG_ CAN_FR_DET_CONFID_ELEVATION_066 : 223|2@0+ (1,0) [0|3] ""  IFV
 SG_ CAN_FR_DET_EXISTENCE_PROB_066 : 227|4@0+ (1,0) [0|15] ""  IFV
 SG_ CAN_FR_DET_CLASS_066 : 231|4@0+ (1,0) [0|15] ""  IFV
 SG_ CAN_FR_DET_RANGE_067 : 247|14@0+ (0.015625,0) [0|255.984375] "m"  IFV
 SG_ CAN_FR_DET_SD_RANGE_067 : 249|6@0+ (0.025,0) [0|1.5] "m"  IFV
 SG_ CAN_FR_DET_RANGE_RATE_067 : 259|14@0+ (0.015625,-128) [-128|127.984375] "m/s"  IFV
 SG_ CAN_FR_DET_SD_RANGE_RATE_067 : 277|6@0+ (0.02,0) [0|1.2] "m/s"  IFV
 SG_ CAN_FR_DET_AZIMUTH_067 : 287|13@0+ (0.0007668,-3.141593) [-3.141593|3.141593] "rad"  IFV
 SG_ CAN_FR_DET_SD_AZIMUTH_067 : 290|6@0+ (0.001745329,0) [0|0.104719755] "rad"  IFV
 SG_ CAN_FR_DET_ELEVATION_067 : 300|7@0+ (0.157449,-9.99812) [-9.99812|9.997903] "deg"  IFV
 SG_ CAN_FR_DET_SD_ELEVATION_067 : 309|6@0+ (0.003490659,0) [0|0.20943951] "rad"  IFV
 SG_ CAN_FR_DET_AMPLITUDE_067 : 319|7@0+ (1,-64) [-64|63] "dBsm"  IFV
 SG_ CAN_FR_DET_VALID_FLAG_067 : 312|1@0+ (1,0) [0|1] ""  IFV
 SG_ CAN_FR_DET_SUPER_RES_067 : 320|1@0+ (1,0) [0|1] ""  IFV
 SG_ CAN_FR_DET_LOW_SNR_FLAG_067 : 321|1@0+ (1,0) [0|1] ""  IFV
 SG_ CAN_FR_DET_MIXER_BIAS_FLAG_067 : 322|1@0+ (1,0) [0|1] ""  IFV
 SG_ CAN_FR_DET_RESERVED_FLAGS_067 : 327|5@0+ (1,0) [0|31] ""  IFV
 SG_ CAN_FR_DET_SNR_067 : 335|8@0+ (0.35156,0) [0|89.6478] "dB"  IFV
 SG_ CAN_FR_DET_MULTI_TARGET_PROB_067 : 339|4@0+ (0.06667,0) [0|1] ""  IFV
 SG_ CAN_FR_DET_CONFID_AZIMUTH_067 : 341|2@0+ (1,0) [0|3] ""  IFV
 SG_ CAN_FR_DET_CONFID_ELEVATION_067 : 343|2@0+ (1,0) [0|3] ""  IFV
 SG_ CAN_FR_DET_EXISTENCE_PROB_067 : 347|4@0+ (1,0) [0|15] ""  IFV
 SG_ CAN_FR_DET_CLASS_067 : 351|4@0+ (1,0) [0|15] ""  IFV
 SG_ CAN_FR_DET_RANGE_068 : 367|14@0+ (0.015625,0) [0|255.984375] "m"  IFV
 SG_ CAN_FR_DET_SD_RANGE_068 : 369|6@0+ (0.025,0) [0|1.5] "m"  IFV
 SG_ CAN_FR_DET_RANGE_RATE_068 : 379|14@0+ (0.015625,-128) [-128|127.984375] "m/s"  IFV
 SG_ CAN_FR_DET_SD_RANGE_RATE_068 : 397|6@0+ (0.02,0) [0|1.2] "m/s"  IFV
 SG_ CAN_FR_DET_AZIMUTH_068 : 407|13@0+ (0.0007668,-3.141593) [-3.141593|3.141593] "rad"  IFV
 SG_ CAN_FR_DET_SD_AZIMUTH_068 : 410|6@0+ (0.001745329,0) [0|0.104719755] "rad"  IFV
 SG_ CAN_FR_DET_ELEVATION_068 : 420|7@0+ (0.157449,-9.99812) [-9.99812|9.997903] "deg"  IFV
 SG_ CAN_FR_DET_SD_ELEVATION_068 : 429|6@0+ (0.003490659,0) [0|0.20943951] "rad"  IFV
 SG_ CAN_FR_DET_AMPLITUDE_068 : 439|7@0+ (1,-64) [-64|63] "dBsm"  IFV
 SG_ CAN_FR_DET_VALID_FLAG_068 : 432|1@0+ (1,0) [0|1] ""  IFV
 SG_ CAN_FR_DET_SUPER_RES_068 : 440|1@0+ (1,0) [0|1] ""  IFV
 SG_ CAN_FR_DET_LOW_SNR_FLAG_068 : 441|1@0+ (1,0) [0|1] ""  IFV
 SG_ CAN_FR_DET_MIXER_BIAS_FLAG_068 : 442|1@0+ (1,0) [0|1] ""  IFV
 SG_ CAN_FR_DET_RESERVED_FLAGS_068 : 447|5@0+ (1,0) [0|31] ""  IFV
 SG_ CAN_FR_DET_SNR_068 : 455|8@0+ (0.35156,0) [0|89.6478] "dB"  IFV
 SG_ CAN_FR_DET_MULTI_TARGET_PROB_068 : 459|4@0+ (0.06667,0) [0|1] ""  IFV
 SG_ CAN_FR_DET_CONFID_AZIMUTH_068 : 461|2@0+ (1,0) [0|3] ""  IFV
 SG_ CAN_FR_DET_CONFID_ELEVATION_068 : 463|2@0+ (1,0) [0|3] ""  IFV
 SG_ CAN_FR_DET_EXISTENCE_PROB_068 : 467|4@0+ (1,0) [0|15] ""  IFV
 SG_ CAN_FR_DET_CLASS_068 : 471|4@0+ (1,0) [0|15] ""  IFV

BO_ 1041 SODFR_DETECTION_069_072: 64 SODFR
 SG_ CAN_FR_DET_RANGE_069 : 7|14@0+ (0.015625,0) [0|255.984375] "m"  IFV
 SG_ CAN_FR_DET_SD_RANGE_069 : 9|6@0+ (0.025,0) [0|1.5] "m"  IFV
 SG_ CAN_FR_DET_RANGE_RATE_069 : 19|14@0+ (0.015625,-128) [-128|127.984375] "m/s"  IFV
 SG_ CAN_FR_DET_SD_RANGE_RATE_069 : 37|6@0+ (0.02,0) [0|1.2] "m/s"  IFV
 SG_ CAN_FR_DET_AZIMUTH_069 : 47|13@0+ (0.0007668,-3.141593) [-3.141593|3.141593] "rad"  IFV
 SG_ CAN_FR_DET_SD_AZIMUTH_069 : 50|6@0+ (0.001745329,0) [0|0.104719755] "rad"  IFV
 SG_ CAN_FR_DET_ELEVATION_069 : 60|7@0+ (0.157449,-9.99812) [-9.99812|9.997903] "deg"  IFV
 SG_ CAN_FR_DET_SD_ELEVATION_069 : 69|6@0+ (0.003490659,0) [0|0.20943951] "rad"  IFV
 SG_ CAN_FR_DET_AMPLITUDE_069 : 79|7@0+ (1,-64) [-64|63] "dBsm"  IFV
 SG_ CAN_FR_DET_VALID_FLAG_069 : 72|1@0+ (1,0) [0|1] ""  IFV
 SG_ CAN_FR_DET_SUPER_RES_069 : 80|1@0+ (1,0) [0|1] ""  IFV
 SG_ CAN_FR_DET_LOW_SNR_FLAG_069 : 81|1@0+ (1,0) [0|1] ""  IFV
 SG_ CAN_FR_DET_MIXER_BIAS_FLAG_069 : 82|1@0+ (1,0) [0|1] ""  IFV
 SG_ CAN_FR_DET_RESERVED_FLAGS_069 : 87|5@0+ (1,0) [0|31] ""  IFV
 SG_ CAN_FR_DET_SNR_069 : 95|8@0+ (0.35156,0) [0|89.6478] "dB"  IFV
 SG_ CAN_FR_DET_MULTI_TARGET_PROB_069 : 99|4@0+ (0.06667,0) [0|1] ""  IFV
 SG_ CAN_FR_DET_CONFID_AZIMUTH_069 : 101|2@0+ (1,0) [0|3] ""  IFV
 SG_ CAN_FR_DET_CONFID_ELEVATION_069 : 103|2@0+ (1,0) [0|3] ""  IFV
 SG_ CAN_FR_DET_EXISTENCE_PROB_069 : 107|4@0+ (1,0) [0|15] ""  IFV
 SG_ CAN_FR_DET_CLASS_069 : 111|4@0+ (1,0) [0|15] ""  IFV
 SG_ CAN_FR_DET_RANGE_070 : 127|14@0+ (0.015625,0) [0|255.984375] "m"  IFV
 SG_ CAN_FR_DET_SD_RANGE_070 : 129|6@0+ (0.025,0) [0|1.5] "m"  IFV
 SG_ CAN_FR_DET_RANGE_RATE_070 : 139|14@0+ (0.015625,-128) [-128|127.984375] "m/s"  IFV
 SG_ CAN_FR_DET_SD_RANGE_RATE_070 : 157|6@0+ (0.02,0) [0|1.2] "m/s"  IFV
 SG_ CAN_FR_DET_AZIMUTH_070 : 167|13@0+ (0.0007668,-3.141593) [-3.141593|3.141593] "rad"  IFV
 SG_ CAN_FR_DET_SD_AZIMUTH_070 : 170|6@0+ (0.001745329,0) [0|0.104719755] "rad"  IFV
 SG_ CAN_FR_DET_ELEVATION_070 : 180|7@0+ (0.157449,-9.99812) [-9.99812|9.997903] "deg"  IFV
 SG_ CAN_FR_DET_SD_ELEVATION_070 : 189|6@0+ (0.003490659,0) [0|0.20943951] "rad"  IFV
 SG_ CAN_FR_DET_AMPLITUDE_070 : 199|7@0+ (1,-64) [-64|63] "dBsm"  IFV
 SG_ CAN_FR_DET_VALID_FLAG_070 : 192|1@0+ (1,0) [0|1] ""  IFV
 SG_ CAN_FR_DET_SUPER_RES_070 : 200|1@0+ (1,0) [0|1] ""  IFV
 SG_ CAN_FR_DET_LOW_SNR_FLAG_070 : 201|1@0+ (1,0) [0|1] ""  IFV
 SG_ CAN_FR_DET_MIXER_BIAS_FLAG_070 : 202|1@0+ (1,0) [0|1] ""  IFV
 SG_ CAN_FR_DET_RESERVED_FLAGS_070 : 207|5@0+ (1,0) [0|31] ""  IFV
 SG_ CAN_FR_DET_SNR_070 : 215|8@0+ (0.35156,0) [0|89.6478] "dB"  IFV
 SG_ CAN_FR_DET_MULTI_TARGET_PROB_070 : 219|4@0+ (0.06667,0) [0|1] ""  IFV
 SG_ CAN_FR_DET_CONFID_AZIMUTH_070 : 221|2@0+ (1,0) [0|3] ""  IFV
 SG_ CAN_FR_DET_CONFID_ELEVATION_070 : 223|2@0+ (1,0) [0|3] ""  IFV
 SG_ CAN_FR_DET_EXISTENCE_PROB_070 : 227|4@0+ (1,0) [0|15] ""  IFV
 SG_ CAN_FR_DET_CLASS_070 : 231|4@0+ (1,0) [0|15] ""  IFV
 SG_ CAN_FR_DET_RANGE_071 : 247|14@0+ (0.015625,0) [0|255.984375] "m"  IFV
 SG_ CAN_FR_DET_SD_RANGE_071 : 249|6@0+ (0.025,0) [0|1.5] "m"  IFV
 SG_ CAN_FR_DET_RANGE_RATE_071 : 259|14@0+ (0.015625,-128) [-128|127.984375] "m/s"  IFV
 SG_ CAN_FR_DET_SD_RANGE_RATE_071 : 277|6@0+ (0.02,0) [0|1.2] "m/s"  IFV
 SG_ CAN_FR_DET_AZIMUTH_071 : 287|13@0+ (0.0007668,-3.141593) [-3.141593|3.141593] "rad"  IFV
 SG_ CAN_FR_DET_SD_AZIMUTH_071 : 290|6@0+ (0.001745329,0) [0|0.104719755] "rad"  IFV
 SG_ CAN_FR_DET_ELEVATION_071 : 300|7@0+ (0.157449,-9.99812) [-9.99812|9.997903] "deg"  IFV
 SG_ CAN_FR_DET_SD_ELEVATION_071 : 309|6@0+ (0.003490659,0) [0|0.20943951] "rad"  IFV
 SG_ CAN_FR_DET_AMPLITUDE_071 : 319|7@0+ (1,-64) [-64|63] "dBsm"  IFV
 SG_ CAN_FR_DET_VALID_FLAG_071 : 312|1@0+ (1,0) [0|1] ""  IFV
 SG_ CAN_FR_DET_SUPER_RES_071 : 320|1@0+ (1,0) [0|1] ""  IFV
 SG_ CAN_FR_DET_LOW_SNR_FLAG_071 : 321|1@0+ (1,0) [0|1] ""  IFV
 SG_ CAN_FR_DET_MIXER_BIAS_FLAG_071 : 322|1@0+ (1,0) [0|1] ""  IFV
 SG_ CAN_FR_DET_RESERVED_FLAGS_071 : 327|5@0+ (1,0) [0|31] ""  IFV
 SG_ CAN_FR_DET_SNR_071 : 335|8@0+ (0.35156,0) [0|89.6478] "dB"  IFV
 SG_ CAN_FR_DET_MULTI_TARGET_PROB_071 : 339|4@0+ (0.06667,0) [0|1] ""  IFV
 SG_ CAN_FR_DET_CONFID_AZIMUTH_071 : 341|2@0+ (1,0) [0|3] ""  IFV
 SG_ CAN_FR_DET_CONFID_ELEVATION_071 : 343|2@0+ (1,0) [0|3] ""  IFV
 SG_ CAN_FR_DET_EXISTENCE_PROB_071 : 347|4@0+ (1,0) [0|15] ""  IFV
 SG_ CAN_FR_DET_CLASS_071 : 351|4@0+ (1,0) [0|15] ""  IFV
 SG_ CAN_FR_DET_RANGE_072 : 367|14@0+ (0.015625,0) [0|255.984375] "m"  IFV
 SG_ CAN_FR_DET_SD_RANGE_072 : 369|6@0+ (0.025,0) [0|1.5] "m"  IFV
 SG_ CAN_FR_DET_RANGE_RATE_072 : 379|14@0+ (0.015625,-128) [-128|127.984375] "m/s"  IFV
 SG_ CAN_FR_DET_SD_RANGE_RATE_072 : 397|6@0+ (0.02,0) [0|1.2] "m/s"  IFV
 SG_ CAN_FR_DET_AZIMUTH_072 : 407|13@0+ (0.0007668,-3.141593) [-3.141593|3.141593] "rad"  IFV
 SG_ CAN_FR_DET_SD_AZIMUTH_072 : 410|6@0+ (0.001745329,0) [0|0.104719755] "rad"  IFV
 SG_ CAN_FR_DET_ELEVATION_072 : 420|7@0+ (0.157449,-9.99812) [-9.99812|9.997903] "deg"  IFV
 SG_ CAN_FR_DET_SD_ELEVATION_072 : 429|6@0+ (0.003490659,0) [0|0.20943951] "rad"  IFV
 SG_ CAN_FR_DET_AMPLITUDE_072 : 439|7@0+ (1,-64) [-64|63] "dBsm"  IFV
 SG_ CAN_FR_DET_VALID_FLAG_072 : 432|1@0+ (1,0) [0|1] ""  IFV
 SG_ CAN_FR_DET_SUPER_RES_072 : 440|1@0+ (1,0) [0|1] ""  IFV
 SG_ CAN_FR_DET_LOW_SNR_FLAG_072 : 441|1@0+ (1,0) [0|1] ""  IFV
 SG_ CAN_FR_DET_MIXER_BIAS_FLAG_072 : 442|1@0+ (1,0) [0|1] ""  IFV
 SG_ CAN_FR_DET_RESERVED_FLAGS_072 : 447|5@0+ (1,0) [0|31] ""  IFV
 SG_ CAN_FR_DET_SNR_072 : 455|8@0+ (0.35156,0) [0|89.6478] "dB"  IFV
 SG_ CAN_FR_DET_MULTI_TARGET_PROB_072 : 459|4@0+ (0.06667,0) [0|1] ""  IFV
 SG_ CAN_FR_DET_CONFID_AZIMUTH_072 : 461|2@0+ (1,0) [0|3] ""  IFV
 SG_ CAN_FR_DET_CONFID_ELEVATION_072 : 463|2@0+ (1,0) [0|3] ""  IFV
 SG_ CAN_FR_DET_EXISTENCE_PROB_072 : 467|4@0+ (1,0) [0|15] ""  IFV
 SG_ CAN_FR_DET_CLASS_072 : 471|4@0+ (1,0) [0|15] ""  IFV

BO_ 1042 SODFR_DETECTION_073_076: 64 SODFR
 SG_ CAN_FR_DET_RANGE_073 : 7|14@0+ (0.015625,0) [0|255.984375] "m"  IFV
 SG_ CAN_FR_DET_SD_RANGE_073 : 9|6@0+ (0.025,0) [0|1.5] "m"  IFV
 SG_ CAN_FR_DET_RANGE_RATE_073 : 19|14@0+ (0.015625,-128) [-128|127.984375] "m/s"  IFV
 SG_ CAN_FR_DET_SD_RANGE_RATE_073 : 37|6@0+ (0.02,0) [0|1.2] "m/s"  IFV
 SG_ CAN_FR_DET_AZIMUTH_073 : 47|13@0+ (0.0007668,-3.141593) [-3.141593|3.141593] "rad"  IFV
 SG_ CAN_FR_DET_SD_AZIMUTH_073 : 50|6@0+ (0.001745329,0) [0|0.104719755] "rad"  IFV
 SG_ CAN_FR_DET_ELEVATION_073 : 60|7@0+ (0.157449,-9.99812) [-9.99812|9.997903] "deg"  IFV
 SG_ CAN_FR_DET_SD_ELEVATION_073 : 69|6@0+ (0.003490659,0) [0|0.20943951] "rad"  IFV
 SG_ CAN_FR_DET_AMPLITUDE_073 : 79|7@0+ (1,-64) [-64|63] "dBsm"  IFV
 SG_ CAN_FR_DET_VALID_FLAG_073 : 72|1@0+ (1,0) [0|1] ""  IFV
 SG_ CAN_FR_DET_SUPER_RES_073 : 80|1@0+ (1,0) [0|1] ""  IFV
 SG_ CAN_FR_DET_LOW_SNR_FLAG_073 : 81|1@0+ (1,0) [0|1] ""  IFV
 SG_ CAN_FR_DET_MIXER_BIAS_FLAG_073 : 82|1@0+ (1,0) [0|1] ""  IFV
 SG_ CAN_FR_DET_RESERVED_FLAGS_073 : 87|5@0+ (1,0) [0|31] ""  IFV
 SG_ CAN_FR_DET_SNR_073 : 95|8@0+ (0.35156,0) [0|89.6478] "dB"  IFV
 SG_ CAN_FR_DET_MULTI_TARGET_PROB_073 : 99|4@0+ (0.06667,0) [0|1] ""  IFV
 SG_ CAN_FR_DET_CONFID_AZIMUTH_073 : 101|2@0+ (1,0) [0|3] ""  IFV
 SG_ CAN_FR_DET_CONFID_ELEVATION_073 : 103|2@0+ (1,0) [0|3] ""  IFV
 SG_ CAN_FR_DET_EXISTENCE_PROB_073 : 107|4@0+ (1,0) [0|15] ""  IFV
 SG_ CAN_FR_DET_CLASS_073 : 111|4@0+ (1,0) [0|15] ""  IFV
 SG_ CAN_FR_DET_RANGE_074 : 127|14@0+ (0.015625,0) [0|255.984375] "m"  IFV
 SG_ CAN_FR_DET_SD_RANGE_074 : 129|6@0+ (0.025,0) [0|1.5] "m"  IFV
 SG_ CAN_FR_DET_RANGE_RATE_074 : 139|14@0+ (0.015625,-128) [-128|127.984375] "m/s"  IFV
 SG_ CAN_FR_DET_SD_RANGE_RATE_074 : 157|6@0+ (0.02,0) [0|1.2] "m/s"  IFV
 SG_ CAN_FR_DET_AZIMUTH_074 : 167|13@0+ (0.0007668,-3.141593) [-3.141593|3.141593] "rad"  IFV
 SG_ CAN_FR_DET_SD_AZIMUTH_074 : 170|6@0+ (0.001745329,0) [0|0.104719755] "rad"  IFV
 SG_ CAN_FR_DET_ELEVATION_074 : 180|7@0+ (0.157449,-9.99812) [-9.99812|9.997903] "deg"  IFV
 SG_ CAN_FR_DET_SD_ELEVATION_074 : 189|6@0+ (0.003490659,0) [0|0.20943951] "rad"  IFV
 SG_ CAN_FR_DET_AMPLITUDE_074 : 199|7@0+ (1,-64) [-64|63] "dBsm"  IFV
 SG_ CAN_FR_DET_VALID_FLAG_074 : 192|1@0+ (1,0) [0|1] ""  IFV
 SG_ CAN_FR_DET_SUPER_RES_074 : 200|1@0+ (1,0) [0|1] ""  IFV
 SG_ CAN_FR_DET_LOW_SNR_FLAG_074 : 201|1@0+ (1,0) [0|1] ""  IFV
 SG_ CAN_FR_DET_MIXER_BIAS_FLAG_074 : 202|1@0+ (1,0) [0|1] ""  IFV
 SG_ CAN_FR_DET_RESERVED_FLAGS_074 : 207|5@0+ (1,0) [0|31] ""  IFV
 SG_ CAN_FR_DET_SNR_074 : 215|8@0+ (0.35156,0) [0|89.6478] "dB"  IFV
 SG_ CAN_FR_DET_MULTI_TARGET_PROB_074 : 219|4@0+ (0.06667,0) [0|1] ""  IFV
 SG_ CAN_FR_DET_CONFID_AZIMUTH_074 : 221|2@0+ (1,0) [0|3] ""  IFV
 SG_ CAN_FR_DET_CONFID_ELEVATION_074 : 223|2@0+ (1,0) [0|3] ""  IFV
 SG_ CAN_FR_DET_EXISTENCE_PROB_074 : 227|4@0+ (1,0) [0|15] ""  IFV
 SG_ CAN_FR_DET_CLASS_074 : 231|4@0+ (1,0) [0|15] ""  IFV
 SG_ CAN_FR_DET_RANGE_075 : 247|14@0+ (0.015625,0) [0|255.984375] "m"  IFV
 SG_ CAN_FR_DET_SD_RANGE_075 : 249|6@0+ (0.025,0) [0|1.5] "m"  IFV
 SG_ CAN_FR_DET_RANGE_RATE_075 : 259|14@0+ (0.015625,-128) [-128|127.984375] "m/s"  IFV
 SG_ CAN_FR_DET_SD_RANGE_RATE_075 : 277|6@0+ (0.02,0) [0|1.2] "m/s"  IFV
 SG_ CAN_FR_DET_AZIMUTH_075 : 287|13@0+ (0.0007668,-3.141593) [-3.141593|3.141593] "rad"  IFV
 SG_ CAN_FR_DET_SD_AZIMUTH_075 : 290|6@0+ (0.001745329,0) [0|0.104719755] "rad"  IFV
 SG_ CAN_FR_DET_ELEVATION_075 : 300|7@0+ (0.157449,-9.99812) [-9.99812|9.997903] "deg"  IFV
 SG_ CAN_FR_DET_SD_ELEVATION_075 : 309|6@0+ (0.003490659,0) [0|0.20943951] "rad"  IFV
 SG_ CAN_FR_DET_AMPLITUDE_075 : 319|7@0+ (1,-64) [-64|63] "dBsm"  IFV
 SG_ CAN_FR_DET_VALID_FLAG_075 : 312|1@0+ (1,0) [0|1] ""  IFV
 SG_ CAN_FR_DET_SUPER_RES_075 : 320|1@0+ (1,0) [0|1] ""  IFV
 SG_ CAN_FR_DET_LOW_SNR_FLAG_075 : 321|1@0+ (1,0) [0|1] ""  IFV
 SG_ CAN_FR_DET_MIXER_BIAS_FLAG_075 : 322|1@0+ (1,0) [0|1] ""  IFV
 SG_ CAN_FR_DET_RESERVED_FLAGS_075 : 327|5@0+ (1,0) [0|31] ""  IFV
 SG_ CAN_FR_DET_SNR_075 : 335|8@0+ (0.35156,0) [0|89.6478] "dB"  IFV
 SG_ CAN_FR_DET_MULTI_TARGET_PROB_075 : 339|4@0+ (0.06667,0) [0|1] ""  IFV
 SG_ CAN_FR_DET_CONFID_AZIMUTH_075 : 341|2@0+ (1,0) [0|3] ""  IFV
 SG_ CAN_FR_DET_CONFID_ELEVATION_075 : 343|2@0+ (1,0) [0|3] ""  IFV
 SG_ CAN_FR_DET_EXISTENCE_PROB_075 : 347|4@0+ (1,0) [0|15] ""  IFV
 SG_ CAN_FR_DET_CLASS_075 : 351|4@0+ (1,0) [0|15] ""  IFV
 SG_ CAN_FR_DET_RANGE_076 : 367|14@0+ (0.015625,0) [0|255.984375] "m"  IFV
 SG_ CAN_FR_DET_SD_RANGE_076 : 369|6@0+ (0.025,0) [0|1.5] "m"  IFV
 SG_ CAN_FR_DET_RANGE_RATE_076 : 379|14@0+ (0.015625,-128) [-128|127.984375] "m/s"  IFV
 SG_ CAN_FR_DET_SD_RANGE_RATE_076 : 397|6@0+ (0.02,0) [0|1.2] "m/s"  IFV
 SG_ CAN_FR_DET_AZIMUTH_076 : 407|13@0+ (0.0007668,-3.141593) [-3.141593|3.141593] "rad"  IFV
 SG_ CAN_FR_DET_SD_AZIMUTH_076 : 410|6@0+ (0.001745329,0) [0|0.104719755] "rad"  IFV
 SG_ CAN_FR_DET_ELEVATION_076 : 420|7@0+ (0.157449,-9.99812) [-9.99812|9.997903] "deg"  IFV
 SG_ CAN_FR_DET_SD_ELEVATION_076 : 429|6@0+ (0.003490659,0) [0|0.20943951] "rad"  IFV
 SG_ CAN_FR_DET_AMPLITUDE_076 : 439|7@0+ (1,-64) [-64|63] "dBsm"  IFV
 SG_ CAN_FR_DET_VALID_FLAG_076 : 432|1@0+ (1,0) [0|1] ""  IFV
 SG_ CAN_FR_DET_SUPER_RES_076 : 440|1@0+ (1,0) [0|1] ""  IFV
 SG_ CAN_FR_DET_LOW_SNR_FLAG_076 : 441|1@0+ (1,0) [0|1] ""  IFV
 SG_ CAN_FR_DET_MIXER_BIAS_FLAG_076 : 442|1@0+ (1,0) [0|1] ""  IFV
 SG_ CAN_FR_DET_RESERVED_FLAGS_076 : 447|5@0+ (1,0) [0|31] ""  IFV
 SG_ CAN_FR_DET_SNR_076 : 455|8@0+ (0.35156,0) [0|89.6478] "dB"  IFV
 SG_ CAN_FR_DET_MULTI_TARGET_PROB_076 : 459|4@0+ (0.06667,0) [0|1] ""  IFV
 SG_ CAN_FR_DET_CONFID_AZIMUTH_076 : 461|2@0+ (1,0) [0|3] ""  IFV
 SG_ CAN_FR_DET_CONFID_ELEVATION_076 : 463|2@0+ (1,0) [0|3] ""  IFV
 SG_ CAN_FR_DET_EXISTENCE_PROB_076 : 467|4@0+ (1,0) [0|15] ""  IFV
 SG_ CAN_FR_DET_CLASS_076 : 471|4@0+ (1,0) [0|15] ""  IFV

BO_ 1043 SODFR_DETECTION_077_080: 64 SODFR
 SG_ CAN_FR_DET_RANGE_077 : 7|14@0+ (0.015625,0) [0|255.984375] "m"  IFV
 SG_ CAN_FR_DET_SD_RANGE_077 : 9|6@0+ (0.025,0) [0|1.5] "m"  IFV
 SG_ CAN_FR_DET_RANGE_RATE_077 : 19|14@0+ (0.015625,-128) [-128|127.984375] "m/s"  IFV
 SG_ CAN_FR_DET_SD_RANGE_RATE_077 : 37|6@0+ (0.02,0) [0|1.2] "m/s"  IFV
 SG_ CAN_FR_DET_AZIMUTH_077 : 47|13@0+ (0.0007668,-3.141593) [-3.141593|3.141593] "rad"  IFV
 SG_ CAN_FR_DET_SD_AZIMUTH_077 : 50|6@0+ (0.001745329,0) [0|0.104719755] "rad"  IFV
 SG_ CAN_FR_DET_ELEVATION_077 : 60|7@0+ (0.157449,-9.99812) [-9.99812|9.997903] "deg"  IFV
 SG_ CAN_FR_DET_SD_ELEVATION_077 : 69|6@0+ (0.003490659,0) [0|0.20943951] "rad"  IFV
 SG_ CAN_FR_DET_AMPLITUDE_077 : 79|7@0+ (1,-64) [-64|63] "dBsm"  IFV
 SG_ CAN_FR_DET_VALID_FLAG_077 : 72|1@0+ (1,0) [0|1] ""  IFV
 SG_ CAN_FR_DET_SUPER_RES_077 : 80|1@0+ (1,0) [0|1] ""  IFV
 SG_ CAN_FR_DET_LOW_SNR_FLAG_077 : 81|1@0+ (1,0) [0|1] ""  IFV
 SG_ CAN_FR_DET_MIXER_BIAS_FLAG_077 : 82|1@0+ (1,0) [0|1] ""  IFV
 SG_ CAN_FR_DET_RESERVED_FLAGS_077 : 87|5@0+ (1,0) [0|31] ""  IFV
 SG_ CAN_FR_DET_SNR_077 : 95|8@0+ (0.35156,0) [0|89.6478] "dB"  IFV
 SG_ CAN_FR_DET_MULTI_TARGET_PROB_077 : 99|4@0+ (0.06667,0) [0|1] ""  IFV
 SG_ CAN_FR_DET_CONFID_AZIMUTH_077 : 101|2@0+ (1,0) [0|3] ""  IFV
 SG_ CAN_FR_DET_CONFID_ELEVATION_077 : 103|2@0+ (1,0) [0|3] ""  IFV
 SG_ CAN_FR_DET_EXISTENCE_PROB_077 : 107|4@0+ (1,0) [0|15] ""  IFV
 SG_ CAN_FR_DET_CLASS_077 : 111|4@0+ (1,0) [0|15] ""  IFV
 SG_ CAN_FR_DET_RANGE_078 : 127|14@0+ (0.015625,0) [0|255.984375] "m"  IFV
 SG_ CAN_FR_DET_SD_RANGE_078 : 129|6@0+ (0.025,0) [0|1.5] "m"  IFV
 SG_ CAN_FR_DET_RANGE_RATE_078 : 139|14@0+ (0.015625,-128) [-128|127.984375] "m/s"  IFV
 SG_ CAN_FR_DET_SD_RANGE_RATE_078 : 157|6@0+ (0.02,0) [0|1.2] "m/s"  IFV
 SG_ CAN_FR_DET_AZIMUTH_078 : 167|13@0+ (0.0007668,-3.141593) [-3.141593|3.141593] "rad"  IFV
 SG_ CAN_FR_DET_SD_AZIMUTH_078 : 170|6@0+ (0.001745329,0) [0|0.104719755] "rad"  IFV
 SG_ CAN_FR_DET_ELEVATION_078 : 180|7@0+ (0.157449,-9.99812) [-9.99812|9.997903] "deg"  IFV
 SG_ CAN_FR_DET_SD_ELEVATION_078 : 189|6@0+ (0.003490659,0) [0|0.20943951] "rad"  IFV
 SG_ CAN_FR_DET_AMPLITUDE_078 : 199|7@0+ (1,-64) [-64|63] "dBsm"  IFV
 SG_ CAN_FR_DET_VALID_FLAG_078 : 192|1@0+ (1,0) [0|1] ""  IFV
 SG_ CAN_FR_DET_SUPER_RES_078 : 200|1@0+ (1,0) [0|1] ""  IFV
 SG_ CAN_FR_DET_LOW_SNR_FLAG_078 : 201|1@0+ (1,0) [0|1] ""  IFV
 SG_ CAN_FR_DET_MIXER_BIAS_FLAG_078 : 202|1@0+ (1,0) [0|1] ""  IFV
 SG_ CAN_FR_DET_RESERVED_FLAGS_078 : 207|5@0+ (1,0) [0|31] ""  IFV
 SG_ CAN_FR_DET_SNR_078 : 215|8@0+ (0.35156,0) [0|89.6478] "dB"  IFV
 SG_ CAN_FR_DET_MULTI_TARGET_PROB_078 : 219|4@0+ (0.06667,0) [0|1] ""  IFV
 SG_ CAN_FR_DET_CONFID_AZIMUTH_078 : 221|2@0+ (1,0) [0|3] ""  IFV
 SG_ CAN_FR_DET_CONFID_ELEVATION_078 : 223|2@0+ (1,0) [0|3] ""  IFV
 SG_ CAN_FR_DET_EXISTENCE_PROB_078 : 227|4@0+ (1,0) [0|15] ""  IFV
 SG_ CAN_FR_DET_CLASS_078 : 231|4@0+ (1,0) [0|15] ""  IFV
 SG_ CAN_FR_DET_RANGE_079 : 247|14@0+ (0.015625,0) [0|255.984375] "m"  IFV
 SG_ CAN_FR_DET_SD_RANGE_079 : 249|6@0+ (0.025,0) [0|1.5] "m"  IFV
 SG_ CAN_FR_DET_RANGE_RATE_079 : 259|14@0+ (0.015625,-128) [-128|127.984375] "m/s"  IFV
 SG_ CAN_FR_DET_SD_RANGE_RATE_079 : 277|6@0+ (0.02,0) [0|1.2] "m/s"  IFV
 SG_ CAN_FR_DET_AZIMUTH_079 : 287|13@0+ (0.0007668,-3.141593) [-3.141593|3.141593] "rad"  IFV
 SG_ CAN_FR_DET_SD_AZIMUTH_079 : 290|6@0+ (0.001745329,0) [0|0.104719755] "rad"  IFV
 SG_ CAN_FR_DET_ELEVATION_079 : 300|7@0+ (0.157449,-9.99812) [-9.99812|9.997903] "deg"  IFV
 SG_ CAN_FR_DET_SD_ELEVATION_079 : 309|6@0+ (0.003490659,0) [0|0.20943951] "rad"  IFV
 SG_ CAN_FR_DET_AMPLITUDE_079 : 319|7@0+ (1,-64) [-64|63] "dBsm"  IFV
 SG_ CAN_FR_DET_VALID_FLAG_079 : 312|1@0+ (1,0) [0|1] ""  IFV
 SG_ CAN_FR_DET_SUPER_RES_079 : 320|1@0+ (1,0) [0|1] ""  IFV
 SG_ CAN_FR_DET_LOW_SNR_FLAG_079 : 321|1@0+ (1,0) [0|1] ""  IFV
 SG_ CAN_FR_DET_MIXER_BIAS_FLAG_079 : 322|1@0+ (1,0) [0|1] ""  IFV
 SG_ CAN_FR_DET_RESERVED_FLAGS_079 : 327|5@0+ (1,0) [0|31] ""  IFV
 SG_ CAN_FR_DET_SNR_079 : 335|8@0+ (0.35156,0) [0|89.6478] "dB"  IFV
 SG_ CAN_FR_DET_MULTI_TARGET_PROB_079 : 339|4@0+ (0.06667,0) [0|1] ""  IFV
 SG_ CAN_FR_DET_CONFID_AZIMUTH_079 : 341|2@0+ (1,0) [0|3] ""  IFV
 SG_ CAN_FR_DET_CONFID_ELEVATION_079 : 343|2@0+ (1,0) [0|3] ""  IFV
 SG_ CAN_FR_DET_EXISTENCE_PROB_079 : 347|4@0+ (1,0) [0|15] ""  IFV
 SG_ CAN_FR_DET_CLASS_079 : 351|4@0+ (1,0) [0|15] ""  IFV
 SG_ CAN_FR_DET_RANGE_080 : 367|14@0+ (0.015625,0) [0|255.984375] "m"  IFV
 SG_ CAN_FR_DET_SD_RANGE_080 : 369|6@0+ (0.025,0) [0|1.5] "m"  IFV
 SG_ CAN_FR_DET_RANGE_RATE_080 : 379|14@0+ (0.015625,-128) [-128|127.984375] "m/s"  IFV
 SG_ CAN_FR_DET_SD_RANGE_RATE_080 : 397|6@0+ (0.02,0) [0|1.2] "m/s"  IFV
 SG_ CAN_FR_DET_AZIMUTH_080 : 407|13@0+ (0.0007668,-3.141593) [-3.141593|3.141593] "rad"  IFV
 SG_ CAN_FR_DET_SD_AZIMUTH_080 : 410|6@0+ (0.001745329,0) [0|0.104719755] "rad"  IFV
 SG_ CAN_FR_DET_ELEVATION_080 : 420|7@0+ (0.157449,-9.99812) [-9.99812|9.997903] "deg"  IFV
 SG_ CAN_FR_DET_SD_ELEVATION_080 : 429|6@0+ (0.003490659,0) [0|0.20943951] "rad"  IFV
 SG_ CAN_FR_DET_AMPLITUDE_080 : 439|7@0+ (1,-64) [-64|63] "dBsm"  IFV
 SG_ CAN_FR_DET_VALID_FLAG_080 : 432|1@0+ (1,0) [0|1] ""  IFV
 SG_ CAN_FR_DET_SUPER_RES_080 : 440|1@0+ (1,0) [0|1] ""  IFV
 SG_ CAN_FR_DET_LOW_SNR_FLAG_080 : 441|1@0+ (1,0) [0|1] ""  IFV
 SG_ CAN_FR_DET_MIXER_BIAS_FLAG_080 : 442|1@0+ (1,0) [0|1] ""  IFV
 SG_ CAN_FR_DET_RESERVED_FLAGS_080 : 447|5@0+ (1,0) [0|31] ""  IFV
 SG_ CAN_FR_DET_SNR_080 : 455|8@0+ (0.35156,0) [0|89.6478] "dB"  IFV
 SG_ CAN_FR_DET_MULTI_TARGET_PROB_080 : 459|4@0+ (0.06667,0) [0|1] ""  IFV
 SG_ CAN_FR_DET_CONFID_AZIMUTH_080 : 461|2@0+ (1,0) [0|3] ""  IFV
 SG_ CAN_FR_DET_CONFID_ELEVATION_080 : 463|2@0+ (1,0) [0|3] ""  IFV
 SG_ CAN_FR_DET_EXISTENCE_PROB_080 : 467|4@0+ (1,0) [0|15] ""  IFV
 SG_ CAN_FR_DET_CLASS_080 : 471|4@0+ (1,0) [0|15] ""  IFV

BO_ 1044 SODFR_DETECTION_081_084: 64 SODFR
 SG_ CAN_FR_DET_RANGE_081 : 7|14@0+ (0.015625,0) [0|255.984375] "m"  IFV
 SG_ CAN_FR_DET_SD_RANGE_081 : 9|6@0+ (0.025,0) [0|1.5] "m"  IFV
 SG_ CAN_FR_DET_RANGE_RATE_081 : 19|14@0+ (0.015625,-128) [-128|127.984375] "m/s"  IFV
 SG_ CAN_FR_DET_SD_RANGE_RATE_081 : 37|6@0+ (0.02,0) [0|1.2] "m/s"  IFV
 SG_ CAN_FR_DET_AZIMUTH_081 : 47|13@0+ (0.0007668,-3.141593) [-3.141593|3.141593] "rad"  IFV
 SG_ CAN_FR_DET_SD_AZIMUTH_081 : 50|6@0+ (0.001745329,0) [0|0.104719755] "rad"  IFV
 SG_ CAN_FR_DET_ELEVATION_081 : 60|7@0+ (0.157449,-9.99812) [-9.99812|9.997903] "deg"  IFV
 SG_ CAN_FR_DET_SD_ELEVATION_081 : 69|6@0+ (0.003490659,0) [0|0.20943951] "rad"  IFV
 SG_ CAN_FR_DET_AMPLITUDE_081 : 79|7@0+ (1,-64) [-64|63] "dBsm"  IFV
 SG_ CAN_FR_DET_VALID_FLAG_081 : 72|1@0+ (1,0) [0|1] ""  IFV
 SG_ CAN_FR_DET_SUPER_RES_081 : 80|1@0+ (1,0) [0|1] ""  IFV
 SG_ CAN_FR_DET_LOW_SNR_FLAG_081 : 81|1@0+ (1,0) [0|1] ""  IFV
 SG_ CAN_FR_DET_MIXER_BIAS_FLAG_081 : 82|1@0+ (1,0) [0|1] ""  IFV
 SG_ CAN_FR_DET_RESERVED_FLAGS_081 : 87|5@0+ (1,0) [0|31] ""  IFV
 SG_ CAN_FR_DET_SNR_081 : 95|8@0+ (0.35156,0) [0|89.6478] "dB"  IFV
 SG_ CAN_FR_DET_MULTI_TARGET_PROB_081 : 99|4@0+ (0.06667,0) [0|1] ""  IFV
 SG_ CAN_FR_DET_CONFID_AZIMUTH_081 : 101|2@0+ (1,0) [0|3] ""  IFV
 SG_ CAN_FR_DET_CONFID_ELEVATION_081 : 103|2@0+ (1,0) [0|3] ""  IFV
 SG_ CAN_FR_DET_EXISTENCE_PROB_081 : 107|4@0+ (1,0) [0|15] ""  IFV
 SG_ CAN_FR_DET_CLASS_081 : 111|4@0+ (1,0) [0|15] ""  IFV
 SG_ CAN_FR_DET_RANGE_082 : 127|14@0+ (0.015625,0) [0|255.984375] "m"  IFV
 SG_ CAN_FR_DET_SD_RANGE_082 : 129|6@0+ (0.025,0) [0|1.5] "m"  IFV
 SG_ CAN_FR_DET_RANGE_RATE_082 : 139|14@0+ (0.015625,-128) [-128|127.984375] "m/s"  IFV
 SG_ CAN_FR_DET_SD_RANGE_RATE_082 : 157|6@0+ (0.02,0) [0|1.2] "m/s"  IFV
 SG_ CAN_FR_DET_AZIMUTH_082 : 167|13@0+ (0.0007668,-3.141593) [-3.141593|3.141593] "rad"  IFV
 SG_ CAN_FR_DET_SD_AZIMUTH_082 : 170|6@0+ (0.001745329,0) [0|0.104719755] "rad"  IFV
 SG_ CAN_FR_DET_ELEVATION_082 : 180|7@0+ (0.157449,-9.99812) [-9.99812|9.997903] "deg"  IFV
 SG_ CAN_FR_DET_SD_ELEVATION_082 : 189|6@0+ (0.003490659,0) [0|0.20943951] "rad"  IFV
 SG_ CAN_FR_DET_AMPLITUDE_082 : 199|7@0+ (1,-64) [-64|63] "dBsm"  IFV
 SG_ CAN_FR_DET_VALID_FLAG_082 : 192|1@0+ (1,0) [0|1] ""  IFV
 SG_ CAN_FR_DET_SUPER_RES_082 : 200|1@0+ (1,0) [0|1] ""  IFV
 SG_ CAN_FR_DET_LOW_SNR_FLAG_082 : 201|1@0+ (1,0) [0|1] ""  IFV
 SG_ CAN_FR_DET_MIXER_BIAS_FLAG_082 : 202|1@0+ (1,0) [0|1] ""  IFV
 SG_ CAN_FR_DET_RESERVED_FLAGS_082 : 207|5@0+ (1,0) [0|31] ""  IFV
 SG_ CAN_FR_DET_SNR_082 : 215|8@0+ (0.35156,0) [0|89.6478] "dB"  IFV
 SG_ CAN_FR_DET_MULTI_TARGET_PROB_082 : 219|4@0+ (0.06667,0) [0|1] ""  IFV
 SG_ CAN_FR_DET_CONFID_AZIMUTH_082 : 221|2@0+ (1,0) [0|3] ""  IFV
 SG_ CAN_FR_DET_CONFID_ELEVATION_082 : 223|2@0+ (1,0) [0|3] ""  IFV
 SG_ CAN_FR_DET_EXISTENCE_PROB_082 : 227|4@0+ (1,0) [0|15] ""  IFV
 SG_ CAN_FR_DET_CLASS_082 : 231|4@0+ (1,0) [0|15] ""  IFV
 SG_ CAN_FR_DET_RANGE_083 : 247|14@0+ (0.015625,0) [0|255.984375] "m"  IFV
 SG_ CAN_FR_DET_SD_RANGE_083 : 249|6@0+ (0.025,0) [0|1.5] "m"  IFV
 SG_ CAN_FR_DET_RANGE_RATE_083 : 259|14@0+ (0.015625,-128) [-128|127.984375] "m/s"  IFV
 SG_ CAN_FR_DET_SD_RANGE_RATE_083 : 277|6@0+ (0.02,0) [0|1.2] "m/s"  IFV
 SG_ CAN_FR_DET_AZIMUTH_083 : 287|13@0+ (0.0007668,-3.141593) [-3.141593|3.141593] "rad"  IFV
 SG_ CAN_FR_DET_SD_AZIMUTH_083 : 290|6@0+ (0.001745329,0) [0|0.104719755] "rad"  IFV
 SG_ CAN_FR_DET_ELEVATION_083 : 300|7@0+ (0.157449,-9.99812) [-9.99812|9.997903] "deg"  IFV
 SG_ CAN_FR_DET_SD_ELEVATION_083 : 309|6@0+ (0.003490659,0) [0|0.20943951] "rad"  IFV
 SG_ CAN_FR_DET_AMPLITUDE_083 : 319|7@0+ (1,-64) [-64|63] "dBsm"  IFV
 SG_ CAN_FR_DET_VALID_FLAG_083 : 312|1@0+ (1,0) [0|1] ""  IFV
 SG_ CAN_FR_DET_SUPER_RES_083 : 320|1@0+ (1,0) [0|1] ""  IFV
 SG_ CAN_FR_DET_LOW_SNR_FLAG_083 : 321|1@0+ (1,0) [0|1] ""  IFV
 SG_ CAN_FR_DET_MIXER_BIAS_FLAG_083 : 322|1@0+ (1,0) [0|1] ""  IFV
 SG_ CAN_FR_DET_RESERVED_FLAGS_083 : 327|5@0+ (1,0) [0|31] ""  IFV
 SG_ CAN_FR_DET_SNR_083 : 335|8@0+ (0.35156,0) [0|89.6478] "dB"  IFV
 SG_ CAN_FR_DET_MULTI_TARGET_PROB_083 : 339|4@0+ (0.06667,0) [0|1] ""  IFV
 SG_ CAN_FR_DET_CONFID_AZIMUTH_083 : 341|2@0+ (1,0) [0|3] ""  IFV
 SG_ CAN_FR_DET_CONFID_ELEVATION_083 : 343|2@0+ (1,0) [0|3] ""  IFV
 SG_ CAN_FR_DET_EXISTENCE_PROB_083 : 347|4@0+ (1,0) [0|15] ""  IFV
 SG_ CAN_FR_DET_CLASS_083 : 351|4@0+ (1,0) [0|15] ""  IFV
 SG_ CAN_FR_DET_RANGE_084 : 367|14@0+ (0.015625,0) [0|255.984375] "m"  IFV
 SG_ CAN_FR_DET_SD_RANGE_084 : 369|6@0+ (0.025,0) [0|1.5] "m"  IFV
 SG_ CAN_FR_DET_RANGE_RATE_084 : 379|14@0+ (0.015625,-128) [-128|127.984375] "m/s"  IFV
 SG_ CAN_FR_DET_SD_RANGE_RATE_084 : 397|6@0+ (0.02,0) [0|1.2] "m/s"  IFV
 SG_ CAN_FR_DET_AZIMUTH_084 : 407|13@0+ (0.0007668,-3.141593) [-3.141593|3.141593] "rad"  IFV
 SG_ CAN_FR_DET_SD_AZIMUTH_084 : 410|6@0+ (0.001745329,0) [0|0.104719755] "rad"  IFV
 SG_ CAN_FR_DET_ELEVATION_084 : 420|7@0+ (0.157449,-9.99812) [-9.99812|9.997903] "deg"  IFV
 SG_ CAN_FR_DET_SD_ELEVATION_084 : 429|6@0+ (0.003490659,0) [0|0.20943951] "rad"  IFV
 SG_ CAN_FR_DET_AMPLITUDE_084 : 439|7@0+ (1,-64) [-64|63] "dBsm"  IFV
 SG_ CAN_FR_DET_VALID_FLAG_084 : 432|1@0+ (1,0) [0|1] ""  IFV
 SG_ CAN_FR_DET_SUPER_RES_084 : 440|1@0+ (1,0) [0|1] ""  IFV
 SG_ CAN_FR_DET_LOW_SNR_FLAG_084 : 441|1@0+ (1,0) [0|1] ""  IFV
 SG_ CAN_FR_DET_MIXER_BIAS_FLAG_084 : 442|1@0+ (1,0) [0|1] ""  IFV
 SG_ CAN_FR_DET_RESERVED_FLAGS_084 : 447|5@0+ (1,0) [0|31] ""  IFV
 SG_ CAN_FR_DET_SNR_084 : 455|8@0+ (0.35156,0) [0|89.6478] "dB"  IFV
 SG_ CAN_FR_DET_MULTI_TARGET_PROB_084 : 459|4@0+ (0.06667,0) [0|1] ""  IFV
 SG_ CAN_FR_DET_CONFID_AZIMUTH_084 : 461|2@0+ (1,0) [0|3] ""  IFV
 SG_ CAN_FR_DET_CONFID_ELEVATION_084 : 463|2@0+ (1,0) [0|3] ""  IFV
 SG_ CAN_FR_DET_EXISTENCE_PROB_084 : 467|4@0+ (1,0) [0|15] ""  IFV
 SG_ CAN_FR_DET_CLASS_084 : 471|4@0+ (1,0) [0|15] ""  IFV

BO_ 1045 SODFR_DETECTION_085_088: 64 SODFR
 SG_ CAN_FR_DET_RANGE_085 : 7|14@0+ (0.015625,0) [0|255.984375] "m"  IFV
 SG_ CAN_FR_DET_SD_RANGE_085 : 9|6@0+ (0.025,0) [0|1.5] "m"  IFV
 SG_ CAN_FR_DET_RANGE_RATE_085 : 19|14@0+ (0.015625,-128) [-128|127.984375] "m/s"  IFV
 SG_ CAN_FR_DET_SD_RANGE_RATE_085 : 37|6@0+ (0.02,0) [0|1.2] "m/s"  IFV
 SG_ CAN_FR_DET_AZIMUTH_085 : 47|13@0+ (0.0007668,-3.141593) [-3.141593|3.141593] "rad"  IFV
 SG_ CAN_FR_DET_SD_AZIMUTH_085 : 50|6@0+ (0.001745329,0) [0|0.104719755] "rad"  IFV
 SG_ CAN_FR_DET_ELEVATION_085 : 60|7@0+ (0.157449,-9.99812) [-9.99812|9.997903] "deg"  IFV
 SG_ CAN_FR_DET_SD_ELEVATION_085 : 69|6@0+ (0.003490659,0) [0|0.20943951] "rad"  IFV
 SG_ CAN_FR_DET_AMPLITUDE_085 : 79|7@0+ (1,-64) [-64|63] "dBsm"  IFV
 SG_ CAN_FR_DET_VALID_FLAG_085 : 72|1@0+ (1,0) [0|1] ""  IFV
 SG_ CAN_FR_DET_SUPER_RES_085 : 80|1@0+ (1,0) [0|1] ""  IFV
 SG_ CAN_FR_DET_LOW_SNR_FLAG_085 : 81|1@0+ (1,0) [0|1] ""  IFV
 SG_ CAN_FR_DET_MIXER_BIAS_FLAG_085 : 82|1@0+ (1,0) [0|1] ""  IFV
 SG_ CAN_FR_DET_RESERVED_FLAGS_085 : 87|5@0+ (1,0) [0|31] ""  IFV
 SG_ CAN_FR_DET_SNR_085 : 95|8@0+ (0.35156,0) [0|89.6478] "dB"  IFV
 SG_ CAN_FR_DET_MULTI_TARGET_PROB_085 : 99|4@0+ (0.06667,0) [0|1] ""  IFV
 SG_ CAN_FR_DET_CONFID_AZIMUTH_085 : 101|2@0+ (1,0) [0|3] ""  IFV
 SG_ CAN_FR_DET_CONFID_ELEVATION_085 : 103|2@0+ (1,0) [0|3] ""  IFV
 SG_ CAN_FR_DET_EXISTENCE_PROB_085 : 107|4@0+ (1,0) [0|15] ""  IFV
 SG_ CAN_FR_DET_CLASS_085 : 111|4@0+ (1,0) [0|15] ""  IFV
 SG_ CAN_FR_DET_RANGE_086 : 127|14@0+ (0.015625,0) [0|255.984375] "m"  IFV
 SG_ CAN_FR_DET_SD_RANGE_086 : 129|6@0+ (0.025,0) [0|1.5] "m"  IFV
 SG_ CAN_FR_DET_RANGE_RATE_086 : 139|14@0+ (0.015625,-128) [-128|127.984375] "m/s"  IFV
 SG_ CAN_FR_DET_SD_RANGE_RATE_086 : 157|6@0+ (0.02,0) [0|1.2] "m/s"  IFV
 SG_ CAN_FR_DET_AZIMUTH_086 : 167|13@0+ (0.0007668,-3.141593) [-3.141593|3.141593] "rad"  IFV
 SG_ CAN_FR_DET_SD_AZIMUTH_086 : 170|6@0+ (0.001745329,0) [0|0.104719755] "rad"  IFV
 SG_ CAN_FR_DET_ELEVATION_086 : 180|7@0+ (0.157449,-9.99812) [-9.99812|9.997903] "deg"  IFV
 SG_ CAN_FR_DET_SD_ELEVATION_086 : 189|6@0+ (0.003490659,0) [0|0.20943951] "rad"  IFV
 SG_ CAN_FR_DET_AMPLITUDE_086 : 199|7@0+ (1,-64) [-64|63] "dBsm"  IFV
 SG_ CAN_FR_DET_VALID_FLAG_086 : 192|1@0+ (1,0) [0|1] ""  IFV
 SG_ CAN_FR_DET_SUPER_RES_086 : 200|1@0+ (1,0) [0|1] ""  IFV
 SG_ CAN_FR_DET_LOW_SNR_FLAG_086 : 201|1@0+ (1,0) [0|1] ""  IFV
 SG_ CAN_FR_DET_MIXER_BIAS_FLAG_086 : 202|1@0+ (1,0) [0|1] ""  IFV
 SG_ CAN_FR_DET_RESERVED_FLAGS_086 : 207|5@0+ (1,0) [0|31] ""  IFV
 SG_ CAN_FR_DET_SNR_086 : 215|8@0+ (0.35156,0) [0|89.6478] "dB"  IFV
 SG_ CAN_FR_DET_MULTI_TARGET_PROB_086 : 219|4@0+ (0.06667,0) [0|1] ""  IFV
 SG_ CAN_FR_DET_CONFID_AZIMUTH_086 : 221|2@0+ (1,0) [0|3] ""  IFV
 SG_ CAN_FR_DET_CONFID_ELEVATION_086 : 223|2@0+ (1,0) [0|3] ""  IFV
 SG_ CAN_FR_DET_EXISTENCE_PROB_086 : 227|4@0+ (1,0) [0|15] ""  IFV
 SG_ CAN_FR_DET_CLASS_086 : 231|4@0+ (1,0) [0|15] ""  IFV
 SG_ CAN_FR_DET_RANGE_087 : 247|14@0+ (0.015625,0) [0|255.984375] "m"  IFV
 SG_ CAN_FR_DET_SD_RANGE_087 : 249|6@0+ (0.025,0) [0|1.5] "m"  IFV
 SG_ CAN_FR_DET_RANGE_RATE_087 : 259|14@0+ (0.015625,-128) [-128|127.984375] "m/s"  IFV
 SG_ CAN_FR_DET_SD_RANGE_RATE_087 : 277|6@0+ (0.02,0) [0|1.2] "m/s"  IFV
 SG_ CAN_FR_DET_AZIMUTH_087 : 287|13@0+ (0.0007668,-3.141593) [-3.141593|3.141593] "rad"  IFV
 SG_ CAN_FR_DET_SD_AZIMUTH_087 : 290|6@0+ (0.001745329,0) [0|0.104719755] "rad"  IFV
 SG_ CAN_FR_DET_ELEVATION_087 : 300|7@0+ (0.157449,-9.99812) [-9.99812|9.997903] "deg"  IFV
 SG_ CAN_FR_DET_SD_ELEVATION_087 : 309|6@0+ (0.003490659,0) [0|0.20943951] "rad"  IFV
 SG_ CAN_FR_DET_AMPLITUDE_087 : 319|7@0+ (1,-64) [-64|63] "dBsm"  IFV
 SG_ CAN_FR_DET_VALID_FLAG_087 : 312|1@0+ (1,0) [0|1] ""  IFV
 SG_ CAN_FR_DET_SUPER_RES_087 : 320|1@0+ (1,0) [0|1] ""  IFV
 SG_ CAN_FR_DET_LOW_SNR_FLAG_087 : 321|1@0+ (1,0) [0|1] ""  IFV
 SG_ CAN_FR_DET_MIXER_BIAS_FLAG_087 : 322|1@0+ (1,0) [0|1] ""  IFV
 SG_ CAN_FR_DET_RESERVED_FLAGS_087 : 327|5@0+ (1,0) [0|31] ""  IFV
 SG_ CAN_FR_DET_SNR_087 : 335|8@0+ (0.35156,0) [0|89.6478] "dB"  IFV
 SG_ CAN_FR_DET_MULTI_TARGET_PROB_087 : 339|4@0+ (0.06667,0) [0|1] ""  IFV
 SG_ CAN_FR_DET_CONFID_AZIMUTH_087 : 341|2@0+ (1,0) [0|3] ""  IFV
 SG_ CAN_FR_DET_CONFID_ELEVATION_087 : 343|2@0+ (1,0) [0|3] ""  IFV
 SG_ CAN_FR_DET_EXISTENCE_PROB_087 : 347|4@0+ (1,0) [0|15] ""  IFV
 SG_ CAN_FR_DET_CLASS_087 : 351|4@0+ (1,0) [0|15] ""  IFV
 SG_ CAN_FR_DET_RANGE_088 : 367|14@0+ (0.015625,0) [0|255.984375] "m"  IFV
 SG_ CAN_FR_DET_SD_RANGE_088 : 369|6@0+ (0.025,0) [0|1.5] "m"  IFV
 SG_ CAN_FR_DET_RANGE_RATE_088 : 379|14@0+ (0.015625,-128) [-128|127.984375] "m/s"  IFV
 SG_ CAN_FR_DET_SD_RANGE_RATE_088 : 397|6@0+ (0.02,0) [0|1.2] "m/s"  IFV
 SG_ CAN_FR_DET_AZIMUTH_088 : 407|13@0+ (0.0007668,-3.141593) [-3.141593|3.141593] "rad"  IFV
 SG_ CAN_FR_DET_SD_AZIMUTH_088 : 410|6@0+ (0.001745329,0) [0|0.104719755] "rad"  IFV
 SG_ CAN_FR_DET_ELEVATION_088 : 420|7@0+ (0.157449,-9.99812) [-9.99812|9.997903] "deg"  IFV
 SG_ CAN_FR_DET_SD_ELEVATION_088 : 429|6@0+ (0.003490659,0) [0|0.20943951] "rad"  IFV
 SG_ CAN_FR_DET_AMPLITUDE_088 : 439|7@0+ (1,-64) [-64|63] "dBsm"  IFV
 SG_ CAN_FR_DET_VALID_FLAG_088 : 432|1@0+ (1,0) [0|1] ""  IFV
 SG_ CAN_FR_DET_SUPER_RES_088 : 440|1@0+ (1,0) [0|1] ""  IFV
 SG_ CAN_FR_DET_LOW_SNR_FLAG_088 : 441|1@0+ (1,0) [0|1] ""  IFV
 SG_ CAN_FR_DET_MIXER_BIAS_FLAG_088 : 442|1@0+ (1,0) [0|1] ""  IFV
 SG_ CAN_FR_DET_RESERVED_FLAGS_088 : 447|5@0+ (1,0) [0|31] ""  IFV
 SG_ CAN_FR_DET_SNR_088 : 455|8@0+ (0.35156,0) [0|89.6478] "dB"  IFV
 SG_ CAN_FR_DET_MULTI_TARGET_PROB_088 : 459|4@0+ (0.06667,0) [0|1] ""  IFV
 SG_ CAN_FR_DET_CONFID_AZIMUTH_088 : 461|2@0+ (1,0) [0|3] ""  IFV
 SG_ CAN_FR_DET_CONFID_ELEVATION_088 : 463|2@0+ (1,0) [0|3] ""  IFV
 SG_ CAN_FR_DET_EXISTENCE_PROB_088 : 467|4@0+ (1,0) [0|15] ""  IFV
 SG_ CAN_FR_DET_CLASS_088 : 471|4@0+ (1,0) [0|15] ""  IFV

BO_ 1046 SODFR_DETECTION_089_092: 64 SODFR
 SG_ CAN_FR_DET_RANGE_089 : 7|14@0+ (0.015625,0) [0|255.984375] "m"  IFV
 SG_ CAN_FR_DET_SD_RANGE_089 : 9|6@0+ (0.025,0) [0|1.5] "m"  IFV
 SG_ CAN_FR_DET_RANGE_RATE_089 : 19|14@0+ (0.015625,-128) [-128|127.984375] "m/s"  IFV
 SG_ CAN_FR_DET_SD_RANGE_RATE_089 : 37|6@0+ (0.02,0) [0|1.2] "m/s"  IFV
 SG_ CAN_FR_DET_AZIMUTH_089 : 47|13@0+ (0.0007668,-3.141593) [-3.141593|3.141593] "rad"  IFV
 SG_ CAN_FR_DET_SD_AZIMUTH_089 : 50|6@0+ (0.001745329,0) [0|0.104719755] "rad"  IFV
 SG_ CAN_FR_DET_ELEVATION_089 : 60|7@0+ (0.157449,-9.99812) [-9.99812|9.997903] "deg"  IFV
 SG_ CAN_FR_DET_SD_ELEVATION_089 : 69|6@0+ (0.003490659,0) [0|0.20943951] "rad"  IFV
 SG_ CAN_FR_DET_AMPLITUDE_089 : 79|7@0+ (1,-64) [-64|63] "dBsm"  IFV
 SG_ CAN_FR_DET_VALID_FLAG_089 : 72|1@0+ (1,0) [0|1] ""  IFV
 SG_ CAN_FR_DET_SUPER_RES_089 : 80|1@0+ (1,0) [0|1] ""  IFV
 SG_ CAN_FR_DET_LOW_SNR_FLAG_089 : 81|1@0+ (1,0) [0|1] ""  IFV
 SG_ CAN_FR_DET_MIXER_BIAS_FLAG_089 : 82|1@0+ (1,0) [0|1] ""  IFV
 SG_ CAN_FR_DET_RESERVED_FLAGS_089 : 87|5@0+ (1,0) [0|31] ""  IFV
 SG_ CAN_FR_DET_SNR_089 : 95|8@0+ (0.35156,0) [0|89.6478] "dB"  IFV
 SG_ CAN_FR_DET_MULTI_TARGET_PROB_089 : 99|4@0+ (0.06667,0) [0|1] ""  IFV
 SG_ CAN_FR_DET_CONFID_AZIMUTH_089 : 101|2@0+ (1,0) [0|3] ""  IFV
 SG_ CAN_FR_DET_CONFID_ELEVATION_089 : 103|2@0+ (1,0) [0|3] ""  IFV
 SG_ CAN_FR_DET_EXISTENCE_PROB_089 : 107|4@0+ (1,0) [0|15] ""  IFV
 SG_ CAN_FR_DET_CLASS_089 : 111|4@0+ (1,0) [0|15] ""  IFV
 SG_ CAN_FR_DET_RANGE_090 : 127|14@0+ (0.015625,0) [0|255.984375] "m"  IFV
 SG_ CAN_FR_DET_SD_RANGE_090 : 129|6@0+ (0.025,0) [0|1.5] "m"  IFV
 SG_ CAN_FR_DET_RANGE_RATE_090 : 139|14@0+ (0.015625,-128) [-128|127.984375] "m/s"  IFV
 SG_ CAN_FR_DET_SD_RANGE_RATE_090 : 157|6@0+ (0.02,0) [0|1.2] "m/s"  IFV
 SG_ CAN_FR_DET_AZIMUTH_090 : 167|13@0+ (0.0007668,-3.141593) [-3.141593|3.141593] "rad"  IFV
 SG_ CAN_FR_DET_SD_AZIMUTH_090 : 170|6@0+ (0.001745329,0) [0|0.104719755] "rad"  IFV
 SG_ CAN_FR_DET_ELEVATION_090 : 180|7@0+ (0.157449,-9.99812) [-9.99812|9.997903] "deg"  IFV
 SG_ CAN_FR_DET_SD_ELEVATION_090 : 189|6@0+ (0.003490659,0) [0|0.20943951] "rad"  IFV
 SG_ CAN_FR_DET_AMPLITUDE_090 : 199|7@0+ (1,-64) [-64|63] "dBsm"  IFV
 SG_ CAN_FR_DET_VALID_FLAG_090 : 192|1@0+ (1,0) [0|1] ""  IFV
 SG_ CAN_FR_DET_SUPER_RES_090 : 200|1@0+ (1,0) [0|1] ""  IFV
 SG_ CAN_FR_DET_LOW_SNR_FLAG_090 : 201|1@0+ (1,0) [0|1] ""  IFV
 SG_ CAN_FR_DET_MIXER_BIAS_FLAG_090 : 202|1@0+ (1,0) [0|1] ""  IFV
 SG_ CAN_FR_DET_RESERVED_FLAGS_090 : 207|5@0+ (1,0) [0|31] ""  IFV
 SG_ CAN_FR_DET_SNR_090 : 215|8@0+ (0.35156,0) [0|89.6478] "dB"  IFV
 SG_ CAN_FR_DET_MULTI_TARGET_PROB_090 : 219|4@0+ (0.06667,0) [0|1] ""  IFV
 SG_ CAN_FR_DET_CONFID_AZIMUTH_090 : 221|2@0+ (1,0) [0|3] ""  IFV
 SG_ CAN_FR_DET_CONFID_ELEVATION_090 : 223|2@0+ (1,0) [0|3] ""  IFV
 SG_ CAN_FR_DET_EXISTENCE_PROB_090 : 227|4@0+ (1,0) [0|15] ""  IFV
 SG_ CAN_FR_DET_CLASS_090 : 231|4@0+ (1,0) [0|15] ""  IFV
 SG_ CAN_FR_DET_RANGE_091 : 247|14@0+ (0.015625,0) [0|255.984375] "m"  IFV
 SG_ CAN_FR_DET_SD_RANGE_091 : 249|6@0+ (0.025,0) [0|1.5] "m"  IFV
 SG_ CAN_FR_DET_RANGE_RATE_091 : 259|14@0+ (0.015625,-128) [-128|127.984375] "m/s"  IFV
 SG_ CAN_FR_DET_SD_RANGE_RATE_091 : 277|6@0+ (0.02,0) [0|1.2] "m/s"  IFV
 SG_ CAN_FR_DET_AZIMUTH_091 : 287|13@0+ (0.0007668,-3.141593) [-3.141593|3.141593] "rad"  IFV
 SG_ CAN_FR_DET_SD_AZIMUTH_091 : 290|6@0+ (0.001745329,0) [0|0.104719755] "rad"  IFV
 SG_ CAN_FR_DET_ELEVATION_091 : 300|7@0+ (0.157449,-9.99812) [-9.99812|9.997903] "deg"  IFV
 SG_ CAN_FR_DET_SD_ELEVATION_091 : 309|6@0+ (0.003490659,0) [0|0.20943951] "rad"  IFV
 SG_ CAN_FR_DET_AMPLITUDE_091 : 319|7@0+ (1,-64) [-64|63] "dBsm"  IFV
 SG_ CAN_FR_DET_VALID_FLAG_091 : 312|1@0+ (1,0) [0|1] ""  IFV
 SG_ CAN_FR_DET_SUPER_RES_091 : 320|1@0+ (1,0) [0|1] ""  IFV
 SG_ CAN_FR_DET_LOW_SNR_FLAG_091 : 321|1@0+ (1,0) [0|1] ""  IFV
 SG_ CAN_FR_DET_MIXER_BIAS_FLAG_091 : 322|1@0+ (1,0) [0|1] ""  IFV
 SG_ CAN_FR_DET_RESERVED_FLAGS_091 : 327|5@0+ (1,0) [0|31] ""  IFV
 SG_ CAN_FR_DET_SNR_091 : 335|8@0+ (0.35156,0) [0|89.6478] "dB"  IFV
 SG_ CAN_FR_DET_MULTI_TARGET_PROB_091 : 339|4@0+ (0.06667,0) [0|1] ""  IFV
 SG_ CAN_FR_DET_CONFID_AZIMUTH_091 : 341|2@0+ (1,0) [0|3] ""  IFV
 SG_ CAN_FR_DET_CONFID_ELEVATION_091 : 343|2@0+ (1,0) [0|3] ""  IFV
 SG_ CAN_FR_DET_EXISTENCE_PROB_091 : 347|4@0+ (1,0) [0|15] ""  IFV
 SG_ CAN_FR_DET_CLASS_091 : 351|4@0+ (1,0) [0|15] ""  IFV
 SG_ CAN_FR_DET_RANGE_092 : 367|14@0+ (0.015625,0) [0|255.984375] "m"  IFV
 SG_ CAN_FR_DET_SD_RANGE_092 : 369|6@0+ (0.025,0) [0|1.5] "m"  IFV
 SG_ CAN_FR_DET_RANGE_RATE_092 : 379|14@0+ (0.015625,-128) [-128|127.984375] "m/s"  IFV
 SG_ CAN_FR_DET_SD_RANGE_RATE_092 : 397|6@0+ (0.02,0) [0|1.2] "m/s"  IFV
 SG_ CAN_FR_DET_AZIMUTH_092 : 407|13@0+ (0.0007668,-3.141593) [-3.141593|3.141593] "rad"  IFV
 SG_ CAN_FR_DET_SD_AZIMUTH_092 : 410|6@0+ (0.001745329,0) [0|0.104719755] "rad"  IFV
 SG_ CAN_FR_DET_ELEVATION_092 : 420|7@0+ (0.157449,-9.99812) [-9.99812|9.997903] "deg"  IFV
 SG_ CAN_FR_DET_SD_ELEVATION_092 : 429|6@0+ (0.003490659,0) [0|0.20943951] "rad"  IFV
 SG_ CAN_FR_DET_AMPLITUDE_092 : 439|7@0+ (1,-64) [-64|63] "dBsm"  IFV
 SG_ CAN_FR_DET_VALID_FLAG_092 : 432|1@0+ (1,0) [0|1] ""  IFV
 SG_ CAN_FR_DET_SUPER_RES_092 : 440|1@0+ (1,0) [0|1] ""  IFV
 SG_ CAN_FR_DET_LOW_SNR_FLAG_092 : 441|1@0+ (1,0) [0|1] ""  IFV
 SG_ CAN_FR_DET_MIXER_BIAS_FLAG_092 : 442|1@0+ (1,0) [0|1] ""  IFV
 SG_ CAN_FR_DET_RESERVED_FLAGS_092 : 447|5@0+ (1,0) [0|31] ""  IFV
 SG_ CAN_FR_DET_SNR_092 : 455|8@0+ (0.35156,0) [0|89.6478] "dB"  IFV
 SG_ CAN_FR_DET_MULTI_TARGET_PROB_092 : 459|4@0+ (0.06667,0) [0|1] ""  IFV
 SG_ CAN_FR_DET_CONFID_AZIMUTH_092 : 461|2@0+ (1,0) [0|3] ""  IFV
 SG_ CAN_FR_DET_CONFID_ELEVATION_092 : 463|2@0+ (1,0) [0|3] ""  IFV
 SG_ CAN_FR_DET_EXISTENCE_PROB_092 : 467|4@0+ (1,0) [0|15] ""  IFV
 SG_ CAN_FR_DET_CLASS_092 : 471|4@0+ (1,0) [0|15] ""  IFV

BO_ 1047 SODFR_DETECTION_093_096: 64 SODFR
 SG_ CAN_FR_DET_RANGE_093 : 7|14@0+ (0.015625,0) [0|255.984375] "m"  IFV
 SG_ CAN_FR_DET_SD_RANGE_093 : 9|6@0+ (0.025,0) [0|1.5] "m"  IFV
 SG_ CAN_FR_DET_RANGE_RATE_093 : 19|14@0+ (0.015625,-128) [-128|127.984375] "m/s"  IFV
 SG_ CAN_FR_DET_SD_RANGE_RATE_093 : 37|6@0+ (0.02,0) [0|1.2] "m/s"  IFV
 SG_ CAN_FR_DET_AZIMUTH_093 : 47|13@0+ (0.0007668,-3.141593) [-3.141593|3.141593] "rad"  IFV
 SG_ CAN_FR_DET_SD_AZIMUTH_093 : 50|6@0+ (0.001745329,0) [0|0.104719755] "rad"  IFV
 SG_ CAN_FR_DET_ELEVATION_093 : 60|7@0+ (0.157449,-9.99812) [-9.99812|9.997903] "deg"  IFV
 SG_ CAN_FR_DET_SD_ELEVATION_093 : 69|6@0+ (0.003490659,0) [0|0.20943951] "rad"  IFV
 SG_ CAN_FR_DET_AMPLITUDE_093 : 79|7@0+ (1,-64) [-64|63] "dBsm"  IFV
 SG_ CAN_FR_DET_VALID_FLAG_093 : 72|1@0+ (1,0) [0|1] ""  IFV
 SG_ CAN_FR_DET_SUPER_RES_093 : 80|1@0+ (1,0) [0|1] ""  IFV
 SG_ CAN_FR_DET_LOW_SNR_FLAG_093 : 81|1@0+ (1,0) [0|1] ""  IFV
 SG_ CAN_FR_DET_MIXER_BIAS_FLAG_093 : 82|1@0+ (1,0) [0|1] ""  IFV
 SG_ CAN_FR_DET_RESERVED_FLAGS_093 : 87|5@0+ (1,0) [0|31] ""  IFV
 SG_ CAN_FR_DET_SNR_093 : 95|8@0+ (0.35156,0) [0|89.6478] "dB"  IFV
 SG_ CAN_FR_DET_MULTI_TARGET_PROB_093 : 99|4@0+ (0.06667,0) [0|1] ""  IFV
 SG_ CAN_FR_DET_CONFID_AZIMUTH_093 : 101|2@0+ (1,0) [0|3] ""  IFV
 SG_ CAN_FR_DET_CONFID_ELEVATION_093 : 103|2@0+ (1,0) [0|3] ""  IFV
 SG_ CAN_FR_DET_EXISTENCE_PROB_093 : 107|4@0+ (1,0) [0|15] ""  IFV
 SG_ CAN_FR_DET_CLASS_093 : 111|4@0+ (1,0) [0|15] ""  IFV
 SG_ CAN_FR_DET_RANGE_094 : 127|14@0+ (0.015625,0) [0|255.984375] "m"  IFV
 SG_ CAN_FR_DET_SD_RANGE_094 : 129|6@0+ (0.025,0) [0|1.5] "m"  IFV
 SG_ CAN_FR_DET_RANGE_RATE_094 : 139|14@0+ (0.015625,-128) [-128|127.984375] "m/s"  IFV
 SG_ CAN_FR_DET_SD_RANGE_RATE_094 : 157|6@0+ (0.02,0) [0|1.2] "m/s"  IFV
 SG_ CAN_FR_DET_AZIMUTH_094 : 167|13@0+ (0.0007668,-3.141593) [-3.141593|3.141593] "rad"  IFV
 SG_ CAN_FR_DET_SD_AZIMUTH_094 : 170|6@0+ (0.001745329,0) [0|0.104719755] "rad"  IFV
 SG_ CAN_FR_DET_ELEVATION_094 : 180|7@0+ (0.157449,-9.99812) [-9.99812|9.997903] "deg"  IFV
 SG_ CAN_FR_DET_SD_ELEVATION_094 : 189|6@0+ (0.003490659,0) [0|0.20943951] "rad"  IFV
 SG_ CAN_FR_DET_AMPLITUDE_094 : 199|7@0+ (1,-64) [-64|63] "dBsm"  IFV
 SG_ CAN_FR_DET_VALID_FLAG_094 : 192|1@0+ (1,0) [0|1] ""  IFV
 SG_ CAN_FR_DET_SUPER_RES_094 : 200|1@0+ (1,0) [0|1] ""  IFV
 SG_ CAN_FR_DET_LOW_SNR_FLAG_094 : 201|1@0+ (1,0) [0|1] ""  IFV
 SG_ CAN_FR_DET_MIXER_BIAS_FLAG_094 : 202|1@0+ (1,0) [0|1] ""  IFV
 SG_ CAN_FR_DET_RESERVED_FLAGS_094 : 207|5@0+ (1,0) [0|31] ""  IFV
 SG_ CAN_FR_DET_SNR_094 : 215|8@0+ (0.35156,0) [0|89.6478] "dB"  IFV
 SG_ CAN_FR_DET_MULTI_TARGET_PROB_094 : 219|4@0+ (0.06667,0) [0|1] ""  IFV
 SG_ CAN_FR_DET_CONFID_AZIMUTH_094 : 221|2@0+ (1,0) [0|3] ""  IFV
 SG_ CAN_FR_DET_CONFID_ELEVATION_094 : 223|2@0+ (1,0) [0|3] ""  IFV
 SG_ CAN_FR_DET_EXISTENCE_PROB_094 : 227|4@0+ (1,0) [0|15] ""  IFV
 SG_ CAN_FR_DET_CLASS_094 : 231|4@0+ (1,0) [0|15] ""  IFV
 SG_ CAN_FR_DET_RANGE_095 : 247|14@0+ (0.015625,0) [0|255.984375] "m"  IFV
 SG_ CAN_FR_DET_SD_RANGE_095 : 249|6@0+ (0.025,0) [0|1.5] "m"  IFV
 SG_ CAN_FR_DET_RANGE_RATE_095 : 259|14@0+ (0.015625,-128) [-128|127.984375] "m/s"  IFV
 SG_ CAN_FR_DET_SD_RANGE_RATE_095 : 277|6@0+ (0.02,0) [0|1.2] "m/s"  IFV
 SG_ CAN_FR_DET_AZIMUTH_095 : 287|13@0+ (0.0007668,-3.141593) [-3.141593|3.141593] "rad"  IFV
 SG_ CAN_FR_DET_SD_AZIMUTH_095 : 290|6@0+ (0.001745329,0) [0|0.104719755] "rad"  IFV
 SG_ CAN_FR_DET_ELEVATION_095 : 300|7@0+ (0.157449,-9.99812) [-9.99812|9.997903] "deg"  IFV
 SG_ CAN_FR_DET_SD_ELEVATION_095 : 309|6@0+ (0.003490659,0) [0|0.20943951] "rad"  IFV
 SG_ CAN_FR_DET_AMPLITUDE_095 : 319|7@0+ (1,-64) [-64|63] "dBsm"  IFV
 SG_ CAN_FR_DET_VALID_FLAG_095 : 312|1@0+ (1,0) [0|1] ""  IFV
 SG_ CAN_FR_DET_SUPER_RES_095 : 320|1@0+ (1,0) [0|1] ""  IFV
 SG_ CAN_FR_DET_LOW_SNR_FLAG_095 : 321|1@0+ (1,0) [0|1] ""  IFV
 SG_ CAN_FR_DET_MIXER_BIAS_FLAG_095 : 322|1@0+ (1,0) [0|1] ""  IFV
 SG_ CAN_FR_DET_RESERVED_FLAGS_095 : 327|5@0+ (1,0) [0|31] ""  IFV
 SG_ CAN_FR_DET_SNR_095 : 335|8@0+ (0.35156,0) [0|89.6478] "dB"  IFV
 SG_ CAN_FR_DET_MULTI_TARGET_PROB_095 : 339|4@0+ (0.06667,0) [0|1] ""  IFV
 SG_ CAN_FR_DET_CONFID_AZIMUTH_095 : 341|2@0+ (1,0) [0|3] ""  IFV
 SG_ CAN_FR_DET_CONFID_ELEVATION_095 : 343|2@0+ (1,0) [0|3] ""  IFV
 SG_ CAN_FR_DET_EXISTENCE_PROB_095 : 347|4@0+ (1,0) [0|15] ""  IFV
 SG_ CAN_FR_DET_CLASS_095 : 351|4@0+ (1,0) [0|15] ""  IFV
 SG_ CAN_FR_DET_RANGE_096 : 367|14@0+ (0.015625,0) [0|255.984375] "m"  IFV
 SG_ CAN_FR_DET_SD_RANGE_096 : 369|6@0+ (0.025,0) [0|1.5] "m"  IFV
 SG_ CAN_FR_DET_RANGE_RATE_096 : 379|14@0+ (0.015625,-128) [-128|127.984375] "m/s"  IFV
 SG_ CAN_FR_DET_SD_RANGE_RATE_096 : 397|6@0+ (0.02,0) [0|1.2] "m/s"  IFV
 SG_ CAN_FR_DET_AZIMUTH_096 : 407|13@0+ (0.0007668,-3.141593) [-3.141593|3.141593] "rad"  IFV
 SG_ CAN_FR_DET_SD_AZIMUTH_096 : 410|6@0+ (0.001745329,0) [0|0.104719755] "rad"  IFV
 SG_ CAN_FR_DET_ELEVATION_096 : 420|7@0+ (0.157449,-9.99812) [-9.99812|9.997903] "deg"  IFV
 SG_ CAN_FR_DET_SD_ELEVATION_096 : 429|6@0+ (0.003490659,0) [0|0.20943951] "rad"  IFV
 SG_ CAN_FR_DET_AMPLITUDE_096 : 439|7@0+ (1,-64) [-64|63] "dBsm"  IFV
 SG_ CAN_FR_DET_VALID_FLAG_096 : 432|1@0+ (1,0) [0|1] ""  IFV
 SG_ CAN_FR_DET_SUPER_RES_096 : 440|1@0+ (1,0) [0|1] ""  IFV
 SG_ CAN_FR_DET_LOW_SNR_FLAG_096 : 441|1@0+ (1,0) [0|1] ""  IFV
 SG_ CAN_FR_DET_MIXER_BIAS_FLAG_096 : 442|1@0+ (1,0) [0|1] ""  IFV
 SG_ CAN_FR_DET_RESERVED_FLAGS_096 : 447|5@0+ (1,0) [0|31] ""  IFV
 SG_ CAN_FR_DET_SNR_096 : 455|8@0+ (0.35156,0) [0|89.6478] "dB"  IFV
 SG_ CAN_FR_DET_MULTI_TARGET_PROB_096 : 459|4@0+ (0.06667,0) [0|1] ""  IFV
 SG_ CAN_FR_DET_CONFID_AZIMUTH_096 : 461|2@0+ (1,0) [0|3] ""  IFV
 SG_ CAN_FR_DET_CONFID_ELEVATION_096 : 463|2@0+ (1,0) [0|3] ""  IFV
 SG_ CAN_FR_DET_EXISTENCE_PROB_096 : 467|4@0+ (1,0) [0|15] ""  IFV
 SG_ CAN_FR_DET_CLASS_096 : 471|4@0+ (1,0) [0|15] ""  IFV

BO_ 1048 SODFR_DETECTION_097_100: 64 SODFR
 SG_ CAN_FR_DET_RANGE_097 : 7|14@0+ (0.015625,0) [0|255.984375] "m"  IFV
 SG_ CAN_FR_DET_SD_RANGE_097 : 9|6@0+ (0.025,0) [0|1.5] "m"  IFV
 SG_ CAN_FR_DET_RANGE_RATE_097 : 19|14@0+ (0.015625,-128) [-128|127.984375] "m/s"  IFV
 SG_ CAN_FR_DET_SD_RANGE_RATE_097 : 37|6@0+ (0.02,0) [0|1.2] "m/s"  IFV
 SG_ CAN_FR_DET_AZIMUTH_097 : 47|13@0+ (0.0007668,-3.141593) [-3.141593|3.141593] "rad"  IFV
 SG_ CAN_FR_DET_SD_AZIMUTH_097 : 50|6@0+ (0.001745329,0) [0|0.104719755] "rad"  IFV
 SG_ CAN_FR_DET_ELEVATION_097 : 60|7@0+ (0.157449,-9.99812) [-9.99812|9.997903] "deg"  IFV
 SG_ CAN_FR_DET_SD_ELEVATION_097 : 69|6@0+ (0.003490659,0) [0|0.20943951] "rad"  IFV
 SG_ CAN_FR_DET_AMPLITUDE_097 : 79|7@0+ (1,-64) [-64|63] "dBsm"  IFV
 SG_ CAN_FR_DET_VALID_FLAG_097 : 72|1@0+ (1,0) [0|1] ""  IFV
 SG_ CAN_FR_DET_SUPER_RES_097 : 80|1@0+ (1,0) [0|1] ""  IFV
 SG_ CAN_FR_DET_LOW_SNR_FLAG_097 : 81|1@0+ (1,0) [0|1] ""  IFV
 SG_ CAN_FR_DET_MIXER_BIAS_FLAG_097 : 82|1@0+ (1,0) [0|1] ""  IFV
 SG_ CAN_FR_DET_RESERVED_FLAGS_097 : 87|5@0+ (1,0) [0|31] ""  IFV
 SG_ CAN_FR_DET_SNR_097 : 95|8@0+ (0.35156,0) [0|89.6478] "dB"  IFV
 SG_ CAN_FR_DET_MULTI_TARGET_PROB_097 : 99|4@0+ (0.06667,0) [0|1] ""  IFV
 SG_ CAN_FR_DET_CONFID_AZIMUTH_097 : 101|2@0+ (1,0) [0|3] ""  IFV
 SG_ CAN_FR_DET_CONFID_ELEVATION_097 : 103|2@0+ (1,0) [0|3] ""  IFV
 SG_ CAN_FR_DET_EXISTENCE_PROB_097 : 107|4@0+ (1,0) [0|15] ""  IFV
 SG_ CAN_FR_DET_CLASS_097 : 111|4@0+ (1,0) [0|15] ""  IFV
 SG_ CAN_FR_DET_RANGE_098 : 127|14@0+ (0.015625,0) [0|255.984375] "m"  IFV
 SG_ CAN_FR_DET_SD_RANGE_098 : 129|6@0+ (0.025,0) [0|1.5] "m"  IFV
 SG_ CAN_FR_DET_RANGE_RATE_098 : 139|14@0+ (0.015625,-128) [-128|127.984375] "m/s"  IFV
 SG_ CAN_FR_DET_SD_RANGE_RATE_098 : 157|6@0+ (0.02,0) [0|1.2] "m/s"  IFV
 SG_ CAN_FR_DET_AZIMUTH_098 : 167|13@0+ (0.0007668,-3.141593) [-3.141593|3.141593] "rad"  IFV
 SG_ CAN_FR_DET_SD_AZIMUTH_098 : 170|6@0+ (0.001745329,0) [0|0.104719755] "rad"  IFV
 SG_ CAN_FR_DET_ELEVATION_098 : 180|7@0+ (0.157449,-9.99812) [-9.99812|9.997903] "deg"  IFV
 SG_ CAN_FR_DET_SD_ELEVATION_098 : 189|6@0+ (0.003490659,0) [0|0.20943951] "rad"  IFV
 SG_ CAN_FR_DET_AMPLITUDE_098 : 199|7@0+ (1,-64) [-64|63] "dBsm"  IFV
 SG_ CAN_FR_DET_VALID_FLAG_098 : 192|1@0+ (1,0) [0|1] ""  IFV
 SG_ CAN_FR_DET_SUPER_RES_098 : 200|1@0+ (1,0) [0|1] ""  IFV
 SG_ CAN_FR_DET_LOW_SNR_FLAG_098 : 201|1@0+ (1,0) [0|1] ""  IFV
 SG_ CAN_FR_DET_MIXER_BIAS_FLAG_098 : 202|1@0+ (1,0) [0|1] ""  IFV
 SG_ CAN_FR_DET_RESERVED_FLAGS_098 : 207|5@0+ (1,0) [0|31] ""  IFV
 SG_ CAN_FR_DET_SNR_098 : 215|8@0+ (0.35156,0) [0|89.6478] "dB"  IFV
 SG_ CAN_FR_DET_MULTI_TARGET_PROB_098 : 219|4@0+ (0.06667,0) [0|1] ""  IFV
 SG_ CAN_FR_DET_CONFID_AZIMUTH_098 : 221|2@0+ (1,0) [0|3] ""  IFV
 SG_ CAN_FR_DET_CONFID_ELEVATION_098 : 223|2@0+ (1,0) [0|3] ""  IFV
 SG_ CAN_FR_DET_EXISTENCE_PROB_098 : 227|4@0+ (1,0) [0|15] ""  IFV
 SG_ CAN_FR_DET_CLASS_098 : 231|4@0+ (1,0) [0|15] ""  IFV
 SG_ CAN_FR_DET_RANGE_099 : 247|14@0+ (0.015625,0) [0|255.984375] "m"  IFV
 SG_ CAN_FR_DET_SD_RANGE_099 : 249|6@0+ (0.025,0) [0|1.5] "m"  IFV
 SG_ CAN_FR_DET_RANGE_RATE_099 : 259|14@0+ (0.015625,-128) [-128|127.984375] "m/s"  IFV
 SG_ CAN_FR_DET_SD_RANGE_RATE_099 : 277|6@0+ (0.02,0) [0|1.2] "m/s"  IFV
 SG_ CAN_FR_DET_AZIMUTH_099 : 287|13@0+ (0.0007668,-3.141593) [-3.141593|3.141593] "rad"  IFV
 SG_ CAN_FR_DET_SD_AZIMUTH_099 : 290|6@0+ (0.001745329,0) [0|0.104719755] "rad"  IFV
 SG_ CAN_FR_DET_ELEVATION_099 : 300|7@0+ (0.157449,-9.99812) [-9.99812|9.997903] "deg"  IFV
 SG_ CAN_FR_DET_SD_ELEVATION_099 : 309|6@0+ (0.003490659,0) [0|0.20943951] "rad"  IFV
 SG_ CAN_FR_DET_AMPLITUDE_099 : 319|7@0+ (1,-64) [-64|63] "dBsm"  IFV
 SG_ CAN_FR_DET_VALID_FLAG_099 : 312|1@0+ (1,0) [0|1] ""  IFV
 SG_ CAN_FR_DET_SUPER_RES_099 : 320|1@0+ (1,0) [0|1] ""  IFV
 SG_ CAN_FR_DET_LOW_SNR_FLAG_099 : 321|1@0+ (1,0) [0|1] ""  IFV
 SG_ CAN_FR_DET_MIXER_BIAS_FLAG_099 : 322|1@0+ (1,0) [0|1] ""  IFV
 SG_ CAN_FR_DET_RESERVED_FLAGS_099 : 327|5@0+ (1,0) [0|31] ""  IFV
 SG_ CAN_FR_DET_SNR_099 : 335|8@0+ (0.35156,0) [0|89.6478] "dB"  IFV
 SG_ CAN_FR_DET_MULTI_TARGET_PROB_099 : 339|4@0+ (0.06667,0) [0|1] ""  IFV
 SG_ CAN_FR_DET_CONFID_AZIMUTH_099 : 341|2@0+ (1,0) [0|3] ""  IFV
 SG_ CAN_FR_DET_CONFID_ELEVATION_099 : 343|2@0+ (1,0) [0|3] ""  IFV
 SG_ CAN_FR_DET_EXISTENCE_PROB_099 : 347|4@0+ (1,0) [0|15] ""  IFV
 SG_ CAN_FR_DET_CLASS_099 : 351|4@0+ (1,0) [0|15] ""  IFV
 SG_ CAN_FR_DET_RANGE_100 : 367|14@0+ (0.015625,0) [0|255.984375] "m"  IFV
 SG_ CAN_FR_DET_SD_RANGE_100 : 369|6@0+ (0.025,0) [0|1.5] "m"  IFV
 SG_ CAN_FR_DET_RANGE_RATE_100 : 379|14@0+ (0.015625,-128) [-128|127.984375] "m/s"  IFV
 SG_ CAN_FR_DET_SD_RANGE_RATE_100 : 397|6@0+ (0.02,0) [0|1.2] "m/s"  IFV
 SG_ CAN_FR_DET_AZIMUTH_100 : 407|13@0+ (0.0007668,-3.141593) [-3.141593|3.141593] "rad"  IFV
 SG_ CAN_FR_DET_SD_AZIMUTH_100 : 410|6@0+ (0.001745329,0) [0|0.104719755] "rad"  IFV
 SG_ CAN_FR_DET_ELEVATION_100 : 420|7@0+ (0.157449,-9.99812) [-9.99812|9.997903] "deg"  IFV
 SG_ CAN_FR_DET_SD_ELEVATION_100 : 429|6@0+ (0.003490659,0) [0|0.20943951] "rad"  IFV
 SG_ CAN_FR_DET_AMPLITUDE_100 : 439|7@0+ (1,-64) [-64|63] "dBsm"  IFV
 SG_ CAN_FR_DET_VALID_FLAG_100 : 432|1@0+ (1,0) [0|1] ""  IFV
 SG_ CAN_FR_DET_SUPER_RES_100 : 440|1@0+ (1,0) [0|1] ""  IFV
 SG_ CAN_FR_DET_LOW_SNR_FLAG_100 : 441|1@0+ (1,0) [0|1] ""  IFV
 SG_ CAN_FR_DET_MIXER_BIAS_FLAG_100 : 442|1@0+ (1,0) [0|1] ""  IFV
 SG_ CAN_FR_DET_RESERVED_FLAGS_100 : 447|5@0+ (1,0) [0|31] ""  IFV
 SG_ CAN_FR_DET_SNR_100 : 455|8@0+ (0.35156,0) [0|89.6478] "dB"  IFV
 SG_ CAN_FR_DET_MULTI_TARGET_PROB_100 : 459|4@0+ (0.06667,0) [0|1] ""  IFV
 SG_ CAN_FR_DET_CONFID_AZIMUTH_100 : 461|2@0+ (1,0) [0|3] ""  IFV
 SG_ CAN_FR_DET_CONFID_ELEVATION_100 : 463|2@0+ (1,0) [0|3] ""  IFV
 SG_ CAN_FR_DET_EXISTENCE_PROB_100 : 467|4@0+ (1,0) [0|15] ""  IFV
 SG_ CAN_FR_DET_CLASS_100 : 471|4@0+ (1,0) [0|15] ""  IFV

BO_ 1049 SODFR_DETECTION_101_104: 64 SODFR
 SG_ CAN_FR_DET_RANGE_101 : 7|14@0+ (0.015625,0) [0|255.984375] "m"  IFV
 SG_ CAN_FR_DET_SD_RANGE_101 : 9|6@0+ (0.025,0) [0|1.5] "m"  IFV
 SG_ CAN_FR_DET_RANGE_RATE_101 : 19|14@0+ (0.015625,-128) [-128|127.984375] "m/s"  IFV
 SG_ CAN_FR_DET_SD_RANGE_RATE_101 : 37|6@0+ (0.02,0) [0|1.2] "m/s"  IFV
 SG_ CAN_FR_DET_AZIMUTH_101 : 47|13@0+ (0.0007668,-3.141593) [-3.141593|3.141593] "rad"  IFV
 SG_ CAN_FR_DET_SD_AZIMUTH_101 : 50|6@0+ (0.001745329,0) [0|0.104719755] "rad"  IFV
 SG_ CAN_FR_DET_ELEVATION_101 : 60|7@0+ (0.157449,-9.99812) [-9.99812|9.997903] "deg"  IFV
 SG_ CAN_FR_DET_SD_ELEVATION_101 : 69|6@0+ (0.003490659,0) [0|0.20943951] "rad"  IFV
 SG_ CAN_FR_DET_AMPLITUDE_101 : 79|7@0+ (1,-64) [-64|63] "dBsm"  IFV
 SG_ CAN_FR_DET_VALID_FLAG_101 : 72|1@0+ (1,0) [0|1] ""  IFV
 SG_ CAN_FR_DET_SUPER_RES_101 : 80|1@0+ (1,0) [0|1] ""  IFV
 SG_ CAN_FR_DET_LOW_SNR_FLAG_101 : 81|1@0+ (1,0) [0|1] ""  IFV
 SG_ CAN_FR_DET_MIXER_BIAS_FLAG_101 : 82|1@0+ (1,0) [0|1] ""  IFV
 SG_ CAN_FR_DET_RESERVED_FLAGS_101 : 87|5@0+ (1,0) [0|31] ""  IFV
 SG_ CAN_FR_DET_SNR_101 : 95|8@0+ (0.35156,0) [0|89.6478] "dB"  IFV
 SG_ CAN_FR_DET_MULTI_TARGET_PROB_101 : 99|4@0+ (0.06667,0) [0|1] ""  IFV
 SG_ CAN_FR_DET_CONFID_AZIMUTH_101 : 101|2@0+ (1,0) [0|3] ""  IFV
 SG_ CAN_FR_DET_CONFID_ELEVATION_101 : 103|2@0+ (1,0) [0|3] ""  IFV
 SG_ CAN_FR_DET_EXISTENCE_PROB_101 : 107|4@0+ (1,0) [0|15] ""  IFV
 SG_ CAN_FR_DET_CLASS_101 : 111|4@0+ (1,0) [0|15] ""  IFV
 SG_ CAN_FR_DET_RANGE_102 : 127|14@0+ (0.015625,0) [0|255.984375] "m"  IFV
 SG_ CAN_FR_DET_SD_RANGE_102 : 129|6@0+ (0.025,0) [0|1.5] "m"  IFV
 SG_ CAN_FR_DET_RANGE_RATE_102 : 139|14@0+ (0.015625,-128) [-128|127.984375] "m/s"  IFV
 SG_ CAN_FR_DET_SD_RANGE_RATE_102 : 157|6@0+ (0.02,0) [0|1.2] "m/s"  IFV
 SG_ CAN_FR_DET_AZIMUTH_102 : 167|13@0+ (0.0007668,-3.141593) [-3.141593|3.141593] "rad"  IFV
 SG_ CAN_FR_DET_SD_AZIMUTH_102 : 170|6@0+ (0.001745329,0) [0|0.104719755] "rad"  IFV
 SG_ CAN_FR_DET_ELEVATION_102 : 180|7@0+ (0.157449,-9.99812) [-9.99812|9.997903] "deg"  IFV
 SG_ CAN_FR_DET_SD_ELEVATION_102 : 189|6@0+ (0.003490659,0) [0|0.20943951] "rad"  IFV
 SG_ CAN_FR_DET_AMPLITUDE_102 : 199|7@0+ (1,-64) [-64|63] "dBsm"  IFV
 SG_ CAN_FR_DET_VALID_FLAG_102 : 192|1@0+ (1,0) [0|1] ""  IFV
 SG_ CAN_FR_DET_SUPER_RES_102 : 200|1@0+ (1,0) [0|1] ""  IFV
 SG_ CAN_FR_DET_LOW_SNR_FLAG_102 : 201|1@0+ (1,0) [0|1] ""  IFV
 SG_ CAN_FR_DET_MIXER_BIAS_FLAG_102 : 202|1@0+ (1,0) [0|1] ""  IFV
 SG_ CAN_FR_DET_RESERVED_FLAGS_102 : 207|5@0+ (1,0) [0|31] ""  IFV
 SG_ CAN_FR_DET_SNR_102 : 215|8@0+ (0.35156,0) [0|89.6478] "dB"  IFV
 SG_ CAN_FR_DET_MULTI_TARGET_PROB_102 : 219|4@0+ (0.06667,0) [0|1] ""  IFV
 SG_ CAN_FR_DET_CONFID_AZIMUTH_102 : 221|2@0+ (1,0) [0|3] ""  IFV
 SG_ CAN_FR_DET_CONFID_ELEVATION_102 : 223|2@0+ (1,0) [0|3] ""  IFV
 SG_ CAN_FR_DET_EXISTENCE_PROB_102 : 227|4@0+ (1,0) [0|15] ""  IFV
 SG_ CAN_FR_DET_CLASS_102 : 231|4@0+ (1,0) [0|15] ""  IFV
 SG_ CAN_FR_DET_RANGE_103 : 247|14@0+ (0.015625,0) [0|255.984375] "m"  IFV
 SG_ CAN_FR_DET_SD_RANGE_103 : 249|6@0+ (0.025,0) [0|1.5] "m"  IFV
 SG_ CAN_FR_DET_RANGE_RATE_103 : 259|14@0+ (0.015625,-128) [-128|127.984375] "m/s"  IFV
 SG_ CAN_FR_DET_SD_RANGE_RATE_103 : 277|6@0+ (0.02,0) [0|1.2] "m/s"  IFV
 SG_ CAN_FR_DET_AZIMUTH_103 : 287|13@0+ (0.0007668,-3.141593) [-3.141593|3.141593] "rad"  IFV
 SG_ CAN_FR_DET_SD_AZIMUTH_103 : 290|6@0+ (0.001745329,0) [0|0.104719755] "rad"  IFV
 SG_ CAN_FR_DET_ELEVATION_103 : 300|7@0+ (0.157449,-9.99812) [-9.99812|9.997903] "deg"  IFV
 SG_ CAN_FR_DET_SD_ELEVATION_103 : 309|6@0+ (0.003490659,0) [0|0.20943951] "rad"  IFV
 SG_ CAN_FR_DET_AMPLITUDE_103 : 319|7@0+ (1,-64) [-64|63] "dBsm"  IFV
 SG_ CAN_FR_DET_VALID_FLAG_103 : 312|1@0+ (1,0) [0|1] ""  IFV
 SG_ CAN_FR_DET_SUPER_RES_103 : 320|1@0+ (1,0) [0|1] ""  IFV
 SG_ CAN_FR_DET_LOW_SNR_FLAG_103 : 321|1@0+ (1,0) [0|1] ""  IFV
 SG_ CAN_FR_DET_MIXER_BIAS_FLAG_103 : 322|1@0+ (1,0) [0|1] ""  IFV
 SG_ CAN_FR_DET_RESERVED_FLAGS_103 : 327|5@0+ (1,0) [0|31] ""  IFV
 SG_ CAN_FR_DET_SNR_103 : 335|8@0+ (0.35156,0) [0|89.6478] "dB"  IFV
 SG_ CAN_FR_DET_MULTI_TARGET_PROB_103 : 339|4@0+ (0.06667,0) [0|1] ""  IFV
 SG_ CAN_FR_DET_CONFID_AZIMUTH_103 : 341|2@0+ (1,0) [0|3] ""  IFV
 SG_ CAN_FR_DET_CONFID_ELEVATION_103 : 343|2@0+ (1,0) [0|3] ""  IFV
 SG_ CAN_FR_DET_EXISTENCE_PROB_103 : 347|4@0+ (1,0) [0|15] ""  IFV
 SG_ CAN_FR_DET_CLASS_103 : 351|4@0+ (1,0) [0|15] ""  IFV
 SG_ CAN_FR_DET_RANGE_104 : 367|14@0+ (0.015625,0) [0|255.984375] "m"  IFV
 SG_ CAN_FR_DET_SD_RANGE_104 : 369|6@0+ (0.025,0) [0|1.5] "m"  IFV
 SG_ CAN_FR_DET_RANGE_RATE_104 : 379|14@0+ (0.015625,-128) [-128|127.984375] "m/s"  IFV
 SG_ CAN_FR_DET_SD_RANGE_RATE_104 : 397|6@0+ (0.02,0) [0|1.2] "m/s"  IFV
 SG_ CAN_FR_DET_AZIMUTH_104 : 407|13@0+ (0.0007668,-3.141593) [-3.141593|3.141593] "rad"  IFV
 SG_ CAN_FR_DET_SD_AZIMUTH_104 : 410|6@0+ (0.001745329,0) [0|0.104719755] "rad"  IFV
 SG_ CAN_FR_DET_ELEVATION_104 : 420|7@0+ (0.157449,-9.99812) [-9.99812|9.997903] "deg"  IFV
 SG_ CAN_FR_DET_SD_ELEVATION_104 : 429|6@0+ (0.003490659,0) [0|0.20943951] "rad"  IFV
 SG_ CAN_FR_DET_AMPLITUDE_104 : 439|7@0+ (1,-64) [-64|63] "dBsm"  IFV
 SG_ CAN_FR_DET_VALID_FLAG_104 : 432|1@0+ (1,0) [0|1] ""  IFV
 SG_ CAN_FR_DET_SUPER_RES_104 : 440|1@0+ (1,0) [0|1] ""  IFV
 SG_ CAN_FR_DET_LOW_SNR_FLAG_104 : 441|1@0+ (1,0) [0|1] ""  IFV
 SG_ CAN_FR_DET_MIXER_BIAS_FLAG_104 : 442|1@0+ (1,0) [0|1] ""  IFV
 SG_ CAN_FR_DET_RESERVED_FLAGS_104 : 447|5@0+ (1,0) [0|31] ""  IFV
 SG_ CAN_FR_DET_SNR_104 : 455|8@0+ (0.35156,0) [0|89.6478] "dB"  IFV
 SG_ CAN_FR_DET_MULTI_TARGET_PROB_104 : 459|4@0+ (0.06667,0) [0|1] ""  IFV
 SG_ CAN_FR_DET_CONFID_AZIMUTH_104 : 461|2@0+ (1,0) [0|3] ""  IFV
 SG_ CAN_FR_DET_CONFID_ELEVATION_104 : 463|2@0+ (1,0) [0|3] ""  IFV
 SG_ CAN_FR_DET_EXISTENCE_PROB_104 : 467|4@0+ (1,0) [0|15] ""  IFV
 SG_ CAN_FR_DET_CLASS_104 : 471|4@0+ (1,0) [0|15] ""  IFV

BO_ 1050 SODFR_DETECTION_105_108: 64 SODFR
 SG_ CAN_FR_DET_RANGE_105 : 7|14@0+ (0.015625,0) [0|255.984375] "m"  IFV
 SG_ CAN_FR_DET_SD_RANGE_105 : 9|6@0+ (0.025,0) [0|1.5] "m"  IFV
 SG_ CAN_FR_DET_RANGE_RATE_105 : 19|14@0+ (0.015625,-128) [-128|127.984375] "m/s"  IFV
 SG_ CAN_FR_DET_SD_RANGE_RATE_105 : 37|6@0+ (0.02,0) [0|1.2] "m/s"  IFV
 SG_ CAN_FR_DET_AZIMUTH_105 : 47|13@0+ (0.0007668,-3.141593) [-3.141593|3.141593] "rad"  IFV
 SG_ CAN_FR_DET_SD_AZIMUTH_105 : 50|6@0+ (0.001745329,0) [0|0.104719755] "rad"  IFV
 SG_ CAN_FR_DET_ELEVATION_105 : 60|7@0+ (0.157449,-9.99812) [-9.99812|9.997903] "deg"  IFV
 SG_ CAN_FR_DET_SD_ELEVATION_105 : 69|6@0+ (0.003490659,0) [0|0.20943951] "rad"  IFV
 SG_ CAN_FR_DET_AMPLITUDE_105 : 79|7@0+ (1,-64) [-64|63] "dBsm"  IFV
 SG_ CAN_FR_DET_VALID_FLAG_105 : 72|1@0+ (1,0) [0|1] ""  IFV
 SG_ CAN_FR_DET_SUPER_RES_105 : 80|1@0+ (1,0) [0|1] ""  IFV
 SG_ CAN_FR_DET_LOW_SNR_FLAG_105 : 81|1@0+ (1,0) [0|1] ""  IFV
 SG_ CAN_FR_DET_MIXER_BIAS_FLAG_105 : 82|1@0+ (1,0) [0|1] ""  IFV
 SG_ CAN_FR_DET_RESERVED_FLAGS_105 : 87|5@0+ (1,0) [0|31] ""  IFV
 SG_ CAN_FR_DET_SNR_105 : 95|8@0+ (0.35156,0) [0|89.6478] "dB"  IFV
 SG_ CAN_FR_DET_MULTI_TARGET_PROB_105 : 99|4@0+ (0.06667,0) [0|1] ""  IFV
 SG_ CAN_FR_DET_CONFID_AZIMUTH_105 : 101|2@0+ (1,0) [0|3] ""  IFV
 SG_ CAN_FR_DET_CONFID_ELEVATION_105 : 103|2@0+ (1,0) [0|3] ""  IFV
 SG_ CAN_FR_DET_EXISTENCE_PROB_105 : 107|4@0+ (1,0) [0|15] ""  IFV
 SG_ CAN_FR_DET_CLASS_105 : 111|4@0+ (1,0) [0|15] ""  IFV
 SG_ CAN_FR_DET_RANGE_106 : 127|14@0+ (0.015625,0) [0|255.984375] "m"  IFV
 SG_ CAN_FR_DET_SD_RANGE_106 : 129|6@0+ (0.025,0) [0|1.5] "m"  IFV
 SG_ CAN_FR_DET_RANGE_RATE_106 : 139|14@0+ (0.015625,-128) [-128|127.984375] "m/s"  IFV
 SG_ CAN_FR_DET_SD_RANGE_RATE_106 : 157|6@0+ (0.02,0) [0|1.2] "m/s"  IFV
 SG_ CAN_FR_DET_AZIMUTH_106 : 167|13@0+ (0.0007668,-3.141593) [-3.141593|3.141593] "rad"  IFV
 SG_ CAN_FR_DET_SD_AZIMUTH_106 : 170|6@0+ (0.001745329,0) [0|0.104719755] "rad"  IFV
 SG_ CAN_FR_DET_ELEVATION_106 : 180|7@0+ (0.157449,-9.99812) [-9.99812|9.997903] "deg"  IFV
 SG_ CAN_FR_DET_SD_ELEVATION_106 : 189|6@0+ (0.003490659,0) [0|0.20943951] "rad"  IFV
 SG_ CAN_FR_DET_AMPLITUDE_106 : 199|7@0+ (1,-64) [-64|63] "dBsm"  IFV
 SG_ CAN_FR_DET_VALID_FLAG_106 : 192|1@0+ (1,0) [0|1] ""  IFV
 SG_ CAN_FR_DET_SUPER_RES_106 : 200|1@0+ (1,0) [0|1] ""  IFV
 SG_ CAN_FR_DET_LOW_SNR_FLAG_106 : 201|1@0+ (1,0) [0|1] ""  IFV
 SG_ CAN_FR_DET_MIXER_BIAS_FLAG_106 : 202|1@0+ (1,0) [0|1] ""  IFV
 SG_ CAN_FR_DET_RESERVED_FLAGS_106 : 207|5@0+ (1,0) [0|31] ""  IFV
 SG_ CAN_FR_DET_SNR_106 : 215|8@0+ (0.35156,0) [0|89.6478] "dB"  IFV
 SG_ CAN_FR_DET_MULTI_TARGET_PROB_106 : 219|4@0+ (0.06667,0) [0|1] ""  IFV
 SG_ CAN_FR_DET_CONFID_AZIMUTH_106 : 221|2@0+ (1,0) [0|3] ""  IFV
 SG_ CAN_FR_DET_CONFID_ELEVATION_106 : 223|2@0+ (1,0) [0|3] ""  IFV
 SG_ CAN_FR_DET_EXISTENCE_PROB_106 : 227|4@0+ (1,0) [0|15] ""  IFV
 SG_ CAN_FR_DET_CLASS_106 : 231|4@0+ (1,0) [0|15] ""  IFV
 SG_ CAN_FR_DET_RANGE_107 : 247|14@0+ (0.015625,0) [0|255.984375] "m"  IFV
 SG_ CAN_FR_DET_SD_RANGE_107 : 249|6@0+ (0.025,0) [0|1.5] "m"  IFV
 SG_ CAN_FR_DET_RANGE_RATE_107 : 259|14@0+ (0.015625,-128) [-128|127.984375] "m/s"  IFV
 SG_ CAN_FR_DET_SD_RANGE_RATE_107 : 277|6@0+ (0.02,0) [0|1.2] "m/s"  IFV
 SG_ CAN_FR_DET_AZIMUTH_107 : 287|13@0+ (0.0007668,-3.141593) [-3.141593|3.141593] "rad"  IFV
 SG_ CAN_FR_DET_SD_AZIMUTH_107 : 290|6@0+ (0.001745329,0) [0|0.104719755] "rad"  IFV
 SG_ CAN_FR_DET_ELEVATION_107 : 300|7@0+ (0.157449,-9.99812) [-9.99812|9.997903] "deg"  IFV
 SG_ CAN_FR_DET_SD_ELEVATION_107 : 309|6@0+ (0.003490659,0) [0|0.20943951] "rad"  IFV
 SG_ CAN_FR_DET_AMPLITUDE_107 : 319|7@0+ (1,-64) [-64|63] "dBsm"  IFV
 SG_ CAN_FR_DET_VALID_FLAG_107 : 312|1@0+ (1,0) [0|1] ""  IFV
 SG_ CAN_FR_DET_SUPER_RES_107 : 320|1@0+ (1,0) [0|1] ""  IFV
 SG_ CAN_FR_DET_LOW_SNR_FLAG_107 : 321|1@0+ (1,0) [0|1] ""  IFV
 SG_ CAN_FR_DET_MIXER_BIAS_FLAG_107 : 322|1@0+ (1,0) [0|1] ""  IFV
 SG_ CAN_FR_DET_RESERVED_FLAGS_107 : 327|5@0+ (1,0) [0|31] ""  IFV
 SG_ CAN_FR_DET_SNR_107 : 335|8@0+ (0.35156,0) [0|89.6478] "dB"  IFV
 SG_ CAN_FR_DET_MULTI_TARGET_PROB_107 : 339|4@0+ (0.06667,0) [0|1] ""  IFV
 SG_ CAN_FR_DET_CONFID_AZIMUTH_107 : 341|2@0+ (1,0) [0|3] ""  IFV
 SG_ CAN_FR_DET_CONFID_ELEVATION_107 : 343|2@0+ (1,0) [0|3] ""  IFV
 SG_ CAN_FR_DET_EXISTENCE_PROB_107 : 347|4@0+ (1,0) [0|15] ""  IFV
 SG_ CAN_FR_DET_CLASS_107 : 351|4@0+ (1,0) [0|15] ""  IFV
 SG_ CAN_FR_DET_RANGE_108 : 367|14@0+ (0.015625,0) [0|255.984375] "m"  IFV
 SG_ CAN_FR_DET_SD_RANGE_108 : 369|6@0+ (0.025,0) [0|1.5] "m"  IFV
 SG_ CAN_FR_DET_RANGE_RATE_108 : 379|14@0+ (0.015625,-128) [-128|127.984375] "m/s"  IFV
 SG_ CAN_FR_DET_SD_RANGE_RATE_108 : 397|6@0+ (0.02,0) [0|1.2] "m/s"  IFV
 SG_ CAN_FR_DET_AZIMUTH_108 : 407|13@0+ (0.0007668,-3.141593) [-3.141593|3.141593] "rad"  IFV
 SG_ CAN_FR_DET_SD_AZIMUTH_108 : 410|6@0+ (0.001745329,0) [0|0.104719755] "rad"  IFV
 SG_ CAN_FR_DET_ELEVATION_108 : 420|7@0+ (0.157449,-9.99812) [-9.99812|9.997903] "deg"  IFV
 SG_ CAN_FR_DET_SD_ELEVATION_108 : 429|6@0+ (0.003490659,0) [0|0.20943951] "rad"  IFV
 SG_ CAN_FR_DET_AMPLITUDE_108 : 439|7@0+ (1,-64) [-64|63] "dBsm"  IFV
 SG_ CAN_FR_DET_VALID_FLAG_108 : 432|1@0+ (1,0) [0|1] ""  IFV
 SG_ CAN_FR_DET_SUPER_RES_108 : 440|1@0+ (1,0) [0|1] ""  IFV
 SG_ CAN_FR_DET_LOW_SNR_FLAG_108 : 441|1@0+ (1,0) [0|1] ""  IFV
 SG_ CAN_FR_DET_MIXER_BIAS_FLAG_108 : 442|1@0+ (1,0) [0|1] ""  IFV
 SG_ CAN_FR_DET_RESERVED_FLAGS_108 : 447|5@0+ (1,0) [0|31] ""  IFV
 SG_ CAN_FR_DET_SNR_108 : 455|8@0+ (0.35156,0) [0|89.6478] "dB"  IFV
 SG_ CAN_FR_DET_MULTI_TARGET_PROB_108 : 459|4@0+ (0.06667,0) [0|1] ""  IFV
 SG_ CAN_FR_DET_CONFID_AZIMUTH_108 : 461|2@0+ (1,0) [0|3] ""  IFV
 SG_ CAN_FR_DET_CONFID_ELEVATION_108 : 463|2@0+ (1,0) [0|3] ""  IFV
 SG_ CAN_FR_DET_EXISTENCE_PROB_108 : 467|4@0+ (1,0) [0|15] ""  IFV
 SG_ CAN_FR_DET_CLASS_108 : 471|4@0+ (1,0) [0|15] ""  IFV

BO_ 1051 SODFR_DETECTION_109_112: 64 SODFR
 SG_ CAN_FR_DET_RANGE_109 : 7|14@0+ (0.015625,0) [0|255.984375] "m"  IFV
 SG_ CAN_FR_DET_SD_RANGE_109 : 9|6@0+ (0.025,0) [0|1.5] "m"  IFV
 SG_ CAN_FR_DET_RANGE_RATE_109 : 19|14@0+ (0.015625,-128) [-128|127.984375] "m/s"  IFV
 SG_ CAN_FR_DET_SD_RANGE_RATE_109 : 37|6@0+ (0.02,0) [0|1.2] "m/s"  IFV
 SG_ CAN_FR_DET_AZIMUTH_109 : 47|13@0+ (0.0007668,-3.141593) [-3.141593|3.141593] "rad"  IFV
 SG_ CAN_FR_DET_SD_AZIMUTH_109 : 50|6@0+ (0.001745329,0) [0|0.104719755] "rad"  IFV
 SG_ CAN_FR_DET_ELEVATION_109 : 60|7@0+ (0.157449,-9.99812) [-9.99812|9.997903] "deg"  IFV
 SG_ CAN_FR_DET_SD_ELEVATION_109 : 69|6@0+ (0.003490659,0) [0|0.20943951] "rad"  IFV
 SG_ CAN_FR_DET_AMPLITUDE_109 : 79|7@0+ (1,-64) [-64|63] "dBsm"  IFV
 SG_ CAN_FR_DET_VALID_FLAG_109 : 72|1@0+ (1,0) [0|1] ""  IFV
 SG_ CAN_FR_DET_SUPER_RES_109 : 80|1@0+ (1,0) [0|1] ""  IFV
 SG_ CAN_FR_DET_LOW_SNR_FLAG_109 : 81|1@0+ (1,0) [0|1] ""  IFV
 SG_ CAN_FR_DET_MIXER_BIAS_FLAG_109 : 82|1@0+ (1,0) [0|1] ""  IFV
 SG_ CAN_FR_DET_RESERVED_FLAGS_109 : 87|5@0+ (1,0) [0|31] ""  IFV
 SG_ CAN_FR_DET_SNR_109 : 95|8@0+ (0.35156,0) [0|89.6478] "dB"  IFV
 SG_ CAN_FR_DET_MULTI_TARGET_PROB_109 : 99|4@0+ (0.06667,0) [0|1] ""  IFV
 SG_ CAN_FR_DET_CONFID_AZIMUTH_109 : 101|2@0+ (1,0) [0|3] ""  IFV
 SG_ CAN_FR_DET_CONFID_ELEVATION_109 : 103|2@0+ (1,0) [0|3] ""  IFV
 SG_ CAN_FR_DET_EXISTENCE_PROB_109 : 107|4@0+ (1,0) [0|15] ""  IFV
 SG_ CAN_FR_DET_CLASS_109 : 111|4@0+ (1,0) [0|15] ""  IFV
 SG_ CAN_FR_DET_RANGE_110 : 127|14@0+ (0.015625,0) [0|255.984375] "m"  IFV
 SG_ CAN_FR_DET_SD_RANGE_110 : 129|6@0+ (0.025,0) [0|1.5] "m"  IFV
 SG_ CAN_FR_DET_RANGE_RATE_110 : 139|14@0+ (0.015625,-128) [-128|127.984375] "m/s"  IFV
 SG_ CAN_FR_DET_SD_RANGE_RATE_110 : 157|6@0+ (0.02,0) [0|1.2] "m/s"  IFV
 SG_ CAN_FR_DET_AZIMUTH_110 : 167|13@0+ (0.0007668,-3.141593) [-3.141593|3.141593] "rad"  IFV
 SG_ CAN_FR_DET_SD_AZIMUTH_110 : 170|6@0+ (0.001745329,0) [0|0.104719755] "rad"  IFV
 SG_ CAN_FR_DET_ELEVATION_110 : 180|7@0+ (0.157449,-9.99812) [-9.99812|9.997903] "deg"  IFV
 SG_ CAN_FR_DET_SD_ELEVATION_110 : 189|6@0+ (0.003490659,0) [0|0.20943951] "rad"  IFV
 SG_ CAN_FR_DET_AMPLITUDE_110 : 199|7@0+ (1,-64) [-64|63] "dBsm"  IFV
 SG_ CAN_FR_DET_VALID_FLAG_110 : 192|1@0+ (1,0) [0|1] ""  IFV
 SG_ CAN_FR_DET_SUPER_RES_110 : 200|1@0+ (1,0) [0|1] ""  IFV
 SG_ CAN_FR_DET_LOW_SNR_FLAG_110 : 201|1@0+ (1,0) [0|1] ""  IFV
 SG_ CAN_FR_DET_MIXER_BIAS_FLAG_110 : 202|1@0+ (1,0) [0|1] ""  IFV
 SG_ CAN_FR_DET_RESERVED_FLAGS_110 : 207|5@0+ (1,0) [0|31] ""  IFV
 SG_ CAN_FR_DET_SNR_110 : 215|8@0+ (0.35156,0) [0|89.6478] "dB"  IFV
 SG_ CAN_FR_DET_MULTI_TARGET_PROB_110 : 219|4@0+ (0.06667,0) [0|1] ""  IFV
 SG_ CAN_FR_DET_CONFID_AZIMUTH_110 : 221|2@0+ (1,0) [0|3] ""  IFV
 SG_ CAN_FR_DET_CONFID_ELEVATION_110 : 223|2@0+ (1,0) [0|3] ""  IFV
 SG_ CAN_FR_DET_EXISTENCE_PROB_110 : 227|4@0+ (1,0) [0|15] ""  IFV
 SG_ CAN_FR_DET_CLASS_110 : 231|4@0+ (1,0) [0|15] ""  IFV
 SG_ CAN_FR_DET_RANGE_111 : 247|14@0+ (0.015625,0) [0|255.984375] "m"  IFV
 SG_ CAN_FR_DET_SD_RANGE_111 : 249|6@0+ (0.025,0) [0|1.5] "m"  IFV
 SG_ CAN_FR_DET_RANGE_RATE_111 : 259|14@0+ (0.015625,-128) [-128|127.984375] "m/s"  IFV
 SG_ CAN_FR_DET_SD_RANGE_RATE_111 : 277|6@0+ (0.02,0) [0|1.2] "m/s"  IFV
 SG_ CAN_FR_DET_AZIMUTH_111 : 287|13@0+ (0.0007668,-3.141593) [-3.141593|3.141593] "rad"  IFV
 SG_ CAN_FR_DET_SD_AZIMUTH_111 : 290|6@0+ (0.001745329,0) [0|0.104719755] "rad"  IFV
 SG_ CAN_FR_DET_ELEVATION_111 : 300|7@0+ (0.157449,-9.99812) [-9.99812|9.997903] "deg"  IFV
 SG_ CAN_FR_DET_SD_ELEVATION_111 : 309|6@0+ (0.003490659,0) [0|0.20943951] "rad"  IFV
 SG_ CAN_FR_DET_AMPLITUDE_111 : 319|7@0+ (1,-64) [-64|63] "dBsm"  IFV
 SG_ CAN_FR_DET_VALID_FLAG_111 : 312|1@0+ (1,0) [0|1] ""  IFV
 SG_ CAN_FR_DET_SUPER_RES_111 : 320|1@0+ (1,0) [0|1] ""  IFV
 SG_ CAN_FR_DET_LOW_SNR_FLAG_111 : 321|1@0+ (1,0) [0|1] ""  IFV
 SG_ CAN_FR_DET_MIXER_BIAS_FLAG_111 : 322|1@0+ (1,0) [0|1] ""  IFV
 SG_ CAN_FR_DET_RESERVED_FLAGS_111 : 327|5@0+ (1,0) [0|31] ""  IFV
 SG_ CAN_FR_DET_SNR_111 : 335|8@0+ (0.35156,0) [0|89.6478] "dB"  IFV
 SG_ CAN_FR_DET_MULTI_TARGET_PROB_111 : 339|4@0+ (0.06667,0) [0|1] ""  IFV
 SG_ CAN_FR_DET_CONFID_AZIMUTH_111 : 341|2@0+ (1,0) [0|3] ""  IFV
 SG_ CAN_FR_DET_CONFID_ELEVATION_111 : 343|2@0+ (1,0) [0|3] ""  IFV
 SG_ CAN_FR_DET_EXISTENCE_PROB_111 : 347|4@0+ (1,0) [0|15] ""  IFV
 SG_ CAN_FR_DET_CLASS_111 : 351|4@0+ (1,0) [0|15] ""  IFV
 SG_ CAN_FR_DET_RANGE_112 : 367|14@0+ (0.015625,0) [0|255.984375] "m"  IFV
 SG_ CAN_FR_DET_SD_RANGE_112 : 369|6@0+ (0.025,0) [0|1.5] "m"  IFV
 SG_ CAN_FR_DET_RANGE_RATE_112 : 379|14@0+ (0.015625,-128) [-128|127.984375] "m/s"  IFV
 SG_ CAN_FR_DET_SD_RANGE_RATE_112 : 397|6@0+ (0.02,0) [0|1.2] "m/s"  IFV
 SG_ CAN_FR_DET_AZIMUTH_112 : 407|13@0+ (0.0007668,-3.141593) [-3.141593|3.141593] "rad"  IFV
 SG_ CAN_FR_DET_SD_AZIMUTH_112 : 410|6@0+ (0.001745329,0) [0|0.104719755] "rad"  IFV
 SG_ CAN_FR_DET_ELEVATION_112 : 420|7@0+ (0.157449,-9.99812) [-9.99812|9.997903] "deg"  IFV
 SG_ CAN_FR_DET_SD_ELEVATION_112 : 429|6@0+ (0.003490659,0) [0|0.20943951] "rad"  IFV
 SG_ CAN_FR_DET_AMPLITUDE_112 : 439|7@0+ (1,-64) [-64|63] "dBsm"  IFV
 SG_ CAN_FR_DET_VALID_FLAG_112 : 432|1@0+ (1,0) [0|1] ""  IFV
 SG_ CAN_FR_DET_SUPER_RES_112 : 440|1@0+ (1,0) [0|1] ""  IFV
 SG_ CAN_FR_DET_LOW_SNR_FLAG_112 : 441|1@0+ (1,0) [0|1] ""  IFV
 SG_ CAN_FR_DET_MIXER_BIAS_FLAG_112 : 442|1@0+ (1,0) [0|1] ""  IFV
 SG_ CAN_FR_DET_RESERVED_FLAGS_112 : 447|5@0+ (1,0) [0|31] ""  IFV
 SG_ CAN_FR_DET_SNR_112 : 455|8@0+ (0.35156,0) [0|89.6478] "dB"  IFV
 SG_ CAN_FR_DET_MULTI_TARGET_PROB_112 : 459|4@0+ (0.06667,0) [0|1] ""  IFV
 SG_ CAN_FR_DET_CONFID_AZIMUTH_112 : 461|2@0+ (1,0) [0|3] ""  IFV
 SG_ CAN_FR_DET_CONFID_ELEVATION_112 : 463|2@0+ (1,0) [0|3] ""  IFV
 SG_ CAN_FR_DET_EXISTENCE_PROB_112 : 467|4@0+ (1,0) [0|15] ""  IFV
 SG_ CAN_FR_DET_CLASS_112 : 471|4@0+ (1,0) [0|15] ""  IFV

BO_ 1052 SODFR_DETECTION_113_116: 64 SODFR
 SG_ CAN_FR_DET_RANGE_113 : 7|14@0+ (0.015625,0) [0|255.984375] "m"  IFV
 SG_ CAN_FR_DET_SD_RANGE_113 : 9|6@0+ (0.025,0) [0|1.5] "m"  IFV
 SG_ CAN_FR_DET_RANGE_RATE_113 : 19|14@0+ (0.015625,-128) [-128|127.984375] "m/s"  IFV
 SG_ CAN_FR_DET_SD_RANGE_RATE_113 : 37|6@0+ (0.02,0) [0|1.2] "m/s"  IFV
 SG_ CAN_FR_DET_AZIMUTH_113 : 47|13@0+ (0.0007668,-3.141593) [-3.141593|3.141593] "rad"  IFV
 SG_ CAN_FR_DET_SD_AZIMUTH_113 : 50|6@0+ (0.001745329,0) [0|0.104719755] "rad"  IFV
 SG_ CAN_FR_DET_ELEVATION_113 : 60|7@0+ (0.157449,-9.99812) [-9.99812|9.997903] "deg"  IFV
 SG_ CAN_FR_DET_SD_ELEVATION_113 : 69|6@0+ (0.003490659,0) [0|0.20943951] "rad"  IFV
 SG_ CAN_FR_DET_AMPLITUDE_113 : 79|7@0+ (1,-64) [-64|63] "dBsm"  IFV
 SG_ CAN_FR_DET_VALID_FLAG_113 : 72|1@0+ (1,0) [0|1] ""  IFV
 SG_ CAN_FR_DET_SUPER_RES_113 : 80|1@0+ (1,0) [0|1] ""  IFV
 SG_ CAN_FR_DET_LOW_SNR_FLAG_113 : 81|1@0+ (1,0) [0|1] ""  IFV
 SG_ CAN_FR_DET_MIXER_BIAS_FLAG_113 : 82|1@0+ (1,0) [0|1] ""  IFV
 SG_ CAN_FR_DET_RESERVED_FLAGS_113 : 87|5@0+ (1,0) [0|31] ""  IFV
 SG_ CAN_FR_DET_SNR_113 : 95|8@0+ (0.35156,0) [0|89.6478] "dB"  IFV
 SG_ CAN_FR_DET_MULTI_TARGET_PROB_113 : 99|4@0+ (0.06667,0) [0|1] ""  IFV
 SG_ CAN_FR_DET_CONFID_AZIMUTH_113 : 101|2@0+ (1,0) [0|3] ""  IFV
 SG_ CAN_FR_DET_CONFID_ELEVATION_113 : 103|2@0+ (1,0) [0|3] ""  IFV
 SG_ CAN_FR_DET_EXISTENCE_PROB_113 : 107|4@0+ (1,0) [0|15] ""  IFV
 SG_ CAN_FR_DET_CLASS_113 : 111|4@0+ (1,0) [0|15] ""  IFV
 SG_ CAN_FR_DET_RANGE_114 : 127|14@0+ (0.015625,0) [0|255.984375] "m"  IFV
 SG_ CAN_FR_DET_SD_RANGE_114 : 129|6@0+ (0.025,0) [0|1.5] "m"  IFV
 SG_ CAN_FR_DET_RANGE_RATE_114 : 139|14@0+ (0.015625,-128) [-128|127.984375] "m/s"  IFV
 SG_ CAN_FR_DET_SD_RANGE_RATE_114 : 157|6@0+ (0.02,0) [0|1.2] "m/s"  IFV
 SG_ CAN_FR_DET_AZIMUTH_114 : 167|13@0+ (0.0007668,-3.141593) [-3.141593|3.141593] "rad"  IFV
 SG_ CAN_FR_DET_SD_AZIMUTH_114 : 170|6@0+ (0.001745329,0) [0|0.104719755] "rad"  IFV
 SG_ CAN_FR_DET_ELEVATION_114 : 180|7@0+ (0.157449,-9.99812) [-9.99812|9.997903] "deg"  IFV
 SG_ CAN_FR_DET_SD_ELEVATION_114 : 189|6@0+ (0.003490659,0) [0|0.20943951] "rad"  IFV
 SG_ CAN_FR_DET_AMPLITUDE_114 : 199|7@0+ (1,-64) [-64|63] "dBsm"  IFV
 SG_ CAN_FR_DET_VALID_FLAG_114 : 192|1@0+ (1,0) [0|1] ""  IFV
 SG_ CAN_FR_DET_SUPER_RES_114 : 200|1@0+ (1,0) [0|1] ""  IFV
 SG_ CAN_FR_DET_LOW_SNR_FLAG_114 : 201|1@0+ (1,0) [0|1] ""  IFV
 SG_ CAN_FR_DET_MIXER_BIAS_FLAG_114 : 202|1@0+ (1,0) [0|1] ""  IFV
 SG_ CAN_FR_DET_RESERVED_FLAGS_114 : 207|5@0+ (1,0) [0|31] ""  IFV
 SG_ CAN_FR_DET_SNR_114 : 215|8@0+ (0.35156,0) [0|89.6478] "dB"  IFV
 SG_ CAN_FR_DET_MULTI_TARGET_PROB_114 : 219|4@0+ (0.06667,0) [0|1] ""  IFV
 SG_ CAN_FR_DET_CONFID_AZIMUTH_114 : 221|2@0+ (1,0) [0|3] ""  IFV
 SG_ CAN_FR_DET_CONFID_ELEVATION_114 : 223|2@0+ (1,0) [0|3] ""  IFV
 SG_ CAN_FR_DET_EXISTENCE_PROB_114 : 227|4@0+ (1,0) [0|15] ""  IFV
 SG_ CAN_FR_DET_CLASS_114 : 231|4@0+ (1,0) [0|15] ""  IFV
 SG_ CAN_FR_DET_RANGE_115 : 247|14@0+ (0.015625,0) [0|255.984375] "m"  IFV
 SG_ CAN_FR_DET_SD_RANGE_115 : 249|6@0+ (0.025,0) [0|1.5] "m"  IFV
 SG_ CAN_FR_DET_RANGE_RATE_115 : 259|14@0+ (0.015625,-128) [-128|127.984375] "m/s"  IFV
 SG_ CAN_FR_DET_SD_RANGE_RATE_115 : 277|6@0+ (0.02,0) [0|1.2] "m/s"  IFV
 SG_ CAN_FR_DET_AZIMUTH_115 : 287|13@0+ (0.0007668,-3.141593) [-3.141593|3.141593] "rad"  IFV
 SG_ CAN_FR_DET_SD_AZIMUTH_115 : 290|6@0+ (0.001745329,0) [0|0.104719755] "rad"  IFV
 SG_ CAN_FR_DET_ELEVATION_115 : 300|7@0+ (0.157449,-9.99812) [-9.99812|9.997903] "deg"  IFV
 SG_ CAN_FR_DET_SD_ELEVATION_115 : 309|6@0+ (0.003490659,0) [0|0.20943951] "rad"  IFV
 SG_ CAN_FR_DET_AMPLITUDE_115 : 319|7@0+ (1,-64) [-64|63] "dBsm"  IFV
 SG_ CAN_FR_DET_VALID_FLAG_115 : 312|1@0+ (1,0) [0|1] ""  IFV
 SG_ CAN_FR_DET_SUPER_RES_115 : 320|1@0+ (1,0) [0|1] ""  IFV
 SG_ CAN_FR_DET_LOW_SNR_FLAG_115 : 321|1@0+ (1,0) [0|1] ""  IFV
 SG_ CAN_FR_DET_MIXER_BIAS_FLAG_115 : 322|1@0+ (1,0) [0|1] ""  IFV
 SG_ CAN_FR_DET_RESERVED_FLAGS_115 : 327|5@0+ (1,0) [0|31] ""  IFV
 SG_ CAN_FR_DET_SNR_115 : 335|8@0+ (0.35156,0) [0|89.6478] "dB"  IFV
 SG_ CAN_FR_DET_MULTI_TARGET_PROB_115 : 339|4@0+ (0.06667,0) [0|1] ""  IFV
 SG_ CAN_FR_DET_CONFID_AZIMUTH_115 : 341|2@0+ (1,0) [0|3] ""  IFV
 SG_ CAN_FR_DET_CONFID_ELEVATION_115 : 343|2@0+ (1,0) [0|3] ""  IFV
 SG_ CAN_FR_DET_EXISTENCE_PROB_115 : 347|4@0+ (1,0) [0|15] ""  IFV
 SG_ CAN_FR_DET_CLASS_115 : 351|4@0+ (1,0) [0|15] ""  IFV
 SG_ CAN_FR_DET_RANGE_116 : 367|14@0+ (0.015625,0) [0|255.984375] "m"  IFV
 SG_ CAN_FR_DET_SD_RANGE_116 : 369|6@0+ (0.025,0) [0|1.5] "m"  IFV
 SG_ CAN_FR_DET_RANGE_RATE_116 : 379|14@0+ (0.015625,-128) [-128|127.984375] "m/s"  IFV
 SG_ CAN_FR_DET_SD_RANGE_RATE_116 : 397|6@0+ (0.02,0) [0|1.2] "m/s"  IFV
 SG_ CAN_FR_DET_AZIMUTH_116 : 407|13@0+ (0.0007668,-3.141593) [-3.141593|3.141593] "rad"  IFV
 SG_ CAN_FR_DET_SD_AZIMUTH_116 : 410|6@0+ (0.001745329,0) [0|0.104719755] "rad"  IFV
 SG_ CAN_FR_DET_ELEVATION_116 : 420|7@0+ (0.157449,-9.99812) [-9.99812|9.997903] "deg"  IFV
 SG_ CAN_FR_DET_SD_ELEVATION_116 : 429|6@0+ (0.003490659,0) [0|0.20943951] "rad"  IFV
 SG_ CAN_FR_DET_AMPLITUDE_116 : 439|7@0+ (1,-64) [-64|63] "dBsm"  IFV
 SG_ CAN_FR_DET_VALID_FLAG_116 : 432|1@0+ (1,0) [0|1] ""  IFV
 SG_ CAN_FR_DET_SUPER_RES_116 : 440|1@0+ (1,0) [0|1] ""  IFV
 SG_ CAN_FR_DET_LOW_SNR_FLAG_116 : 441|1@0+ (1,0) [0|1] ""  IFV
 SG_ CAN_FR_DET_MIXER_BIAS_FLAG_116 : 442|1@0+ (1,0) [0|1] ""  IFV
 SG_ CAN_FR_DET_RESERVED_FLAGS_116 : 447|5@0+ (1,0) [0|31] ""  IFV
 SG_ CAN_FR_DET_SNR_116 : 455|8@0+ (0.35156,0) [0|89.6478] "dB"  IFV
 SG_ CAN_FR_DET_MULTI_TARGET_PROB_116 : 459|4@0+ (0.06667,0) [0|1] ""  IFV
 SG_ CAN_FR_DET_CONFID_AZIMUTH_116 : 461|2@0+ (1,0) [0|3] ""  IFV
 SG_ CAN_FR_DET_CONFID_ELEVATION_116 : 463|2@0+ (1,0) [0|3] ""  IFV
 SG_ CAN_FR_DET_EXISTENCE_PROB_116 : 467|4@0+ (1,0) [0|15] ""  IFV
 SG_ CAN_FR_DET_CLASS_116 : 471|4@0+ (1,0) [0|15] ""  IFV

BO_ 1053 SODFR_DETECTION_117_120: 64 SODFR
 SG_ CAN_FR_DET_RANGE_117 : 7|14@0+ (0.015625,0) [0|255.984375] "m"  IFV
 SG_ CAN_FR_DET_SD_RANGE_117 : 9|6@0+ (0.025,0) [0|1.5] "m"  IFV
 SG_ CAN_FR_DET_RANGE_RATE_117 : 19|14@0+ (0.015625,-128) [-128|127.984375] "m/s"  IFV
 SG_ CAN_FR_DET_SD_RANGE_RATE_117 : 37|6@0+ (0.02,0) [0|1.2] "m/s"  IFV
 SG_ CAN_FR_DET_AZIMUTH_117 : 47|13@0+ (0.0007668,-3.141593) [-3.141593|3.141593] "rad"  IFV
 SG_ CAN_FR_DET_SD_AZIMUTH_117 : 50|6@0+ (0.001745329,0) [0|0.104719755] "rad"  IFV
 SG_ CAN_FR_DET_ELEVATION_117 : 60|7@0+ (0.157449,-9.99812) [-9.99812|9.997903] "deg"  IFV
 SG_ CAN_FR_DET_SD_ELEVATION_117 : 69|6@0+ (0.003490659,0) [0|0.20943951] "rad"  IFV
 SG_ CAN_FR_DET_AMPLITUDE_117 : 79|7@0+ (1,-64) [-64|63] "dBsm"  IFV
 SG_ CAN_FR_DET_VALID_FLAG_117 : 72|1@0+ (1,0) [0|1] ""  IFV
 SG_ CAN_FR_DET_SUPER_RES_117 : 80|1@0+ (1,0) [0|1] ""  IFV
 SG_ CAN_FR_DET_LOW_SNR_FLAG_117 : 81|1@0+ (1,0) [0|1] ""  IFV
 SG_ CAN_FR_DET_MIXER_BIAS_FLAG_117 : 82|1@0+ (1,0) [0|1] ""  IFV
 SG_ CAN_FR_DET_RESERVED_FLAGS_117 : 87|5@0+ (1,0) [0|31] ""  IFV
 SG_ CAN_FR_DET_SNR_117 : 95|8@0+ (0.35156,0) [0|89.6478] "dB"  IFV
 SG_ CAN_FR_DET_MULTI_TARGET_PROB_117 : 99|4@0+ (0.06667,0) [0|1] ""  IFV
 SG_ CAN_FR_DET_CONFID_AZIMUTH_117 : 101|2@0+ (1,0) [0|3] ""  IFV
 SG_ CAN_FR_DET_CONFID_ELEVATION_117 : 103|2@0+ (1,0) [0|3] ""  IFV
 SG_ CAN_FR_DET_EXISTENCE_PROB_117 : 107|4@0+ (1,0) [0|15] ""  IFV
 SG_ CAN_FR_DET_CLASS_117 : 111|4@0+ (1,0) [0|15] ""  IFV
 SG_ CAN_FR_DET_RANGE_118 : 127|14@0+ (0.015625,0) [0|255.984375] "m"  IFV
 SG_ CAN_FR_DET_SD_RANGE_118 : 129|6@0+ (0.025,0) [0|1.5] "m"  IFV
 SG_ CAN_FR_DET_RANGE_RATE_118 : 139|14@0+ (0.015625,-128) [-128|127.984375] "m/s"  IFV
 SG_ CAN_FR_DET_SD_RANGE_RATE_118 : 157|6@0+ (0.02,0) [0|1.2] "m/s"  IFV
 SG_ CAN_FR_DET_AZIMUTH_118 : 167|13@0+ (0.0007668,-3.141593) [-3.141593|3.141593] "rad"  IFV
 SG_ CAN_FR_DET_SD_AZIMUTH_118 : 170|6@0+ (0.001745329,0) [0|0.104719755] "rad"  IFV
 SG_ CAN_FR_DET_ELEVATION_118 : 180|7@0+ (0.157449,-9.99812) [-9.99812|9.997903] "deg"  IFV
 SG_ CAN_FR_DET_SD_ELEVATION_118 : 189|6@0+ (0.003490659,0) [0|0.20943951] "rad"  IFV
 SG_ CAN_FR_DET_AMPLITUDE_118 : 199|7@0+ (1,-64) [-64|63] "dBsm"  IFV
 SG_ CAN_FR_DET_VALID_FLAG_118 : 192|1@0+ (1,0) [0|1] ""  IFV
 SG_ CAN_FR_DET_SUPER_RES_118 : 200|1@0+ (1,0) [0|1] ""  IFV
 SG_ CAN_FR_DET_LOW_SNR_FLAG_118 : 201|1@0+ (1,0) [0|1] ""  IFV
 SG_ CAN_FR_DET_MIXER_BIAS_FLAG_118 : 202|1@0+ (1,0) [0|1] ""  IFV
 SG_ CAN_FR_DET_RESERVED_FLAGS_118 : 207|5@0+ (1,0) [0|31] ""  IFV
 SG_ CAN_FR_DET_SNR_118 : 215|8@0+ (0.35156,0) [0|89.6478] "dB"  IFV
 SG_ CAN_FR_DET_MULTI_TARGET_PROB_118 : 219|4@0+ (0.06667,0) [0|1] ""  IFV
 SG_ CAN_FR_DET_CONFID_AZIMUTH_118 : 221|2@0+ (1,0) [0|3] ""  IFV
 SG_ CAN_FR_DET_CONFID_ELEVATION_118 : 223|2@0+ (1,0) [0|3] ""  IFV
 SG_ CAN_FR_DET_EXISTENCE_PROB_118 : 227|4@0+ (1,0) [0|15] ""  IFV
 SG_ CAN_FR_DET_CLASS_118 : 231|4@0+ (1,0) [0|15] ""  IFV
 SG_ CAN_FR_DET_RANGE_119 : 247|14@0+ (0.015625,0) [0|255.984375] "m"  IFV
 SG_ CAN_FR_DET_SD_RANGE_119 : 249|6@0+ (0.025,0) [0|1.5] "m"  IFV
 SG_ CAN_FR_DET_RANGE_RATE_119 : 259|14@0+ (0.015625,-128) [-128|127.984375] "m/s"  IFV
 SG_ CAN_FR_DET_SD_RANGE_RATE_119 : 277|6@0+ (0.02,0) [0|1.2] "m/s"  IFV
 SG_ CAN_FR_DET_AZIMUTH_119 : 287|13@0+ (0.0007668,-3.141593) [-3.141593|3.141593] "rad"  IFV
 SG_ CAN_FR_DET_SD_AZIMUTH_119 : 290|6@0+ (0.001745329,0) [0|0.104719755] "rad"  IFV
 SG_ CAN_FR_DET_ELEVATION_119 : 300|7@0+ (0.157449,-9.99812) [-9.99812|9.997903] "deg"  IFV
 SG_ CAN_FR_DET_SD_ELEVATION_119 : 309|6@0+ (0.003490659,0) [0|0.20943951] "rad"  IFV
 SG_ CAN_FR_DET_AMPLITUDE_119 : 319|7@0+ (1,-64) [-64|63] "dBsm"  IFV
 SG_ CAN_FR_DET_VALID_FLAG_119 : 312|1@0+ (1,0) [0|1] ""  IFV
 SG_ CAN_FR_DET_SUPER_RES_119 : 320|1@0+ (1,0) [0|1] ""  IFV
 SG_ CAN_FR_DET_LOW_SNR_FLAG_119 : 321|1@0+ (1,0) [0|1] ""  IFV
 SG_ CAN_FR_DET_MIXER_BIAS_FLAG_119 : 322|1@0+ (1,0) [0|1] ""  IFV
 SG_ CAN_FR_DET_RESERVED_FLAGS_119 : 327|5@0+ (1,0) [0|31] ""  IFV
 SG_ CAN_FR_DET_SNR_119 : 335|8@0+ (0.35156,0) [0|89.6478] "dB"  IFV
 SG_ CAN_FR_DET_MULTI_TARGET_PROB_119 : 339|4@0+ (0.06667,0) [0|1] ""  IFV
 SG_ CAN_FR_DET_CONFID_AZIMUTH_119 : 341|2@0+ (1,0) [0|3] ""  IFV
 SG_ CAN_FR_DET_CONFID_ELEVATION_119 : 343|2@0+ (1,0) [0|3] ""  IFV
 SG_ CAN_FR_DET_EXISTENCE_PROB_119 : 347|4@0+ (1,0) [0|15] ""  IFV
 SG_ CAN_FR_DET_CLASS_119 : 351|4@0+ (1,0) [0|15] ""  IFV
 SG_ CAN_FR_DET_RANGE_120 : 367|14@0+ (0.015625,0) [0|255.984375] "m"  IFV
 SG_ CAN_FR_DET_SD_RANGE_120 : 369|6@0+ (0.025,0) [0|1.5] "m"  IFV
 SG_ CAN_FR_DET_RANGE_RATE_120 : 379|14@0+ (0.015625,-128) [-128|127.984375] "m/s"  IFV
 SG_ CAN_FR_DET_SD_RANGE_RATE_120 : 397|6@0+ (0.02,0) [0|1.2] "m/s"  IFV
 SG_ CAN_FR_DET_AZIMUTH_120 : 407|13@0+ (0.0007668,-3.141593) [-3.141593|3.141593] "rad"  IFV
 SG_ CAN_FR_DET_SD_AZIMUTH_120 : 410|6@0+ (0.001745329,0) [0|0.104719755] "rad"  IFV
 SG_ CAN_FR_DET_ELEVATION_120 : 420|7@0+ (0.157449,-9.99812) [-9.99812|9.997903] "deg"  IFV
 SG_ CAN_FR_DET_SD_ELEVATION_120 : 429|6@0+ (0.003490659,0) [0|0.20943951] "rad"  IFV
 SG_ CAN_FR_DET_AMPLITUDE_120 : 439|7@0+ (1,-64) [-64|63] "dBsm"  IFV
 SG_ CAN_FR_DET_VALID_FLAG_120 : 432|1@0+ (1,0) [0|1] ""  IFV
 SG_ CAN_FR_DET_SUPER_RES_120 : 440|1@0+ (1,0) [0|1] ""  IFV
 SG_ CAN_FR_DET_LOW_SNR_FLAG_120 : 441|1@0+ (1,0) [0|1] ""  IFV
 SG_ CAN_FR_DET_MIXER_BIAS_FLAG_120 : 442|1@0+ (1,0) [0|1] ""  IFV
 SG_ CAN_FR_DET_RESERVED_FLAGS_120 : 447|5@0+ (1,0) [0|31] ""  IFV
 SG_ CAN_FR_DET_SNR_120 : 455|8@0+ (0.35156,0) [0|89.6478] "dB"  IFV
 SG_ CAN_FR_DET_MULTI_TARGET_PROB_120 : 459|4@0+ (0.06667,0) [0|1] ""  IFV
 SG_ CAN_FR_DET_CONFID_AZIMUTH_120 : 461|2@0+ (1,0) [0|3] ""  IFV
 SG_ CAN_FR_DET_CONFID_ELEVATION_120 : 463|2@0+ (1,0) [0|3] ""  IFV
 SG_ CAN_FR_DET_EXISTENCE_PROB_120 : 467|4@0+ (1,0) [0|15] ""  IFV
 SG_ CAN_FR_DET_CLASS_120 : 471|4@0+ (1,0) [0|15] ""  IFV

BO_ 1054 SODFR_DETECTION_121_124: 64 SODFR
 SG_ CAN_FR_DET_RANGE_121 : 7|14@0+ (0.015625,0) [0|255.984375] "m"  IFV
 SG_ CAN_FR_DET_SD_RANGE_121 : 9|6@0+ (0.025,0) [0|1.5] "m"  IFV
 SG_ CAN_FR_DET_RANGE_RATE_121 : 19|14@0+ (0.015625,-128) [-128|127.984375] "m/s"  IFV
 SG_ CAN_FR_DET_SD_RANGE_RATE_121 : 37|6@0+ (0.02,0) [0|1.2] "m/s"  IFV
 SG_ CAN_FR_DET_AZIMUTH_121 : 47|13@0+ (0.0007668,-3.141593) [-3.141593|3.141593] "rad"  IFV
 SG_ CAN_FR_DET_SD_AZIMUTH_121 : 50|6@0+ (0.001745329,0) [0|0.104719755] "rad"  IFV
 SG_ CAN_FR_DET_ELEVATION_121 : 60|7@0+ (0.157449,-9.99812) [-9.99812|9.997903] "deg"  IFV
 SG_ CAN_FR_DET_SD_ELEVATION_121 : 69|6@0+ (0.003490659,0) [0|0.20943951] "rad"  IFV
 SG_ CAN_FR_DET_AMPLITUDE_121 : 79|7@0+ (1,-64) [-64|63] "dBsm"  IFV
 SG_ CAN_FR_DET_VALID_FLAG_121 : 72|1@0+ (1,0) [0|1] ""  IFV
 SG_ CAN_FR_DET_SUPER_RES_121 : 80|1@0+ (1,0) [0|1] ""  IFV
 SG_ CAN_FR_DET_LOW_SNR_FLAG_121 : 81|1@0+ (1,0) [0|1] ""  IFV
 SG_ CAN_FR_DET_MIXER_BIAS_FLAG_121 : 82|1@0+ (1,0) [0|1] ""  IFV
 SG_ CAN_FR_DET_RESERVED_FLAGS_121 : 87|5@0+ (1,0) [0|31] ""  IFV
 SG_ CAN_FR_DET_SNR_121 : 95|8@0+ (0.35156,0) [0|89.6478] "dB"  IFV
 SG_ CAN_FR_DET_MULTI_TARGET_PROB_121 : 99|4@0+ (0.06667,0) [0|1] ""  IFV
 SG_ CAN_FR_DET_CONFID_AZIMUTH_121 : 101|2@0+ (1,0) [0|3] ""  IFV
 SG_ CAN_FR_DET_CONFID_ELEVATION_121 : 103|2@0+ (1,0) [0|3] ""  IFV
 SG_ CAN_FR_DET_EXISTENCE_PROB_121 : 107|4@0+ (1,0) [0|15] ""  IFV
 SG_ CAN_FR_DET_CLASS_121 : 111|4@0+ (1,0) [0|15] ""  IFV
 SG_ CAN_FR_DET_RANGE_122 : 127|14@0+ (0.015625,0) [0|255.984375] "m"  IFV
 SG_ CAN_FR_DET_SD_RANGE_122 : 129|6@0+ (0.025,0) [0|1.5] "m"  IFV
 SG_ CAN_FR_DET_RANGE_RATE_122 : 139|14@0+ (0.015625,-128) [-128|127.984375] "m/s"  IFV
 SG_ CAN_FR_DET_SD_RANGE_RATE_122 : 157|6@0+ (0.02,0) [0|1.2] "m/s"  IFV
 SG_ CAN_FR_DET_AZIMUTH_122 : 167|13@0+ (0.0007668,-3.141593) [-3.141593|3.141593] "rad"  IFV
 SG_ CAN_FR_DET_SD_AZIMUTH_122 : 170|6@0+ (0.001745329,0) [0|0.104719755] "rad"  IFV
 SG_ CAN_FR_DET_ELEVATION_122 : 180|7@0+ (0.157449,-9.99812) [-9.99812|9.997903] "deg"  IFV
 SG_ CAN_FR_DET_SD_ELEVATION_122 : 189|6@0+ (0.003490659,0) [0|0.20943951] "rad"  IFV
 SG_ CAN_FR_DET_AMPLITUDE_122 : 199|7@0+ (1,-64) [-64|63] "dBsm"  IFV
 SG_ CAN_FR_DET_VALID_FLAG_122 : 192|1@0+ (1,0) [0|1] ""  IFV
 SG_ CAN_FR_DET_SUPER_RES_122 : 200|1@0+ (1,0) [0|1] ""  IFV
 SG_ CAN_FR_DET_LOW_SNR_FLAG_122 : 201|1@0+ (1,0) [0|1] ""  IFV
 SG_ CAN_FR_DET_MIXER_BIAS_FLAG_122 : 202|1@0+ (1,0) [0|1] ""  IFV
 SG_ CAN_FR_DET_RESERVED_FLAGS_122 : 207|5@0+ (1,0) [0|31] ""  IFV
 SG_ CAN_FR_DET_SNR_122 : 215|8@0+ (0.35156,0) [0|89.6478] "dB"  IFV
 SG_ CAN_FR_DET_MULTI_TARGET_PROB_122 : 219|4@0+ (0.06667,0) [0|1] ""  IFV
 SG_ CAN_FR_DET_CONFID_AZIMUTH_122 : 221|2@0+ (1,0) [0|3] ""  IFV
 SG_ CAN_FR_DET_CONFID_ELEVATION_122 : 223|2@0+ (1,0) [0|3] ""  IFV
 SG_ CAN_FR_DET_EXISTENCE_PROB_122 : 227|4@0+ (1,0) [0|15] ""  IFV
 SG_ CAN_FR_DET_CLASS_122 : 231|4@0+ (1,0) [0|15] ""  IFV
 SG_ CAN_FR_DET_RANGE_123 : 247|14@0+ (0.015625,0) [0|255.984375] "m"  IFV
 SG_ CAN_FR_DET_SD_RANGE_123 : 249|6@0+ (0.025,0) [0|1.5] "m"  IFV
 SG_ CAN_FR_DET_RANGE_RATE_123 : 259|14@0+ (0.015625,-128) [-128|127.984375] "m/s"  IFV
 SG_ CAN_FR_DET_SD_RANGE_RATE_123 : 277|6@0+ (0.02,0) [0|1.2] "m/s"  IFV
 SG_ CAN_FR_DET_AZIMUTH_123 : 287|13@0+ (0.0007668,-3.141593) [-3.141593|3.141593] "rad"  IFV
 SG_ CAN_FR_DET_SD_AZIMUTH_123 : 290|6@0+ (0.001745329,0) [0|0.104719755] "rad"  IFV
 SG_ CAN_FR_DET_ELEVATION_123 : 300|7@0+ (0.157449,-9.99812) [-9.99812|9.997903] "deg"  IFV
 SG_ CAN_FR_DET_SD_ELEVATION_123 : 309|6@0+ (0.003490659,0) [0|0.20943951] "rad"  IFV
 SG_ CAN_FR_DET_AMPLITUDE_123 : 319|7@0+ (1,-64) [-64|63] "dBsm"  IFV
 SG_ CAN_FR_DET_VALID_FLAG_123 : 312|1@0+ (1,0) [0|1] ""  IFV
 SG_ CAN_FR_DET_SUPER_RES_123 : 320|1@0+ (1,0) [0|1] ""  IFV
 SG_ CAN_FR_DET_LOW_SNR_FLAG_123 : 321|1@0+ (1,0) [0|1] ""  IFV
 SG_ CAN_FR_DET_MIXER_BIAS_FLAG_123 : 322|1@0+ (1,0) [0|1] ""  IFV
 SG_ CAN_FR_DET_RESERVED_FLAGS_123 : 327|5@0+ (1,0) [0|31] ""  IFV
 SG_ CAN_FR_DET_SNR_123 : 335|8@0+ (0.35156,0) [0|89.6478] "dB"  IFV
 SG_ CAN_FR_DET_MULTI_TARGET_PROB_123 : 339|4@0+ (0.06667,0) [0|1] ""  IFV
 SG_ CAN_FR_DET_CONFID_AZIMUTH_123 : 341|2@0+ (1,0) [0|3] ""  IFV
 SG_ CAN_FR_DET_CONFID_ELEVATION_123 : 343|2@0+ (1,0) [0|3] ""  IFV
 SG_ CAN_FR_DET_EXISTENCE_PROB_123 : 347|4@0+ (1,0) [0|15] ""  IFV
 SG_ CAN_FR_DET_CLASS_123 : 351|4@0+ (1,0) [0|15] ""  IFV
 SG_ CAN_FR_DET_RANGE_124 : 367|14@0+ (0.015625,0) [0|255.984375] "m"  IFV
 SG_ CAN_FR_DET_SD_RANGE_124 : 369|6@0+ (0.025,0) [0|1.5] "m"  IFV
 SG_ CAN_FR_DET_RANGE_RATE_124 : 379|14@0+ (0.015625,-128) [-128|127.984375] "m/s"  IFV
 SG_ CAN_FR_DET_SD_RANGE_RATE_124 : 397|6@0+ (0.02,0) [0|1.2] "m/s"  IFV
 SG_ CAN_FR_DET_AZIMUTH_124 : 407|13@0+ (0.0007668,-3.141593) [-3.141593|3.141593] "rad"  IFV
 SG_ CAN_FR_DET_SD_AZIMUTH_124 : 410|6@0+ (0.001745329,0) [0|0.104719755] "rad"  IFV
 SG_ CAN_FR_DET_ELEVATION_124 : 420|7@0+ (0.157449,-9.99812) [-9.99812|9.997903] "deg"  IFV
 SG_ CAN_FR_DET_SD_ELEVATION_124 : 429|6@0+ (0.003490659,0) [0|0.20943951] "rad"  IFV
 SG_ CAN_FR_DET_AMPLITUDE_124 : 439|7@0+ (1,-64) [-64|63] "dBsm"  IFV
 SG_ CAN_FR_DET_VALID_FLAG_124 : 432|1@0+ (1,0) [0|1] ""  IFV
 SG_ CAN_FR_DET_SUPER_RES_124 : 440|1@0+ (1,0) [0|1] ""  IFV
 SG_ CAN_FR_DET_LOW_SNR_FLAG_124 : 441|1@0+ (1,0) [0|1] ""  IFV
 SG_ CAN_FR_DET_MIXER_BIAS_FLAG_124 : 442|1@0+ (1,0) [0|1] ""  IFV
 SG_ CAN_FR_DET_RESERVED_FLAGS_124 : 447|5@0+ (1,0) [0|31] ""  IFV
 SG_ CAN_FR_DET_SNR_124 : 455|8@0+ (0.35156,0) [0|89.6478] "dB"  IFV
 SG_ CAN_FR_DET_MULTI_TARGET_PROB_124 : 459|4@0+ (0.06667,0) [0|1] ""  IFV
 SG_ CAN_FR_DET_CONFID_AZIMUTH_124 : 461|2@0+ (1,0) [0|3] ""  IFV
 SG_ CAN_FR_DET_CONFID_ELEVATION_124 : 463|2@0+ (1,0) [0|3] ""  IFV
 SG_ CAN_FR_DET_EXISTENCE_PROB_124 : 467|4@0+ (1,0) [0|15] ""  IFV
 SG_ CAN_FR_DET_CLASS_124 : 471|4@0+ (1,0) [0|15] ""  IFV

BO_ 1055 SODFR_DETECTION_125_128: 64 SODFR
 SG_ CAN_FR_DET_RANGE_125 : 7|14@0+ (0.015625,0) [0|255.984375] "m"  IFV
 SG_ CAN_FR_DET_SD_RANGE_125 : 9|6@0+ (0.025,0) [0|1.5] "m"  IFV
 SG_ CAN_FR_DET_RANGE_RATE_125 : 19|14@0+ (0.015625,-128) [-128|127.984375] "m/s"  IFV
 SG_ CAN_FR_DET_SD_RANGE_RATE_125 : 37|6@0+ (0.02,0) [0|1.2] "m/s"  IFV
 SG_ CAN_FR_DET_AZIMUTH_125 : 47|13@0+ (0.0007668,-3.141593) [-3.141593|3.141593] "rad"  IFV
 SG_ CAN_FR_DET_SD_AZIMUTH_125 : 50|6@0+ (0.001745329,0) [0|0.104719755] "rad"  IFV
 SG_ CAN_FR_DET_ELEVATION_125 : 60|7@0+ (0.157449,-9.99812) [-9.99812|9.997903] "deg"  IFV
 SG_ CAN_FR_DET_SD_ELEVATION_125 : 69|6@0+ (0.003490659,0) [0|0.20943951] "rad"  IFV
 SG_ CAN_FR_DET_AMPLITUDE_125 : 79|7@0+ (1,-64) [-64|63] "dBsm"  IFV
 SG_ CAN_FR_DET_VALID_FLAG_125 : 72|1@0+ (1,0) [0|1] ""  IFV
 SG_ CAN_FR_DET_SUPER_RES_125 : 80|1@0+ (1,0) [0|1] ""  IFV
 SG_ CAN_FR_DET_LOW_SNR_FLAG_125 : 81|1@0+ (1,0) [0|1] ""  IFV
 SG_ CAN_FR_DET_MIXER_BIAS_FLAG_125 : 82|1@0+ (1,0) [0|1] ""  IFV
 SG_ CAN_FR_DET_RESERVED_FLAGS_125 : 87|5@0+ (1,0) [0|31] ""  IFV
 SG_ CAN_FR_DET_SNR_125 : 95|8@0+ (0.35156,0) [0|89.6478] "dB"  IFV
 SG_ CAN_FR_DET_MULTI_TARGET_PROB_125 : 99|4@0+ (0.06667,0) [0|1] ""  IFV
 SG_ CAN_FR_DET_CONFID_AZIMUTH_125 : 101|2@0+ (1,0) [0|3] ""  IFV
 SG_ CAN_FR_DET_CONFID_ELEVATION_125 : 103|2@0+ (1,0) [0|3] ""  IFV
 SG_ CAN_FR_DET_EXISTENCE_PROB_125 : 107|4@0+ (1,0) [0|15] ""  IFV
 SG_ CAN_FR_DET_CLASS_125 : 111|4@0+ (1,0) [0|15] ""  IFV
 SG_ CAN_FR_DET_RANGE_126 : 127|14@0+ (0.015625,0) [0|255.984375] "m"  IFV
 SG_ CAN_FR_DET_SD_RANGE_126 : 129|6@0+ (0.025,0) [0|1.5] "m"  IFV
 SG_ CAN_FR_DET_RANGE_RATE_126 : 139|14@0+ (0.015625,-128) [-128|127.984375] "m/s"  IFV
 SG_ CAN_FR_DET_SD_RANGE_RATE_126 : 157|6@0+ (0.02,0) [0|1.2] "m/s"  IFV
 SG_ CAN_FR_DET_AZIMUTH_126 : 167|13@0+ (0.0007668,-3.141593) [-3.141593|3.141593] "rad"  IFV
 SG_ CAN_FR_DET_SD_AZIMUTH_126 : 170|6@0+ (0.001745329,0) [0|0.104719755] "rad"  IFV
 SG_ CAN_FR_DET_ELEVATION_126 : 180|7@0+ (0.157449,-9.99812) [-9.99812|9.997903] "deg"  IFV
 SG_ CAN_FR_DET_SD_ELEVATION_126 : 189|6@0+ (0.003490659,0) [0|0.20943951] "rad"  IFV
 SG_ CAN_FR_DET_AMPLITUDE_126 : 199|7@0+ (1,-64) [-64|63] "dBsm"  IFV
 SG_ CAN_FR_DET_VALID_FLAG_126 : 192|1@0+ (1,0) [0|1] ""  IFV
 SG_ CAN_FR_DET_SUPER_RES_126 : 200|1@0+ (1,0) [0|1] ""  IFV
 SG_ CAN_FR_DET_LOW_SNR_FLAG_126 : 201|1@0+ (1,0) [0|1] ""  IFV
 SG_ CAN_FR_DET_MIXER_BIAS_FLAG_126 : 202|1@0+ (1,0) [0|1] ""  IFV
 SG_ CAN_FR_DET_RESERVED_FLAGS_126 : 207|5@0+ (1,0) [0|31] ""  IFV
 SG_ CAN_FR_DET_SNR_126 : 215|8@0+ (0.35156,0) [0|89.6478] "dB"  IFV
 SG_ CAN_FR_DET_MULTI_TARGET_PROB_126 : 219|4@0+ (0.06667,0) [0|1] ""  IFV
 SG_ CAN_FR_DET_CONFID_AZIMUTH_126 : 221|2@0+ (1,0) [0|3] ""  IFV
 SG_ CAN_FR_DET_CONFID_ELEVATION_126 : 223|2@0+ (1,0) [0|3] ""  IFV
 SG_ CAN_FR_DET_EXISTENCE_PROB_126 : 227|4@0+ (1,0) [0|15] ""  IFV
 SG_ CAN_FR_DET_CLASS_126 : 231|4@0+ (1,0) [0|15] ""  IFV
 SG_ CAN_FR_DET_RANGE_127 : 247|14@0+ (0.015625,0) [0|255.984375] "m"  IFV
 SG_ CAN_FR_DET_SD_RANGE_127 : 249|6@0+ (0.025,0) [0|1.5] "m"  IFV
 SG_ CAN_FR_DET_RANGE_RATE_127 : 259|14@0+ (0.015625,-128) [-128|127.984375] "m/s"  IFV
 SG_ CAN_FR_DET_SD_RANGE_RATE_127 : 277|6@0+ (0.02,0) [0|1.2] "m/s"  IFV
 SG_ CAN_FR_DET_AZIMUTH_127 : 287|13@0+ (0.0007668,-3.141593) [-3.141593|3.141593] "rad"  IFV
 SG_ CAN_FR_DET_SD_AZIMUTH_127 : 290|6@0+ (0.001745329,0) [0|0.104719755] "rad"  IFV
 SG_ CAN_FR_DET_ELEVATION_127 : 300|7@0+ (0.157449,-9.99812) [-9.99812|9.997903] "deg"  IFV
 SG_ CAN_FR_DET_SD_ELEVATION_127 : 309|6@0+ (0.003490659,0) [0|0.20943951] "rad"  IFV
 SG_ CAN_FR_DET_AMPLITUDE_127 : 319|7@0+ (1,-64) [-64|63] "dBsm"  IFV
 SG_ CAN_FR_DET_VALID_FLAG_127 : 312|1@0+ (1,0) [0|1] ""  IFV
 SG_ CAN_FR_DET_SUPER_RES_127 : 320|1@0+ (1,0) [0|1] ""  IFV
 SG_ CAN_FR_DET_LOW_SNR_FLAG_127 : 321|1@0+ (1,0) [0|1] ""  IFV
 SG_ CAN_FR_DET_MIXER_BIAS_FLAG_127 : 322|1@0+ (1,0) [0|1] ""  IFV
 SG_ CAN_FR_DET_RESERVED_FLAGS_127 : 327|5@0+ (1,0) [0|31] ""  IFV
 SG_ CAN_FR_DET_SNR_127 : 335|8@0+ (0.35156,0) [0|89.6478] "dB"  IFV
 SG_ CAN_FR_DET_MULTI_TARGET_PROB_127 : 339|4@0+ (0.06667,0) [0|1] ""  IFV
 SG_ CAN_FR_DET_CONFID_AZIMUTH_127 : 341|2@0+ (1,0) [0|3] ""  IFV
 SG_ CAN_FR_DET_CONFID_ELEVATION_127 : 343|2@0+ (1,0) [0|3] ""  IFV
 SG_ CAN_FR_DET_EXISTENCE_PROB_127 : 347|4@0+ (1,0) [0|15] ""  IFV
 SG_ CAN_FR_DET_CLASS_127 : 351|4@0+ (1,0) [0|15] ""  IFV
 SG_ CAN_FR_DET_RANGE_128 : 367|14@0+ (0.015625,0) [0|255.984375] "m"  IFV
 SG_ CAN_FR_DET_SD_RANGE_128 : 369|6@0+ (0.025,0) [0|1.5] "m"  IFV
 SG_ CAN_FR_DET_RANGE_RATE_128 : 379|14@0+ (0.015625,-128) [-128|127.984375] "m/s"  IFV
 SG_ CAN_FR_DET_SD_RANGE_RATE_128 : 397|6@0+ (0.02,0) [0|1.2] "m/s"  IFV
 SG_ CAN_FR_DET_AZIMUTH_128 : 407|13@0+ (0.0007668,-3.141593) [-3.141593|3.141593] "rad"  IFV
 SG_ CAN_FR_DET_SD_AZIMUTH_128 : 410|6@0+ (0.001745329,0) [0|0.104719755] "rad"  IFV
 SG_ CAN_FR_DET_ELEVATION_128 : 420|7@0+ (0.157449,-9.99812) [-9.99812|9.997903] "deg"  IFV
 SG_ CAN_FR_DET_SD_ELEVATION_128 : 429|6@0+ (0.003490659,0) [0|0.20943951] "rad"  IFV
 SG_ CAN_FR_DET_AMPLITUDE_128 : 439|7@0+ (1,-64) [-64|63] "dBsm"  IFV
 SG_ CAN_FR_DET_VALID_FLAG_128 : 432|1@0+ (1,0) [0|1] ""  IFV
 SG_ CAN_FR_DET_SUPER_RES_128 : 440|1@0+ (1,0) [0|1] ""  IFV
 SG_ CAN_FR_DET_LOW_SNR_FLAG_128 : 441|1@0+ (1,0) [0|1] ""  IFV
 SG_ CAN_FR_DET_MIXER_BIAS_FLAG_128 : 442|1@0+ (1,0) [0|1] ""  IFV
 SG_ CAN_FR_DET_RESERVED_FLAGS_128 : 447|5@0+ (1,0) [0|31] ""  IFV
 SG_ CAN_FR_DET_SNR_128 : 455|8@0+ (0.35156,0) [0|89.6478] "dB"  IFV
 SG_ CAN_FR_DET_MULTI_TARGET_PROB_128 : 459|4@0+ (0.06667,0) [0|1] ""  IFV
 SG_ CAN_FR_DET_CONFID_AZIMUTH_128 : 461|2@0+ (1,0) [0|3] ""  IFV
 SG_ CAN_FR_DET_CONFID_ELEVATION_128 : 463|2@0+ (1,0) [0|3] ""  IFV
 SG_ CAN_FR_DET_EXISTENCE_PROB_128 : 467|4@0+ (1,0) [0|15] ""  IFV
 SG_ CAN_FR_DET_CLASS_128 : 471|4@0+ (1,0) [0|15] ""  IFV

BO_ 1056 SODFR_DETECTION_129_132: 64 SODFR
 SG_ CAN_FR_DET_RANGE_129 : 7|14@0+ (0.015625,0) [0|255.984375] "m"  IFV
 SG_ CAN_FR_DET_SD_RANGE_129 : 9|6@0+ (0.025,0) [0|1.5] "m"  IFV
 SG_ CAN_FR_DET_RANGE_RATE_129 : 19|14@0+ (0.015625,-128) [-128|127.984375] "m/s"  IFV
 SG_ CAN_FR_DET_SD_RANGE_RATE_129 : 37|6@0+ (0.02,0) [0|1.2] "m/s"  IFV
 SG_ CAN_FR_DET_AZIMUTH_129 : 47|13@0+ (0.0007668,-3.141593) [-3.141593|3.141593] "rad"  IFV
 SG_ CAN_FR_DET_SD_AZIMUTH_129 : 50|6@0+ (0.001745329,0) [0|0.104719755] "rad"  IFV
 SG_ CAN_FR_DET_ELEVATION_129 : 60|7@0+ (0.157449,-9.99812) [-9.99812|9.997903] "deg"  IFV
 SG_ CAN_FR_DET_SD_ELEVATION_129 : 69|6@0+ (0.003490659,0) [0|0.20943951] "rad"  IFV
 SG_ CAN_FR_DET_AMPLITUDE_129 : 79|7@0+ (1,-64) [-64|63] "dBsm"  IFV
 SG_ CAN_FR_DET_VALID_FLAG_129 : 72|1@0+ (1,0) [0|1] ""  IFV
 SG_ CAN_FR_DET_SUPER_RES_129 : 80|1@0+ (1,0) [0|1] ""  IFV
 SG_ CAN_FR_DET_LOW_SNR_FLAG_129 : 81|1@0+ (1,0) [0|1] ""  IFV
 SG_ CAN_FR_DET_MIXER_BIAS_FLAG_129 : 82|1@0+ (1,0) [0|1] ""  IFV
 SG_ CAN_FR_DET_RESERVED_FLAGS_129 : 87|5@0+ (1,0) [0|31] ""  IFV
 SG_ CAN_FR_DET_SNR_129 : 95|8@0+ (0.35156,0) [0|89.6478] "dB"  IFV
 SG_ CAN_FR_DET_MULTI_TARGET_PROB_129 : 99|4@0+ (0.06667,0) [0|1] ""  IFV
 SG_ CAN_FR_DET_CONFID_AZIMUTH_129 : 101|2@0+ (1,0) [0|3] ""  IFV
 SG_ CAN_FR_DET_CONFID_ELEVATION_129 : 103|2@0+ (1,0) [0|3] ""  IFV
 SG_ CAN_FR_DET_EXISTENCE_PROB_129 : 107|4@0+ (1,0) [0|15] ""  IFV
 SG_ CAN_FR_DET_CLASS_129 : 111|4@0+ (1,0) [0|15] ""  IFV
 SG_ CAN_FR_DET_RANGE_130 : 127|14@0+ (0.015625,0) [0|255.984375] "m"  IFV
 SG_ CAN_FR_DET_SD_RANGE_130 : 129|6@0+ (0.025,0) [0|1.5] "m"  IFV
 SG_ CAN_FR_DET_RANGE_RATE_130 : 139|14@0+ (0.015625,-128) [-128|127.984375] "m/s"  IFV
 SG_ CAN_FR_DET_SD_RANGE_RATE_130 : 157|6@0+ (0.02,0) [0|1.2] "m/s"  IFV
 SG_ CAN_FR_DET_AZIMUTH_130 : 167|13@0+ (0.0007668,-3.141593) [-3.141593|3.141593] "rad"  IFV
 SG_ CAN_FR_DET_SD_AZIMUTH_130 : 170|6@0+ (0.001745329,0) [0|0.104719755] "rad"  IFV
 SG_ CAN_FR_DET_ELEVATION_130 : 180|7@0+ (0.157449,-9.99812) [-9.99812|9.997903] "deg"  IFV
 SG_ CAN_FR_DET_SD_ELEVATION_130 : 189|6@0+ (0.003490659,0) [0|0.20943951] "rad"  IFV
 SG_ CAN_FR_DET_AMPLITUDE_130 : 199|7@0+ (1,-64) [-64|63] "dBsm"  IFV
 SG_ CAN_FR_DET_VALID_FLAG_130 : 192|1@0+ (1,0) [0|1] ""  IFV
 SG_ CAN_FR_DET_SUPER_RES_130 : 200|1@0+ (1,0) [0|1] ""  IFV
 SG_ CAN_FR_DET_LOW_SNR_FLAG_130 : 201|1@0+ (1,0) [0|1] ""  IFV
 SG_ CAN_FR_DET_MIXER_BIAS_FLAG_130 : 202|1@0+ (1,0) [0|1] ""  IFV
 SG_ CAN_FR_DET_RESERVED_FLAGS_130 : 207|5@0+ (1,0) [0|31] ""  IFV
 SG_ CAN_FR_DET_SNR_130 : 215|8@0+ (0.35156,0) [0|89.6478] "dB"  IFV
 SG_ CAN_FR_DET_MULTI_TARGET_PROB_130 : 219|4@0+ (0.06667,0) [0|1] ""  IFV
 SG_ CAN_FR_DET_CONFID_AZIMUTH_130 : 221|2@0+ (1,0) [0|3] ""  IFV
 SG_ CAN_FR_DET_CONFID_ELEVATION_130 : 223|2@0+ (1,0) [0|3] ""  IFV
 SG_ CAN_FR_DET_EXISTENCE_PROB_130 : 227|4@0+ (1,0) [0|15] ""  IFV
 SG_ CAN_FR_DET_CLASS_130 : 231|4@0+ (1,0) [0|15] ""  IFV
 SG_ CAN_FR_DET_RANGE_131 : 247|14@0+ (0.015625,0) [0|255.984375] "m"  IFV
 SG_ CAN_FR_DET_SD_RANGE_131 : 249|6@0+ (0.025,0) [0|1.5] "m"  IFV
 SG_ CAN_FR_DET_RANGE_RATE_131 : 259|14@0+ (0.015625,-128) [-128|127.984375] "m/s"  IFV
 SG_ CAN_FR_DET_SD_RANGE_RATE_131 : 277|6@0+ (0.02,0) [0|1.2] "m/s"  IFV
 SG_ CAN_FR_DET_AZIMUTH_131 : 287|13@0+ (0.0007668,-3.141593) [-3.141593|3.141593] "rad"  IFV
 SG_ CAN_FR_DET_SD_AZIMUTH_131 : 290|6@0+ (0.001745329,0) [0|0.104719755] "rad"  IFV
 SG_ CAN_FR_DET_ELEVATION_131 : 300|7@0+ (0.157449,-9.99812) [-9.99812|9.997903] "deg"  IFV
 SG_ CAN_FR_DET_SD_ELEVATION_131 : 309|6@0+ (0.003490659,0) [0|0.20943951] "rad"  IFV
 SG_ CAN_FR_DET_AMPLITUDE_131 : 319|7@0+ (1,-64) [-64|63] "dBsm"  IFV
 SG_ CAN_FR_DET_VALID_FLAG_131 : 312|1@0+ (1,0) [0|1] ""  IFV
 SG_ CAN_FR_DET_SUPER_RES_131 : 320|1@0+ (1,0) [0|1] ""  IFV
 SG_ CAN_FR_DET_LOW_SNR_FLAG_131 : 321|1@0+ (1,0) [0|1] ""  IFV
 SG_ CAN_FR_DET_MIXER_BIAS_FLAG_131 : 322|1@0+ (1,0) [0|1] ""  IFV
 SG_ CAN_FR_DET_RESERVED_FLAGS_131 : 327|5@0+ (1,0) [0|31] ""  IFV
 SG_ CAN_FR_DET_SNR_131 : 335|8@0+ (0.35156,0) [0|89.6478] "dB"  IFV
 SG_ CAN_FR_DET_MULTI_TARGET_PROB_131 : 339|4@0+ (0.06667,0) [0|1] ""  IFV
 SG_ CAN_FR_DET_CONFID_AZIMUTH_131 : 341|2@0+ (1,0) [0|3] ""  IFV
 SG_ CAN_FR_DET_CONFID_ELEVATION_131 : 343|2@0+ (1,0) [0|3] ""  IFV
 SG_ CAN_FR_DET_EXISTENCE_PROB_131 : 347|4@0+ (1,0) [0|15] ""  IFV
 SG_ CAN_FR_DET_CLASS_131 : 351|4@0+ (1,0) [0|15] ""  IFV
 SG_ CAN_FR_DET_RANGE_132 : 367|14@0+ (0.015625,0) [0|255.984375] "m"  IFV
 SG_ CAN_FR_DET_SD_RANGE_132 : 369|6@0+ (0.025,0) [0|1.5] "m"  IFV
 SG_ CAN_FR_DET_RANGE_RATE_132 : 379|14@0+ (0.015625,-128) [-128|127.984375] "m/s"  IFV
 SG_ CAN_FR_DET_SD_RANGE_RATE_132 : 397|6@0+ (0.02,0) [0|1.2] "m/s"  IFV
 SG_ CAN_FR_DET_AZIMUTH_132 : 407|13@0+ (0.0007668,-3.141593) [-3.141593|3.141593] "rad"  IFV
 SG_ CAN_FR_DET_SD_AZIMUTH_132 : 410|6@0+ (0.001745329,0) [0|0.104719755] "rad"  IFV
 SG_ CAN_FR_DET_ELEVATION_132 : 420|7@0+ (0.157449,-9.99812) [-9.99812|9.997903] "deg"  IFV
 SG_ CAN_FR_DET_SD_ELEVATION_132 : 429|6@0+ (0.003490659,0) [0|0.20943951] "rad"  IFV
 SG_ CAN_FR_DET_AMPLITUDE_132 : 439|7@0+ (1,-64) [-64|63] "dBsm"  IFV
 SG_ CAN_FR_DET_VALID_FLAG_132 : 432|1@0+ (1,0) [0|1] ""  IFV
 SG_ CAN_FR_DET_SUPER_RES_132 : 440|1@0+ (1,0) [0|1] ""  IFV
 SG_ CAN_FR_DET_LOW_SNR_FLAG_132 : 441|1@0+ (1,0) [0|1] ""  IFV
 SG_ CAN_FR_DET_MIXER_BIAS_FLAG_132 : 442|1@0+ (1,0) [0|1] ""  IFV
 SG_ CAN_FR_DET_RESERVED_FLAGS_132 : 447|5@0+ (1,0) [0|31] ""  IFV
 SG_ CAN_FR_DET_SNR_132 : 455|8@0+ (0.35156,0) [0|89.6478] "dB"  IFV
 SG_ CAN_FR_DET_MULTI_TARGET_PROB_132 : 459|4@0+ (0.06667,0) [0|1] ""  IFV
 SG_ CAN_FR_DET_CONFID_AZIMUTH_132 : 461|2@0+ (1,0) [0|3] ""  IFV
 SG_ CAN_FR_DET_CONFID_ELEVATION_132 : 463|2@0+ (1,0) [0|3] ""  IFV
 SG_ CAN_FR_DET_EXISTENCE_PROB_132 : 467|4@0+ (1,0) [0|15] ""  IFV
 SG_ CAN_FR_DET_CLASS_132 : 471|4@0+ (1,0) [0|15] ""  IFV

BO_ 1057 SODFR_DETECTION_133_136: 64 SODFR
 SG_ CAN_FR_DET_RANGE_133 : 7|14@0+ (0.015625,0) [0|255.984375] "m"  IFV
 SG_ CAN_FR_DET_SD_RANGE_133 : 9|6@0+ (0.025,0) [0|1.5] "m"  IFV
 SG_ CAN_FR_DET_RANGE_RATE_133 : 19|14@0+ (0.015625,-128) [-128|127.984375] "m/s"  IFV
 SG_ CAN_FR_DET_SD_RANGE_RATE_133 : 37|6@0+ (0.02,0) [0|1.2] "m/s"  IFV
 SG_ CAN_FR_DET_AZIMUTH_133 : 47|13@0+ (0.0007668,-3.141593) [-3.141593|3.141593] "rad"  IFV
 SG_ CAN_FR_DET_SD_AZIMUTH_133 : 50|6@0+ (0.001745329,0) [0|0.104719755] "rad"  IFV
 SG_ CAN_FR_DET_ELEVATION_133 : 60|7@0+ (0.157449,-9.99812) [-9.99812|9.997903] "deg"  IFV
 SG_ CAN_FR_DET_SD_ELEVATION_133 : 69|6@0+ (0.003490659,0) [0|0.20943951] "rad"  IFV
 SG_ CAN_FR_DET_AMPLITUDE_133 : 79|7@0+ (1,-64) [-64|63] "dBsm"  IFV
 SG_ CAN_FR_DET_VALID_FLAG_133 : 72|1@0+ (1,0) [0|1] ""  IFV
 SG_ CAN_FR_DET_SUPER_RES_133 : 80|1@0+ (1,0) [0|1] ""  IFV
 SG_ CAN_FR_DET_LOW_SNR_FLAG_133 : 81|1@0+ (1,0) [0|1] ""  IFV
 SG_ CAN_FR_DET_MIXER_BIAS_FLAG_133 : 82|1@0+ (1,0) [0|1] ""  IFV
 SG_ CAN_FR_DET_RESERVED_FLAGS_133 : 87|5@0+ (1,0) [0|31] ""  IFV
 SG_ CAN_FR_DET_SNR_133 : 95|8@0+ (0.35156,0) [0|89.6478] "dB"  IFV
 SG_ CAN_FR_DET_MULTI_TARGET_PROB_133 : 99|4@0+ (0.06667,0) [0|1] ""  IFV
 SG_ CAN_FR_DET_CONFID_AZIMUTH_133 : 101|2@0+ (1,0) [0|3] ""  IFV
 SG_ CAN_FR_DET_CONFID_ELEVATION_133 : 103|2@0+ (1,0) [0|3] ""  IFV
 SG_ CAN_FR_DET_EXISTENCE_PROB_133 : 107|4@0+ (1,0) [0|15] ""  IFV
 SG_ CAN_FR_DET_CLASS_133 : 111|4@0+ (1,0) [0|15] ""  IFV
 SG_ CAN_FR_DET_RANGE_134 : 127|14@0+ (0.015625,0) [0|255.984375] "m"  IFV
 SG_ CAN_FR_DET_SD_RANGE_134 : 129|6@0+ (0.025,0) [0|1.5] "m"  IFV
 SG_ CAN_FR_DET_RANGE_RATE_134 : 139|14@0+ (0.015625,-128) [-128|127.984375] "m/s"  IFV
 SG_ CAN_FR_DET_SD_RANGE_RATE_134 : 157|6@0+ (0.02,0) [0|1.2] "m/s"  IFV
 SG_ CAN_FR_DET_AZIMUTH_134 : 167|13@0+ (0.0007668,-3.141593) [-3.141593|3.141593] "rad"  IFV
 SG_ CAN_FR_DET_SD_AZIMUTH_134 : 170|6@0+ (0.001745329,0) [0|0.104719755] "rad"  IFV
 SG_ CAN_FR_DET_ELEVATION_134 : 180|7@0+ (0.157449,-9.99812) [-9.99812|9.997903] "deg"  IFV
 SG_ CAN_FR_DET_SD_ELEVATION_134 : 189|6@0+ (0.003490659,0) [0|0.20943951] "rad"  IFV
 SG_ CAN_FR_DET_AMPLITUDE_134 : 199|7@0+ (1,-64) [-64|63] "dBsm"  IFV
 SG_ CAN_FR_DET_VALID_FLAG_134 : 192|1@0+ (1,0) [0|1] ""  IFV
 SG_ CAN_FR_DET_SUPER_RES_134 : 200|1@0+ (1,0) [0|1] ""  IFV
 SG_ CAN_FR_DET_LOW_SNR_FLAG_134 : 201|1@0+ (1,0) [0|1] ""  IFV
 SG_ CAN_FR_DET_MIXER_BIAS_FLAG_134 : 202|1@0+ (1,0) [0|1] ""  IFV
 SG_ CAN_FR_DET_RESERVED_FLAGS_134 : 207|5@0+ (1,0) [0|31] ""  IFV
 SG_ CAN_FR_DET_SNR_134 : 215|8@0+ (0.35156,0) [0|89.6478] "dB"  IFV
 SG_ CAN_FR_DET_MULTI_TARGET_PROB_134 : 219|4@0+ (0.06667,0) [0|1] ""  IFV
 SG_ CAN_FR_DET_CONFID_AZIMUTH_134 : 221|2@0+ (1,0) [0|3] ""  IFV
 SG_ CAN_FR_DET_CONFID_ELEVATION_134 : 223|2@0+ (1,0) [0|3] ""  IFV
 SG_ CAN_FR_DET_EXISTENCE_PROB_134 : 227|4@0+ (1,0) [0|15] ""  IFV
 SG_ CAN_FR_DET_CLASS_134 : 231|4@0+ (1,0) [0|15] ""  IFV
 SG_ CAN_FR_DET_RANGE_135 : 247|14@0+ (0.015625,0) [0|255.984375] "m"  IFV
 SG_ CAN_FR_DET_SD_RANGE_135 : 249|6@0+ (0.025,0) [0|1.5] "m"  IFV
 SG_ CAN_FR_DET_RANGE_RATE_135 : 259|14@0+ (0.015625,-128) [-128|127.984375] "m/s"  IFV
 SG_ CAN_FR_DET_SD_RANGE_RATE_135 : 277|6@0+ (0.02,0) [0|1.2] "m/s"  IFV
 SG_ CAN_FR_DET_AZIMUTH_135 : 287|13@0+ (0.0007668,-3.141593) [-3.141593|3.141593] "rad"  IFV
 SG_ CAN_FR_DET_SD_AZIMUTH_135 : 290|6@0+ (0.001745329,0) [0|0.104719755] "rad"  IFV
 SG_ CAN_FR_DET_ELEVATION_135 : 300|7@0+ (0.157449,-9.99812) [-9.99812|9.997903] "deg"  IFV
 SG_ CAN_FR_DET_SD_ELEVATION_135 : 309|6@0+ (0.003490659,0) [0|0.20943951] "rad"  IFV
 SG_ CAN_FR_DET_AMPLITUDE_135 : 319|7@0+ (1,-64) [-64|63] "dBsm"  IFV
 SG_ CAN_FR_DET_VALID_FLAG_135 : 312|1@0+ (1,0) [0|1] ""  IFV
 SG_ CAN_FR_DET_SUPER_RES_135 : 320|1@0+ (1,0) [0|1] ""  IFV
 SG_ CAN_FR_DET_LOW_SNR_FLAG_135 : 321|1@0+ (1,0) [0|1] ""  IFV
 SG_ CAN_FR_DET_MIXER_BIAS_FLAG_135 : 322|1@0+ (1,0) [0|1] ""  IFV
 SG_ CAN_FR_DET_RESERVED_FLAGS_135 : 327|5@0+ (1,0) [0|31] ""  IFV
 SG_ CAN_FR_DET_SNR_135 : 335|8@0+ (0.35156,0) [0|89.6478] "dB"  IFV
 SG_ CAN_FR_DET_MULTI_TARGET_PROB_135 : 339|4@0+ (0.06667,0) [0|1] ""  IFV
 SG_ CAN_FR_DET_CONFID_AZIMUTH_135 : 341|2@0+ (1,0) [0|3] ""  IFV
 SG_ CAN_FR_DET_CONFID_ELEVATION_135 : 343|2@0+ (1,0) [0|3] ""  IFV
 SG_ CAN_FR_DET_EXISTENCE_PROB_135 : 347|4@0+ (1,0) [0|15] ""  IFV
 SG_ CAN_FR_DET_CLASS_135 : 351|4@0+ (1,0) [0|15] ""  IFV
 SG_ CAN_FR_DET_RANGE_136 : 367|14@0+ (0.015625,0) [0|255.984375] "m"  IFV
 SG_ CAN_FR_DET_SD_RANGE_136 : 369|6@0+ (0.025,0) [0|1.5] "m"  IFV
 SG_ CAN_FR_DET_RANGE_RATE_136 : 379|14@0+ (0.015625,-128) [-128|127.984375] "m/s"  IFV
 SG_ CAN_FR_DET_SD_RANGE_RATE_136 : 397|6@0+ (0.02,0) [0|1.2] "m/s"  IFV
 SG_ CAN_FR_DET_AZIMUTH_136 : 407|13@0+ (0.0007668,-3.141593) [-3.141593|3.141593] "rad"  IFV
 SG_ CAN_FR_DET_SD_AZIMUTH_136 : 410|6@0+ (0.001745329,0) [0|0.104719755] "rad"  IFV
 SG_ CAN_FR_DET_ELEVATION_136 : 420|7@0+ (0.157449,-9.99812) [-9.99812|9.997903] "deg"  IFV
 SG_ CAN_FR_DET_SD_ELEVATION_136 : 429|6@0+ (0.003490659,0) [0|0.20943951] "rad"  IFV
 SG_ CAN_FR_DET_AMPLITUDE_136 : 439|7@0+ (1,-64) [-64|63] "dBsm"  IFV
 SG_ CAN_FR_DET_VALID_FLAG_136 : 432|1@0+ (1,0) [0|1] ""  IFV
 SG_ CAN_FR_DET_SUPER_RES_136 : 440|1@0+ (1,0) [0|1] ""  IFV
 SG_ CAN_FR_DET_LOW_SNR_FLAG_136 : 441|1@0+ (1,0) [0|1] ""  IFV
 SG_ CAN_FR_DET_MIXER_BIAS_FLAG_136 : 442|1@0+ (1,0) [0|1] ""  IFV
 SG_ CAN_FR_DET_RESERVED_FLAGS_136 : 447|5@0+ (1,0) [0|31] ""  IFV
 SG_ CAN_FR_DET_SNR_136 : 455|8@0+ (0.35156,0) [0|89.6478] "dB"  IFV
 SG_ CAN_FR_DET_MULTI_TARGET_PROB_136 : 459|4@0+ (0.06667,0) [0|1] ""  IFV
 SG_ CAN_FR_DET_CONFID_AZIMUTH_136 : 461|2@0+ (1,0) [0|3] ""  IFV
 SG_ CAN_FR_DET_CONFID_ELEVATION_136 : 463|2@0+ (1,0) [0|3] ""  IFV
 SG_ CAN_FR_DET_EXISTENCE_PROB_136 : 467|4@0+ (1,0) [0|15] ""  IFV
 SG_ CAN_FR_DET_CLASS_136 : 471|4@0+ (1,0) [0|15] ""  IFV

BO_ 1058 SODFR_DETECTION_137_140: 64 SODFR
 SG_ CAN_FR_DET_RANGE_137 : 7|14@0+ (0.015625,0) [0|255.984375] "m"  IFV
 SG_ CAN_FR_DET_SD_RANGE_137 : 9|6@0+ (0.025,0) [0|1.5] "m"  IFV
 SG_ CAN_FR_DET_RANGE_RATE_137 : 19|14@0+ (0.015625,-128) [-128|127.984375] "m/s"  IFV
 SG_ CAN_FR_DET_SD_RANGE_RATE_137 : 37|6@0+ (0.02,0) [0|1.2] "m/s"  IFV
 SG_ CAN_FR_DET_AZIMUTH_137 : 47|13@0+ (0.0007668,-3.141593) [-3.141593|3.141593] "rad"  IFV
 SG_ CAN_FR_DET_SD_AZIMUTH_137 : 50|6@0+ (0.001745329,0) [0|0.104719755] "rad"  IFV
 SG_ CAN_FR_DET_ELEVATION_137 : 60|7@0+ (0.157449,-9.99812) [-9.99812|9.997903] "deg"  IFV
 SG_ CAN_FR_DET_SD_ELEVATION_137 : 69|6@0+ (0.003490659,0) [0|0.20943951] "rad"  IFV
 SG_ CAN_FR_DET_AMPLITUDE_137 : 79|7@0+ (1,-64) [-64|63] "dBsm"  IFV
 SG_ CAN_FR_DET_VALID_FLAG_137 : 72|1@0+ (1,0) [0|1] ""  IFV
 SG_ CAN_FR_DET_SUPER_RES_137 : 80|1@0+ (1,0) [0|1] ""  IFV
 SG_ CAN_FR_DET_LOW_SNR_FLAG_137 : 81|1@0+ (1,0) [0|1] ""  IFV
 SG_ CAN_FR_DET_MIXER_BIAS_FLAG_137 : 82|1@0+ (1,0) [0|1] ""  IFV
 SG_ CAN_FR_DET_RESERVED_FLAGS_137 : 87|5@0+ (1,0) [0|31] ""  IFV
 SG_ CAN_FR_DET_SNR_137 : 95|8@0+ (0.35156,0) [0|89.6478] "dB"  IFV
 SG_ CAN_FR_DET_MULTI_TARGET_PROB_137 : 99|4@0+ (0.06667,0) [0|1] ""  IFV
 SG_ CAN_FR_DET_CONFID_AZIMUTH_137 : 101|2@0+ (1,0) [0|3] ""  IFV
 SG_ CAN_FR_DET_CONFID_ELEVATION_137 : 103|2@0+ (1,0) [0|3] ""  IFV
 SG_ CAN_FR_DET_EXISTENCE_PROB_137 : 107|4@0+ (1,0) [0|15] ""  IFV
 SG_ CAN_FR_DET_CLASS_137 : 111|4@0+ (1,0) [0|15] ""  IFV
 SG_ CAN_FR_DET_RANGE_138 : 127|14@0+ (0.015625,0) [0|255.984375] "m"  IFV
 SG_ CAN_FR_DET_SD_RANGE_138 : 129|6@0+ (0.025,0) [0|1.5] "m"  IFV
 SG_ CAN_FR_DET_RANGE_RATE_138 : 139|14@0+ (0.015625,-128) [-128|127.984375] "m/s"  IFV
 SG_ CAN_FR_DET_SD_RANGE_RATE_138 : 157|6@0+ (0.02,0) [0|1.2] "m/s"  IFV
 SG_ CAN_FR_DET_AZIMUTH_138 : 167|13@0+ (0.0007668,-3.141593) [-3.141593|3.141593] "rad"  IFV
 SG_ CAN_FR_DET_SD_AZIMUTH_138 : 170|6@0+ (0.001745329,0) [0|0.104719755] "rad"  IFV
 SG_ CAN_FR_DET_ELEVATION_138 : 180|7@0+ (0.157449,-9.99812) [-9.99812|9.997903] "deg"  IFV
 SG_ CAN_FR_DET_SD_ELEVATION_138 : 189|6@0+ (0.003490659,0) [0|0.20943951] "rad"  IFV
 SG_ CAN_FR_DET_AMPLITUDE_138 : 199|7@0+ (1,-64) [-64|63] "dBsm"  IFV
 SG_ CAN_FR_DET_VALID_FLAG_138 : 192|1@0+ (1,0) [0|1] ""  IFV
 SG_ CAN_FR_DET_SUPER_RES_138 : 200|1@0+ (1,0) [0|1] ""  IFV
 SG_ CAN_FR_DET_LOW_SNR_FLAG_138 : 201|1@0+ (1,0) [0|1] ""  IFV
 SG_ CAN_FR_DET_MIXER_BIAS_FLAG_138 : 202|1@0+ (1,0) [0|1] ""  IFV
 SG_ CAN_FR_DET_RESERVED_FLAGS_138 : 207|5@0+ (1,0) [0|31] ""  IFV
 SG_ CAN_FR_DET_SNR_138 : 215|8@0+ (0.35156,0) [0|89.6478] "dB"  IFV
 SG_ CAN_FR_DET_MULTI_TARGET_PROB_138 : 219|4@0+ (0.06667,0) [0|1] ""  IFV
 SG_ CAN_FR_DET_CONFID_AZIMUTH_138 : 221|2@0+ (1,0) [0|3] ""  IFV
 SG_ CAN_FR_DET_CONFID_ELEVATION_138 : 223|2@0+ (1,0) [0|3] ""  IFV
 SG_ CAN_FR_DET_EXISTENCE_PROB_138 : 227|4@0+ (1,0) [0|15] ""  IFV
 SG_ CAN_FR_DET_CLASS_138 : 231|4@0+ (1,0) [0|15] ""  IFV
 SG_ CAN_FR_DET_RANGE_139 : 247|14@0+ (0.015625,0) [0|255.984375] "m"  IFV
 SG_ CAN_FR_DET_SD_RANGE_139 : 249|6@0+ (0.025,0) [0|1.5] "m"  IFV
 SG_ CAN_FR_DET_RANGE_RATE_139 : 259|14@0+ (0.015625,-128) [-128|127.984375] "m/s"  IFV
 SG_ CAN_FR_DET_SD_RANGE_RATE_139 : 277|6@0+ (0.02,0) [0|1.2] "m/s"  IFV
 SG_ CAN_FR_DET_AZIMUTH_139 : 287|13@0+ (0.0007668,-3.141593) [-3.141593|3.141593] "rad"  IFV
 SG_ CAN_FR_DET_SD_AZIMUTH_139 : 290|6@0+ (0.001745329,0) [0|0.104719755] "rad"  IFV
 SG_ CAN_FR_DET_ELEVATION_139 : 300|7@0+ (0.157449,-9.99812) [-9.99812|9.997903] "deg"  IFV
 SG_ CAN_FR_DET_SD_ELEVATION_139 : 309|6@0+ (0.003490659,0) [0|0.20943951] "rad"  IFV
 SG_ CAN_FR_DET_AMPLITUDE_139 : 319|7@0+ (1,-64) [-64|63] "dBsm"  IFV
 SG_ CAN_FR_DET_VALID_FLAG_139 : 312|1@0+ (1,0) [0|1] ""  IFV
 SG_ CAN_FR_DET_SUPER_RES_139 : 320|1@0+ (1,0) [0|1] ""  IFV
 SG_ CAN_FR_DET_LOW_SNR_FLAG_139 : 321|1@0+ (1,0) [0|1] ""  IFV
 SG_ CAN_FR_DET_MIXER_BIAS_FLAG_139 : 322|1@0+ (1,0) [0|1] ""  IFV
 SG_ CAN_FR_DET_RESERVED_FLAGS_139 : 327|5@0+ (1,0) [0|31] ""  IFV
 SG_ CAN_FR_DET_SNR_139 : 335|8@0+ (0.35156,0) [0|89.6478] "dB"  IFV
 SG_ CAN_FR_DET_MULTI_TARGET_PROB_139 : 339|4@0+ (0.06667,0) [0|1] ""  IFV
 SG_ CAN_FR_DET_CONFID_AZIMUTH_139 : 341|2@0+ (1,0) [0|3] ""  IFV
 SG_ CAN_FR_DET_CONFID_ELEVATION_139 : 343|2@0+ (1,0) [0|3] ""  IFV
 SG_ CAN_FR_DET_EXISTENCE_PROB_139 : 347|4@0+ (1,0) [0|15] ""  IFV
 SG_ CAN_FR_DET_CLASS_139 : 351|4@0+ (1,0) [0|15] ""  IFV
 SG_ CAN_FR_DET_RANGE_140 : 367|14@0+ (0.015625,0) [0|255.984375] "m"  IFV
 SG_ CAN_FR_DET_SD_RANGE_140 : 369|6@0+ (0.025,0) [0|1.5] "m"  IFV
 SG_ CAN_FR_DET_RANGE_RATE_140 : 379|14@0+ (0.015625,-128) [-128|127.984375] "m/s"  IFV
 SG_ CAN_FR_DET_SD_RANGE_RATE_140 : 397|6@0+ (0.02,0) [0|1.2] "m/s"  IFV
 SG_ CAN_FR_DET_AZIMUTH_140 : 407|13@0+ (0.0007668,-3.141593) [-3.141593|3.141593] "rad"  IFV
 SG_ CAN_FR_DET_SD_AZIMUTH_140 : 410|6@0+ (0.001745329,0) [0|0.104719755] "rad"  IFV
 SG_ CAN_FR_DET_ELEVATION_140 : 420|7@0+ (0.157449,-9.99812) [-9.99812|9.997903] "deg"  IFV
 SG_ CAN_FR_DET_SD_ELEVATION_140 : 429|6@0+ (0.003490659,0) [0|0.20943951] "rad"  IFV
 SG_ CAN_FR_DET_AMPLITUDE_140 : 439|7@0+ (1,-64) [-64|63] "dBsm"  IFV
 SG_ CAN_FR_DET_VALID_FLAG_140 : 432|1@0+ (1,0) [0|1] ""  IFV
 SG_ CAN_FR_DET_SUPER_RES_140 : 440|1@0+ (1,0) [0|1] ""  IFV
 SG_ CAN_FR_DET_LOW_SNR_FLAG_140 : 441|1@0+ (1,0) [0|1] ""  IFV
 SG_ CAN_FR_DET_MIXER_BIAS_FLAG_140 : 442|1@0+ (1,0) [0|1] ""  IFV
 SG_ CAN_FR_DET_RESERVED_FLAGS_140 : 447|5@0+ (1,0) [0|31] ""  IFV
 SG_ CAN_FR_DET_SNR_140 : 455|8@0+ (0.35156,0) [0|89.6478] "dB"  IFV
 SG_ CAN_FR_DET_MULTI_TARGET_PROB_140 : 459|4@0+ (0.06667,0) [0|1] ""  IFV
 SG_ CAN_FR_DET_CONFID_AZIMUTH_140 : 461|2@0+ (1,0) [0|3] ""  IFV
 SG_ CAN_FR_DET_CONFID_ELEVATION_140 : 463|2@0+ (1,0) [0|3] ""  IFV
 SG_ CAN_FR_DET_EXISTENCE_PROB_140 : 467|4@0+ (1,0) [0|15] ""  IFV
 SG_ CAN_FR_DET_CLASS_140 : 471|4@0+ (1,0) [0|15] ""  IFV

BO_ 1059 SODFR_DETECTION_141_144: 64 SODFR
 SG_ CAN_FR_DET_RANGE_141 : 7|14@0+ (0.015625,0) [0|255.984375] "m"  IFV
 SG_ CAN_FR_DET_SD_RANGE_141 : 9|6@0+ (0.025,0) [0|1.5] "m"  IFV
 SG_ CAN_FR_DET_RANGE_RATE_141 : 19|14@0+ (0.015625,-128) [-128|127.984375] "m/s"  IFV
 SG_ CAN_FR_DET_SD_RANGE_RATE_141 : 37|6@0+ (0.02,0) [0|1.2] "m/s"  IFV
 SG_ CAN_FR_DET_AZIMUTH_141 : 47|13@0+ (0.0007668,-3.141593) [-3.141593|3.141593] "rad"  IFV
 SG_ CAN_FR_DET_SD_AZIMUTH_141 : 50|6@0+ (0.001745329,0) [0|0.104719755] "rad"  IFV
 SG_ CAN_FR_DET_ELEVATION_141 : 60|7@0+ (0.157449,-9.99812) [-9.99812|9.997903] "deg"  IFV
 SG_ CAN_FR_DET_SD_ELEVATION_141 : 69|6@0+ (0.003490659,0) [0|0.20943951] "rad"  IFV
 SG_ CAN_FR_DET_AMPLITUDE_141 : 79|7@0+ (1,-64) [-64|63] "dBsm"  IFV
 SG_ CAN_FR_DET_VALID_FLAG_141 : 72|1@0+ (1,0) [0|1] ""  IFV
 SG_ CAN_FR_DET_SUPER_RES_141 : 80|1@0+ (1,0) [0|1] ""  IFV
 SG_ CAN_FR_DET_LOW_SNR_FLAG_141 : 81|1@0+ (1,0) [0|1] ""  IFV
 SG_ CAN_FR_DET_MIXER_BIAS_FLAG_141 : 82|1@0+ (1,0) [0|1] ""  IFV
 SG_ CAN_FR_DET_RESERVED_FLAGS_141 : 87|5@0+ (1,0) [0|31] ""  IFV
 SG_ CAN_FR_DET_SNR_141 : 95|8@0+ (0.35156,0) [0|89.6478] "dB"  IFV
 SG_ CAN_FR_DET_MULTI_TARGET_PROB_141 : 99|4@0+ (0.06667,0) [0|1] ""  IFV
 SG_ CAN_FR_DET_CONFID_AZIMUTH_141 : 101|2@0+ (1,0) [0|3] ""  IFV
 SG_ CAN_FR_DET_CONFID_ELEVATION_141 : 103|2@0+ (1,0) [0|3] ""  IFV
 SG_ CAN_FR_DET_EXISTENCE_PROB_141 : 107|4@0+ (1,0) [0|15] ""  IFV
 SG_ CAN_FR_DET_CLASS_141 : 111|4@0+ (1,0) [0|15] ""  IFV
 SG_ CAN_FR_DET_RANGE_142 : 127|14@0+ (0.015625,0) [0|255.984375] "m"  IFV
 SG_ CAN_FR_DET_SD_RANGE_142 : 129|6@0+ (0.025,0) [0|1.5] "m"  IFV
 SG_ CAN_FR_DET_RANGE_RATE_142 : 139|14@0+ (0.015625,-128) [-128|127.984375] "m/s"  IFV
 SG_ CAN_FR_DET_SD_RANGE_RATE_142 : 157|6@0+ (0.02,0) [0|1.2] "m/s"  IFV
 SG_ CAN_FR_DET_AZIMUTH_142 : 167|13@0+ (0.0007668,-3.141593) [-3.141593|3.141593] "rad"  IFV
 SG_ CAN_FR_DET_SD_AZIMUTH_142 : 170|6@0+ (0.001745329,0) [0|0.104719755] "rad"  IFV
 SG_ CAN_FR_DET_ELEVATION_142 : 180|7@0+ (0.157449,-9.99812) [-9.99812|9.997903] "deg"  IFV
 SG_ CAN_FR_DET_SD_ELEVATION_142 : 189|6@0+ (0.003490659,0) [0|0.20943951] "rad"  IFV
 SG_ CAN_FR_DET_AMPLITUDE_142 : 199|7@0+ (1,-64) [-64|63] "dBsm"  IFV
 SG_ CAN_FR_DET_VALID_FLAG_142 : 192|1@0+ (1,0) [0|1] ""  IFV
 SG_ CAN_FR_DET_SUPER_RES_142 : 200|1@0+ (1,0) [0|1] ""  IFV
 SG_ CAN_FR_DET_LOW_SNR_FLAG_142 : 201|1@0+ (1,0) [0|1] ""  IFV
 SG_ CAN_FR_DET_MIXER_BIAS_FLAG_142 : 202|1@0+ (1,0) [0|1] ""  IFV
 SG_ CAN_FR_DET_RESERVED_FLAGS_142 : 207|5@0+ (1,0) [0|31] ""  IFV
 SG_ CAN_FR_DET_SNR_142 : 215|8@0+ (0.35156,0) [0|89.6478] "dB"  IFV
 SG_ CAN_FR_DET_MULTI_TARGET_PROB_142 : 219|4@0+ (0.06667,0) [0|1] ""  IFV
 SG_ CAN_FR_DET_CONFID_AZIMUTH_142 : 221|2@0+ (1,0) [0|3] ""  IFV
 SG_ CAN_FR_DET_CONFID_ELEVATION_142 : 223|2@0+ (1,0) [0|3] ""  IFV
 SG_ CAN_FR_DET_EXISTENCE_PROB_142 : 227|4@0+ (1,0) [0|15] ""  IFV
 SG_ CAN_FR_DET_CLASS_142 : 231|4@0+ (1,0) [0|15] ""  IFV
 SG_ CAN_FR_DET_RANGE_143 : 247|14@0+ (0.015625,0) [0|255.984375] "m"  IFV
 SG_ CAN_FR_DET_SD_RANGE_143 : 249|6@0+ (0.025,0) [0|1.5] "m"  IFV
 SG_ CAN_FR_DET_RANGE_RATE_143 : 259|14@0+ (0.015625,-128) [-128|127.984375] "m/s"  IFV
 SG_ CAN_FR_DET_SD_RANGE_RATE_143 : 277|6@0+ (0.02,0) [0|1.2] "m/s"  IFV
 SG_ CAN_FR_DET_AZIMUTH_143 : 287|13@0+ (0.0007668,-3.141593) [-3.141593|3.141593] "rad"  IFV
 SG_ CAN_FR_DET_SD_AZIMUTH_143 : 290|6@0+ (0.001745329,0) [0|0.104719755] "rad"  IFV
 SG_ CAN_FR_DET_ELEVATION_143 : 300|7@0+ (0.157449,-9.99812) [-9.99812|9.997903] "deg"  IFV
 SG_ CAN_FR_DET_SD_ELEVATION_143 : 309|6@0+ (0.003490659,0) [0|0.20943951] "rad"  IFV
 SG_ CAN_FR_DET_AMPLITUDE_143 : 319|7@0+ (1,-64) [-64|63] "dBsm"  IFV
 SG_ CAN_FR_DET_VALID_FLAG_143 : 312|1@0+ (1,0) [0|1] ""  IFV
 SG_ CAN_FR_DET_SUPER_RES_143 : 320|1@0+ (1,0) [0|1] ""  IFV
 SG_ CAN_FR_DET_LOW_SNR_FLAG_143 : 321|1@0+ (1,0) [0|1] ""  IFV
 SG_ CAN_FR_DET_MIXER_BIAS_FLAG_143 : 322|1@0+ (1,0) [0|1] ""  IFV
 SG_ CAN_FR_DET_RESERVED_FLAGS_143 : 327|5@0+ (1,0) [0|31] ""  IFV
 SG_ CAN_FR_DET_SNR_143 : 335|8@0+ (0.35156,0) [0|89.6478] "dB"  IFV
 SG_ CAN_FR_DET_MULTI_TARGET_PROB_143 : 339|4@0+ (0.06667,0) [0|1] ""  IFV
 SG_ CAN_FR_DET_CONFID_AZIMUTH_143 : 341|2@0+ (1,0) [0|3] ""  IFV
 SG_ CAN_FR_DET_CONFID_ELEVATION_143 : 343|2@0+ (1,0) [0|3] ""  IFV
 SG_ CAN_FR_DET_EXISTENCE_PROB_143 : 347|4@0+ (1,0) [0|15] ""  IFV
 SG_ CAN_FR_DET_CLASS_143 : 351|4@0+ (1,0) [0|15] ""  IFV
 SG_ CAN_FR_DET_RANGE_144 : 367|14@0+ (0.015625,0) [0|255.984375] "m"  IFV
 SG_ CAN_FR_DET_SD_RANGE_144 : 369|6@0+ (0.025,0) [0|1.5] "m"  IFV
 SG_ CAN_FR_DET_RANGE_RATE_144 : 379|14@0+ (0.015625,-128) [-128|127.984375] "m/s"  IFV
 SG_ CAN_FR_DET_SD_RANGE_RATE_144 : 397|6@0+ (0.02,0) [0|1.2] "m/s"  IFV
 SG_ CAN_FR_DET_AZIMUTH_144 : 407|13@0+ (0.0007668,-3.141593) [-3.141593|3.141593] "rad"  IFV
 SG_ CAN_FR_DET_SD_AZIMUTH_144 : 410|6@0+ (0.001745329,0) [0|0.104719755] "rad"  IFV
 SG_ CAN_FR_DET_ELEVATION_144 : 420|7@0+ (0.157449,-9.99812) [-9.99812|9.997903] "deg"  IFV
 SG_ CAN_FR_DET_SD_ELEVATION_144 : 429|6@0+ (0.003490659,0) [0|0.20943951] "rad"  IFV
 SG_ CAN_FR_DET_AMPLITUDE_144 : 439|7@0+ (1,-64) [-64|63] "dBsm"  IFV
 SG_ CAN_FR_DET_VALID_FLAG_144 : 432|1@0+ (1,0) [0|1] ""  IFV
 SG_ CAN_FR_DET_SUPER_RES_144 : 440|1@0+ (1,0) [0|1] ""  IFV
 SG_ CAN_FR_DET_LOW_SNR_FLAG_144 : 441|1@0+ (1,0) [0|1] ""  IFV
 SG_ CAN_FR_DET_MIXER_BIAS_FLAG_144 : 442|1@0+ (1,0) [0|1] ""  IFV
 SG_ CAN_FR_DET_RESERVED_FLAGS_144 : 447|5@0+ (1,0) [0|31] ""  IFV
 SG_ CAN_FR_DET_SNR_144 : 455|8@0+ (0.35156,0) [0|89.6478] "dB"  IFV
 SG_ CAN_FR_DET_MULTI_TARGET_PROB_144 : 459|4@0+ (0.06667,0) [0|1] ""  IFV
 SG_ CAN_FR_DET_CONFID_AZIMUTH_144 : 461|2@0+ (1,0) [0|3] ""  IFV
 SG_ CAN_FR_DET_CONFID_ELEVATION_144 : 463|2@0+ (1,0) [0|3] ""  IFV
 SG_ CAN_FR_DET_EXISTENCE_PROB_144 : 467|4@0+ (1,0) [0|15] ""  IFV
 SG_ CAN_FR_DET_CLASS_144 : 471|4@0+ (1,0) [0|15] ""  IFV

BO_ 1060 SODFR_DETECTION_145_148: 64 SODFR
 SG_ CAN_FR_DET_RANGE_145 : 7|14@0+ (0.015625,0) [0|255.984375] "m"  IFV
 SG_ CAN_FR_DET_SD_RANGE_145 : 9|6@0+ (0.025,0) [0|1.5] "m"  IFV
 SG_ CAN_FR_DET_RANGE_RATE_145 : 19|14@0+ (0.015625,-128) [-128|127.984375] "m/s"  IFV
 SG_ CAN_FR_DET_SD_RANGE_RATE_145 : 37|6@0+ (0.02,0) [0|1.2] "m/s"  IFV
 SG_ CAN_FR_DET_AZIMUTH_145 : 47|13@0+ (0.0007668,-3.141593) [-3.141593|3.141593] "rad"  IFV
 SG_ CAN_FR_DET_SD_AZIMUTH_145 : 50|6@0+ (0.001745329,0) [0|0.104719755] "rad"  IFV
 SG_ CAN_FR_DET_ELEVATION_145 : 60|7@0+ (0.157449,-9.99812) [-9.99812|9.997903] "deg"  IFV
 SG_ CAN_FR_DET_SD_ELEVATION_145 : 69|6@0+ (0.003490659,0) [0|0.20943951] "rad"  IFV
 SG_ CAN_FR_DET_AMPLITUDE_145 : 79|7@0+ (1,-64) [-64|63] "dBsm"  IFV
 SG_ CAN_FR_DET_VALID_FLAG_145 : 72|1@0+ (1,0) [0|1] ""  IFV
 SG_ CAN_FR_DET_SUPER_RES_145 : 80|1@0+ (1,0) [0|1] ""  IFV
 SG_ CAN_FR_DET_LOW_SNR_FLAG_145 : 81|1@0+ (1,0) [0|1] ""  IFV
 SG_ CAN_FR_DET_MIXER_BIAS_FLAG_145 : 82|1@0+ (1,0) [0|1] ""  IFV
 SG_ CAN_FR_DET_RESERVED_FLAGS_145 : 87|5@0+ (1,0) [0|31] ""  IFV
 SG_ CAN_FR_DET_SNR_145 : 95|8@0+ (0.35156,0) [0|89.6478] "dB"  IFV
 SG_ CAN_FR_DET_MULTI_TARGET_PROB_145 : 99|4@0+ (0.06667,0) [0|1] ""  IFV
 SG_ CAN_FR_DET_CONFID_AZIMUTH_145 : 101|2@0+ (1,0) [0|3] ""  IFV
 SG_ CAN_FR_DET_CONFID_ELEVATION_145 : 103|2@0+ (1,0) [0|3] ""  IFV
 SG_ CAN_FR_DET_EXISTENCE_PROB_145 : 107|4@0+ (1,0) [0|15] ""  IFV
 SG_ CAN_FR_DET_CLASS_145 : 111|4@0+ (1,0) [0|15] ""  IFV
 SG_ CAN_FR_DET_RANGE_146 : 127|14@0+ (0.015625,0) [0|255.984375] "m"  IFV
 SG_ CAN_FR_DET_SD_RANGE_146 : 129|6@0+ (0.025,0) [0|1.5] "m"  IFV
 SG_ CAN_FR_DET_RANGE_RATE_146 : 139|14@0+ (0.015625,-128) [-128|127.984375] "m/s"  IFV
 SG_ CAN_FR_DET_SD_RANGE_RATE_146 : 157|6@0+ (0.02,0) [0|1.2] "m/s"  IFV
 SG_ CAN_FR_DET_AZIMUTH_146 : 167|13@0+ (0.0007668,-3.141593) [-3.141593|3.141593] "rad"  IFV
 SG_ CAN_FR_DET_SD_AZIMUTH_146 : 170|6@0+ (0.001745329,0) [0|0.104719755] "rad"  IFV
 SG_ CAN_FR_DET_ELEVATION_146 : 180|7@0+ (0.157449,-9.99812) [-9.99812|9.997903] "deg"  IFV
 SG_ CAN_FR_DET_SD_ELEVATION_146 : 189|6@0+ (0.003490659,0) [0|0.20943951] "rad"  IFV
 SG_ CAN_FR_DET_AMPLITUDE_146 : 199|7@0+ (1,-64) [-64|63] "dBsm"  IFV
 SG_ CAN_FR_DET_VALID_FLAG_146 : 192|1@0+ (1,0) [0|1] ""  IFV
 SG_ CAN_FR_DET_SUPER_RES_146 : 200|1@0+ (1,0) [0|1] ""  IFV
 SG_ CAN_FR_DET_LOW_SNR_FLAG_146 : 201|1@0+ (1,0) [0|1] ""  IFV
 SG_ CAN_FR_DET_MIXER_BIAS_FLAG_146 : 202|1@0+ (1,0) [0|1] ""  IFV
 SG_ CAN_FR_DET_RESERVED_FLAGS_146 : 207|5@0+ (1,0) [0|31] ""  IFV
 SG_ CAN_FR_DET_SNR_146 : 215|8@0+ (0.35156,0) [0|89.6478] "dB"  IFV
 SG_ CAN_FR_DET_MULTI_TARGET_PROB_146 : 219|4@0+ (0.06667,0) [0|1] ""  IFV
 SG_ CAN_FR_DET_CONFID_AZIMUTH_146 : 221|2@0+ (1,0) [0|3] ""  IFV
 SG_ CAN_FR_DET_CONFID_ELEVATION_146 : 223|2@0+ (1,0) [0|3] ""  IFV
 SG_ CAN_FR_DET_EXISTENCE_PROB_146 : 227|4@0+ (1,0) [0|15] ""  IFV
 SG_ CAN_FR_DET_CLASS_146 : 231|4@0+ (1,0) [0|15] ""  IFV
 SG_ CAN_FR_DET_RANGE_147 : 247|14@0+ (0.015625,0) [0|255.984375] "m"  IFV
 SG_ CAN_FR_DET_SD_RANGE_147 : 249|6@0+ (0.025,0) [0|1.5] "m"  IFV
 SG_ CAN_FR_DET_RANGE_RATE_147 : 259|14@0+ (0.015625,-128) [-128|127.984375] "m/s"  IFV
 SG_ CAN_FR_DET_SD_RANGE_RATE_147 : 277|6@0+ (0.02,0) [0|1.2] "m/s"  IFV
 SG_ CAN_FR_DET_AZIMUTH_147 : 287|13@0+ (0.0007668,-3.141593) [-3.141593|3.141593] "rad"  IFV
 SG_ CAN_FR_DET_SD_AZIMUTH_147 : 290|6@0+ (0.001745329,0) [0|0.104719755] "rad"  IFV
 SG_ CAN_FR_DET_ELEVATION_147 : 300|7@0+ (0.157449,-9.99812) [-9.99812|9.997903] "deg"  IFV
 SG_ CAN_FR_DET_SD_ELEVATION_147 : 309|6@0+ (0.003490659,0) [0|0.20943951] "rad"  IFV
 SG_ CAN_FR_DET_AMPLITUDE_147 : 319|7@0+ (1,-64) [-64|63] "dBsm"  IFV
 SG_ CAN_FR_DET_VALID_FLAG_147 : 312|1@0+ (1,0) [0|1] ""  IFV
 SG_ CAN_FR_DET_SUPER_RES_147 : 320|1@0+ (1,0) [0|1] ""  IFV
 SG_ CAN_FR_DET_LOW_SNR_FLAG_147 : 321|1@0+ (1,0) [0|1] ""  IFV
 SG_ CAN_FR_DET_MIXER_BIAS_FLAG_147 : 322|1@0+ (1,0) [0|1] ""  IFV
 SG_ CAN_FR_DET_RESERVED_FLAGS_147 : 327|5@0+ (1,0) [0|31] ""  IFV
 SG_ CAN_FR_DET_SNR_147 : 335|8@0+ (0.35156,0) [0|89.6478] "dB"  IFV
 SG_ CAN_FR_DET_MULTI_TARGET_PROB_147 : 339|4@0+ (0.06667,0) [0|1] ""  IFV
 SG_ CAN_FR_DET_CONFID_AZIMUTH_147 : 341|2@0+ (1,0) [0|3] ""  IFV
 SG_ CAN_FR_DET_CONFID_ELEVATION_147 : 343|2@0+ (1,0) [0|3] ""  IFV
 SG_ CAN_FR_DET_EXISTENCE_PROB_147 : 347|4@0+ (1,0) [0|15] ""  IFV
 SG_ CAN_FR_DET_CLASS_147 : 351|4@0+ (1,0) [0|15] ""  IFV
 SG_ CAN_FR_DET_RANGE_148 : 367|14@0+ (0.015625,0) [0|255.984375] "m"  IFV
 SG_ CAN_FR_DET_SD_RANGE_148 : 369|6@0+ (0.025,0) [0|1.5] "m"  IFV
 SG_ CAN_FR_DET_RANGE_RATE_148 : 379|14@0+ (0.015625,-128) [-128|127.984375] "m/s"  IFV
 SG_ CAN_FR_DET_SD_RANGE_RATE_148 : 397|6@0+ (0.02,0) [0|1.2] "m/s"  IFV
 SG_ CAN_FR_DET_AZIMUTH_148 : 407|13@0+ (0.0007668,-3.141593) [-3.141593|3.141593] "rad"  IFV
 SG_ CAN_FR_DET_SD_AZIMUTH_148 : 410|6@0+ (0.001745329,0) [0|0.104719755] "rad"  IFV
 SG_ CAN_FR_DET_ELEVATION_148 : 420|7@0+ (0.157449,-9.99812) [-9.99812|9.997903] "deg"  IFV
 SG_ CAN_FR_DET_SD_ELEVATION_148 : 429|6@0+ (0.003490659,0) [0|0.20943951] "rad"  IFV
 SG_ CAN_FR_DET_AMPLITUDE_148 : 439|7@0+ (1,-64) [-64|63] "dBsm"  IFV
 SG_ CAN_FR_DET_VALID_FLAG_148 : 432|1@0+ (1,0) [0|1] ""  IFV
 SG_ CAN_FR_DET_SUPER_RES_148 : 440|1@0+ (1,0) [0|1] ""  IFV
 SG_ CAN_FR_DET_LOW_SNR_FLAG_148 : 441|1@0+ (1,0) [0|1] ""  IFV
 SG_ CAN_FR_DET_MIXER_BIAS_FLAG_148 : 442|1@0+ (1,0) [0|1] ""  IFV
 SG_ CAN_FR_DET_RESERVED_FLAGS_148 : 447|5@0+ (1,0) [0|31] ""  IFV
 SG_ CAN_FR_DET_SNR_148 : 455|8@0+ (0.35156,0) [0|89.6478] "dB"  IFV
 SG_ CAN_FR_DET_MULTI_TARGET_PROB_148 : 459|4@0+ (0.06667,0) [0|1] ""  IFV
 SG_ CAN_FR_DET_CONFID_AZIMUTH_148 : 461|2@0+ (1,0) [0|3] ""  IFV
 SG_ CAN_FR_DET_CONFID_ELEVATION_148 : 463|2@0+ (1,0) [0|3] ""  IFV
 SG_ CAN_FR_DET_EXISTENCE_PROB_148 : 467|4@0+ (1,0) [0|15] ""  IFV
 SG_ CAN_FR_DET_CLASS_148 : 471|4@0+ (1,0) [0|15] ""  IFV

BO_ 1061 SODFR_DETECTION_149_152: 64 SODFR
 SG_ CAN_FR_DET_RANGE_149 : 7|14@0+ (0.015625,0) [0|255.984375] "m"  IFV
 SG_ CAN_FR_DET_SD_RANGE_149 : 9|6@0+ (0.025,0) [0|1.5] "m"  IFV
 SG_ CAN_FR_DET_RANGE_RATE_149 : 19|14@0+ (0.015625,-128) [-128|127.984375] "m/s"  IFV
 SG_ CAN_FR_DET_SD_RANGE_RATE_149 : 37|6@0+ (0.02,0) [0|1.2] "m/s"  IFV
 SG_ CAN_FR_DET_AZIMUTH_149 : 47|13@0+ (0.0007668,-3.141593) [-3.141593|3.141593] "rad"  IFV
 SG_ CAN_FR_DET_SD_AZIMUTH_149 : 50|6@0+ (0.001745329,0) [0|0.104719755] "rad"  IFV
 SG_ CAN_FR_DET_ELEVATION_149 : 60|7@0+ (0.157449,-9.99812) [-9.99812|9.997903] "deg"  IFV
 SG_ CAN_FR_DET_SD_ELEVATION_149 : 69|6@0+ (0.003490659,0) [0|0.20943951] "rad"  IFV
 SG_ CAN_FR_DET_AMPLITUDE_149 : 79|7@0+ (1,-64) [-64|63] "dBsm"  IFV
 SG_ CAN_FR_DET_VALID_FLAG_149 : 72|1@0+ (1,0) [0|1] ""  IFV
 SG_ CAN_FR_DET_SUPER_RES_149 : 80|1@0+ (1,0) [0|1] ""  IFV
 SG_ CAN_FR_DET_LOW_SNR_FLAG_149 : 81|1@0+ (1,0) [0|1] ""  IFV
 SG_ CAN_FR_DET_MIXER_BIAS_FLAG_149 : 82|1@0+ (1,0) [0|1] ""  IFV
 SG_ CAN_FR_DET_RESERVED_FLAGS_149 : 87|5@0+ (1,0) [0|31] ""  IFV
 SG_ CAN_FR_DET_SNR_149 : 95|8@0+ (0.35156,0) [0|89.6478] "dB"  IFV
 SG_ CAN_FR_DET_MULTI_TARGET_PROB_149 : 99|4@0+ (0.06667,0) [0|1] ""  IFV
 SG_ CAN_FR_DET_CONFID_AZIMUTH_149 : 101|2@0+ (1,0) [0|3] ""  IFV
 SG_ CAN_FR_DET_CONFID_ELEVATION_149 : 103|2@0+ (1,0) [0|3] ""  IFV
 SG_ CAN_FR_DET_EXISTENCE_PROB_149 : 107|4@0+ (1,0) [0|15] ""  IFV
 SG_ CAN_FR_DET_CLASS_149 : 111|4@0+ (1,0) [0|15] ""  IFV
 SG_ CAN_FR_DET_RANGE_150 : 127|14@0+ (0.015625,0) [0|255.984375] "m"  IFV
 SG_ CAN_FR_DET_SD_RANGE_150 : 129|6@0+ (0.025,0) [0|1.5] "m"  IFV
 SG_ CAN_FR_DET_RANGE_RATE_150 : 139|14@0+ (0.015625,-128) [-128|127.984375] "m/s"  IFV
 SG_ CAN_FR_DET_SD_RANGE_RATE_150 : 157|6@0+ (0.02,0) [0|1.2] "m/s"  IFV
 SG_ CAN_FR_DET_AZIMUTH_150 : 167|13@0+ (0.0007668,-3.141593) [-3.141593|3.141593] "rad"  IFV
 SG_ CAN_FR_DET_SD_AZIMUTH_150 : 170|6@0+ (0.001745329,0) [0|0.104719755] "rad"  IFV
 SG_ CAN_FR_DET_ELEVATION_150 : 180|7@0+ (0.157449,-9.99812) [-9.99812|9.997903] "deg"  IFV
 SG_ CAN_FR_DET_SD_ELEVATION_150 : 189|6@0+ (0.003490659,0) [0|0.20943951] "rad"  IFV
 SG_ CAN_FR_DET_AMPLITUDE_150 : 199|7@0+ (1,-64) [-64|63] "dBsm"  IFV
 SG_ CAN_FR_DET_VALID_FLAG_150 : 192|1@0+ (1,0) [0|1] ""  IFV
 SG_ CAN_FR_DET_SUPER_RES_150 : 200|1@0+ (1,0) [0|1] ""  IFV
 SG_ CAN_FR_DET_LOW_SNR_FLAG_150 : 201|1@0+ (1,0) [0|1] ""  IFV
 SG_ CAN_FR_DET_MIXER_BIAS_FLAG_150 : 202|1@0+ (1,0) [0|1] ""  IFV
 SG_ CAN_FR_DET_RESERVED_FLAGS_150 : 207|5@0+ (1,0) [0|31] ""  IFV
 SG_ CAN_FR_DET_SNR_150 : 215|8@0+ (0.35156,0) [0|89.6478] "dB"  IFV
 SG_ CAN_FR_DET_MULTI_TARGET_PROB_150 : 219|4@0+ (0.06667,0) [0|1] ""  IFV
 SG_ CAN_FR_DET_CONFID_AZIMUTH_150 : 221|2@0+ (1,0) [0|3] ""  IFV
 SG_ CAN_FR_DET_CONFID_ELEVATION_150 : 223|2@0+ (1,0) [0|3] ""  IFV
 SG_ CAN_FR_DET_EXISTENCE_PROB_150 : 227|4@0+ (1,0) [0|15] ""  IFV
 SG_ CAN_FR_DET_CLASS_150 : 231|4@0+ (1,0) [0|15] ""  IFV
 SG_ CAN_FR_DET_RANGE_151 : 247|14@0+ (0.015625,0) [0|255.984375] "m"  IFV
 SG_ CAN_FR_DET_SD_RANGE_151 : 249|6@0+ (0.025,0) [0|1.5] "m"  IFV
 SG_ CAN_FR_DET_RANGE_RATE_151 : 259|14@0+ (0.015625,-128) [-128|127.984375] "m/s"  IFV
 SG_ CAN_FR_DET_SD_RANGE_RATE_151 : 277|6@0+ (0.02,0) [0|1.2] "m/s"  IFV
 SG_ CAN_FR_DET_AZIMUTH_151 : 287|13@0+ (0.0007668,-3.141593) [-3.141593|3.141593] "rad"  IFV
 SG_ CAN_FR_DET_SD_AZIMUTH_151 : 290|6@0+ (0.001745329,0) [0|0.104719755] "rad"  IFV
 SG_ CAN_FR_DET_ELEVATION_151 : 300|7@0+ (0.157449,-9.99812) [-9.99812|9.997903] "deg"  IFV
 SG_ CAN_FR_DET_SD_ELEVATION_151 : 309|6@0+ (0.003490659,0) [0|0.20943951] "rad"  IFV
 SG_ CAN_FR_DET_AMPLITUDE_151 : 319|7@0+ (1,-64) [-64|63] "dBsm"  IFV
 SG_ CAN_FR_DET_VALID_FLAG_151 : 312|1@0+ (1,0) [0|1] ""  IFV
 SG_ CAN_FR_DET_SUPER_RES_151 : 320|1@0+ (1,0) [0|1] ""  IFV
 SG_ CAN_FR_DET_LOW_SNR_FLAG_151 : 321|1@0+ (1,0) [0|1] ""  IFV
 SG_ CAN_FR_DET_MIXER_BIAS_FLAG_151 : 322|1@0+ (1,0) [0|1] ""  IFV
 SG_ CAN_FR_DET_RESERVED_FLAGS_151 : 327|5@0+ (1,0) [0|31] ""  IFV
 SG_ CAN_FR_DET_SNR_151 : 335|8@0+ (0.35156,0) [0|89.6478] "dB"  IFV
 SG_ CAN_FR_DET_MULTI_TARGET_PROB_151 : 339|4@0+ (0.06667,0) [0|1] ""  IFV
 SG_ CAN_FR_DET_CONFID_AZIMUTH_151 : 341|2@0+ (1,0) [0|3] ""  IFV
 SG_ CAN_FR_DET_CONFID_ELEVATION_151 : 343|2@0+ (1,0) [0|3] ""  IFV
 SG_ CAN_FR_DET_EXISTENCE_PROB_151 : 347|4@0+ (1,0) [0|15] ""  IFV
 SG_ CAN_FR_DET_CLASS_151 : 351|4@0+ (1,0) [0|15] ""  IFV
 SG_ CAN_FR_DET_RANGE_152 : 367|14@0+ (0.015625,0) [0|255.984375] "m"  IFV
 SG_ CAN_FR_DET_SD_RANGE_152 : 369|6@0+ (0.025,0) [0|1.5] "m"  IFV
 SG_ CAN_FR_DET_RANGE_RATE_152 : 379|14@0+ (0.015625,-128) [-128|127.984375] "m/s"  IFV
 SG_ CAN_FR_DET_SD_RANGE_RATE_152 : 397|6@0+ (0.02,0) [0|1.2] "m/s"  IFV
 SG_ CAN_FR_DET_AZIMUTH_152 : 407|13@0+ (0.0007668,-3.141593) [-3.141593|3.141593] "rad"  IFV
 SG_ CAN_FR_DET_SD_AZIMUTH_152 : 410|6@0+ (0.001745329,0) [0|0.104719755] "rad"  IFV
 SG_ CAN_FR_DET_ELEVATION_152 : 420|7@0+ (0.157449,-9.99812) [-9.99812|9.997903] "deg"  IFV
 SG_ CAN_FR_DET_SD_ELEVATION_152 : 429|6@0+ (0.003490659,0) [0|0.20943951] "rad"  IFV
 SG_ CAN_FR_DET_AMPLITUDE_152 : 439|7@0+ (1,-64) [-64|63] "dBsm"  IFV
 SG_ CAN_FR_DET_VALID_FLAG_152 : 432|1@0+ (1,0) [0|1] ""  IFV
 SG_ CAN_FR_DET_SUPER_RES_152 : 440|1@0+ (1,0) [0|1] ""  IFV
 SG_ CAN_FR_DET_LOW_SNR_FLAG_152 : 441|1@0+ (1,0) [0|1] ""  IFV
 SG_ CAN_FR_DET_MIXER_BIAS_FLAG_152 : 442|1@0+ (1,0) [0|1] ""  IFV
 SG_ CAN_FR_DET_RESERVED_FLAGS_152 : 447|5@0+ (1,0) [0|31] ""  IFV
 SG_ CAN_FR_DET_SNR_152 : 455|8@0+ (0.35156,0) [0|89.6478] "dB"  IFV
 SG_ CAN_FR_DET_MULTI_TARGET_PROB_152 : 459|4@0+ (0.06667,0) [0|1] ""  IFV
 SG_ CAN_FR_DET_CONFID_AZIMUTH_152 : 461|2@0+ (1,0) [0|3] ""  IFV
 SG_ CAN_FR_DET_CONFID_ELEVATION_152 : 463|2@0+ (1,0) [0|3] ""  IFV
 SG_ CAN_FR_DET_EXISTENCE_PROB_152 : 467|4@0+ (1,0) [0|15] ""  IFV
 SG_ CAN_FR_DET_CLASS_152 : 471|4@0+ (1,0) [0|15] ""  IFV

BO_ 1062 SODFR_DETECTION_153_156: 64 SODFR
 SG_ CAN_FR_DET_RANGE_153 : 7|14@0+ (0.015625,0) [0|255.984375] "m"  IFV
 SG_ CAN_FR_DET_SD_RANGE_153 : 9|6@0+ (0.025,0) [0|1.5] "m"  IFV
 SG_ CAN_FR_DET_RANGE_RATE_153 : 19|14@0+ (0.015625,-128) [-128|127.984375] "m/s"  IFV
 SG_ CAN_FR_DET_SD_RANGE_RATE_153 : 37|6@0+ (0.02,0) [0|1.2] "m/s"  IFV
 SG_ CAN_FR_DET_AZIMUTH_153 : 47|13@0+ (0.0007668,-3.141593) [-3.141593|3.141593] "rad"  IFV
 SG_ CAN_FR_DET_SD_AZIMUTH_153 : 50|6@0+ (0.001745329,0) [0|0.104719755] "rad"  IFV
 SG_ CAN_FR_DET_ELEVATION_153 : 60|7@0+ (0.157449,-9.99812) [-9.99812|9.997903] "deg"  IFV
 SG_ CAN_FR_DET_SD_ELEVATION_153 : 69|6@0+ (0.003490659,0) [0|0.20943951] "rad"  IFV
 SG_ CAN_FR_DET_AMPLITUDE_153 : 79|7@0+ (1,-64) [-64|63] "dBsm"  IFV
 SG_ CAN_FR_DET_VALID_FLAG_153 : 72|1@0+ (1,0) [0|1] ""  IFV
 SG_ CAN_FR_DET_SUPER_RES_153 : 80|1@0+ (1,0) [0|1] ""  IFV
 SG_ CAN_FR_DET_LOW_SNR_FLAG_153 : 81|1@0+ (1,0) [0|1] ""  IFV
 SG_ CAN_FR_DET_MIXER_BIAS_FLAG_153 : 82|1@0+ (1,0) [0|1] ""  IFV
 SG_ CAN_FR_DET_RESERVED_FLAGS_153 : 87|5@0+ (1,0) [0|31] ""  IFV
 SG_ CAN_FR_DET_SNR_153 : 95|8@0+ (0.35156,0) [0|89.6478] "dB"  IFV
 SG_ CAN_FR_DET_MULTI_TARGET_PROB_153 : 99|4@0+ (0.06667,0) [0|1] ""  IFV
 SG_ CAN_FR_DET_CONFID_AZIMUTH_153 : 101|2@0+ (1,0) [0|3] ""  IFV
 SG_ CAN_FR_DET_CONFID_ELEVATION_153 : 103|2@0+ (1,0) [0|3] ""  IFV
 SG_ CAN_FR_DET_EXISTENCE_PROB_153 : 107|4@0+ (1,0) [0|15] ""  IFV
 SG_ CAN_FR_DET_CLASS_153 : 111|4@0+ (1,0) [0|15] ""  IFV
 SG_ CAN_FR_DET_RANGE_154 : 127|14@0+ (0.015625,0) [0|255.984375] "m"  IFV
 SG_ CAN_FR_DET_SD_RANGE_154 : 129|6@0+ (0.025,0) [0|1.5] "m"  IFV
 SG_ CAN_FR_DET_RANGE_RATE_154 : 139|14@0+ (0.015625,-128) [-128|127.984375] "m/s"  IFV
 SG_ CAN_FR_DET_SD_RANGE_RATE_154 : 157|6@0+ (0.02,0) [0|1.2] "m/s"  IFV
 SG_ CAN_FR_DET_AZIMUTH_154 : 167|13@0+ (0.0007668,-3.141593) [-3.141593|3.141593] "rad"  IFV
 SG_ CAN_FR_DET_SD_AZIMUTH_154 : 170|6@0+ (0.001745329,0) [0|0.104719755] "rad"  IFV
 SG_ CAN_FR_DET_ELEVATION_154 : 180|7@0+ (0.157449,-9.99812) [-9.99812|9.997903] "deg"  IFV
 SG_ CAN_FR_DET_SD_ELEVATION_154 : 189|6@0+ (0.003490659,0) [0|0.20943951] "rad"  IFV
 SG_ CAN_FR_DET_AMPLITUDE_154 : 199|7@0+ (1,-64) [-64|63] "dBsm"  IFV
 SG_ CAN_FR_DET_VALID_FLAG_154 : 192|1@0+ (1,0) [0|1] ""  IFV
 SG_ CAN_FR_DET_SUPER_RES_154 : 200|1@0+ (1,0) [0|1] ""  IFV
 SG_ CAN_FR_DET_LOW_SNR_FLAG_154 : 201|1@0+ (1,0) [0|1] ""  IFV
 SG_ CAN_FR_DET_MIXER_BIAS_FLAG_154 : 202|1@0+ (1,0) [0|1] ""  IFV
 SG_ CAN_FR_DET_RESERVED_FLAGS_154 : 207|5@0+ (1,0) [0|31] ""  IFV
 SG_ CAN_FR_DET_SNR_154 : 215|8@0+ (0.35156,0) [0|89.6478] "dB"  IFV
 SG_ CAN_FR_DET_MULTI_TARGET_PROB_154 : 219|4@0+ (0.06667,0) [0|1] ""  IFV
 SG_ CAN_FR_DET_CONFID_AZIMUTH_154 : 221|2@0+ (1,0) [0|3] ""  IFV
 SG_ CAN_FR_DET_CONFID_ELEVATION_154 : 223|2@0+ (1,0) [0|3] ""  IFV
 SG_ CAN_FR_DET_EXISTENCE_PROB_154 : 227|4@0+ (1,0) [0|15] ""  IFV
 SG_ CAN_FR_DET_CLASS_154 : 231|4@0+ (1,0) [0|15] ""  IFV
 SG_ CAN_FR_DET_RANGE_155 : 247|14@0+ (0.015625,0) [0|255.984375] "m"  IFV
 SG_ CAN_FR_DET_SD_RANGE_155 : 249|6@0+ (0.025,0) [0|1.5] "m"  IFV
 SG_ CAN_FR_DET_RANGE_RATE_155 : 259|14@0+ (0.015625,-128) [-128|127.984375] "m/s"  IFV
 SG_ CAN_FR_DET_SD_RANGE_RATE_155 : 277|6@0+ (0.02,0) [0|1.2] "m/s"  IFV
 SG_ CAN_FR_DET_AZIMUTH_155 : 287|13@0+ (0.0007668,-3.141593) [-3.141593|3.141593] "rad"  IFV
 SG_ CAN_FR_DET_SD_AZIMUTH_155 : 290|6@0+ (0.001745329,0) [0|0.104719755] "rad"  IFV
 SG_ CAN_FR_DET_ELEVATION_155 : 300|7@0+ (0.157449,-9.99812) [-9.99812|9.997903] "deg"  IFV
 SG_ CAN_FR_DET_SD_ELEVATION_155 : 309|6@0+ (0.003490659,0) [0|0.20943951] "rad"  IFV
 SG_ CAN_FR_DET_AMPLITUDE_155 : 319|7@0+ (1,-64) [-64|63] "dBsm"  IFV
 SG_ CAN_FR_DET_VALID_FLAG_155 : 312|1@0+ (1,0) [0|1] ""  IFV
 SG_ CAN_FR_DET_SUPER_RES_155 : 320|1@0+ (1,0) [0|1] ""  IFV
 SG_ CAN_FR_DET_LOW_SNR_FLAG_155 : 321|1@0+ (1,0) [0|1] ""  IFV
 SG_ CAN_FR_DET_MIXER_BIAS_FLAG_155 : 322|1@0+ (1,0) [0|1] ""  IFV
 SG_ CAN_FR_DET_RESERVED_FLAGS_155 : 327|5@0+ (1,0) [0|31] ""  IFV
 SG_ CAN_FR_DET_SNR_155 : 335|8@0+ (0.35156,0) [0|89.6478] "dB"  IFV
 SG_ CAN_FR_DET_MULTI_TARGET_PROB_155 : 339|4@0+ (0.06667,0) [0|1] ""  IFV
 SG_ CAN_FR_DET_CONFID_AZIMUTH_155 : 341|2@0+ (1,0) [0|3] ""  IFV
 SG_ CAN_FR_DET_CONFID_ELEVATION_155 : 343|2@0+ (1,0) [0|3] ""  IFV
 SG_ CAN_FR_DET_EXISTENCE_PROB_155 : 347|4@0+ (1,0) [0|15] ""  IFV
 SG_ CAN_FR_DET_CLASS_155 : 351|4@0+ (1,0) [0|15] ""  IFV
 SG_ CAN_FR_DET_RANGE_156 : 367|14@0+ (0.015625,0) [0|255.984375] "m"  IFV
 SG_ CAN_FR_DET_SD_RANGE_156 : 369|6@0+ (0.025,0) [0|1.5] "m"  IFV
 SG_ CAN_FR_DET_RANGE_RATE_156 : 379|14@0+ (0.015625,-128) [-128|127.984375] "m/s"  IFV
 SG_ CAN_FR_DET_SD_RANGE_RATE_156 : 397|6@0+ (0.02,0) [0|1.2] "m/s"  IFV
 SG_ CAN_FR_DET_AZIMUTH_156 : 407|13@0+ (0.0007668,-3.141593) [-3.141593|3.141593] "rad"  IFV
 SG_ CAN_FR_DET_SD_AZIMUTH_156 : 410|6@0+ (0.001745329,0) [0|0.104719755] "rad"  IFV
 SG_ CAN_FR_DET_ELEVATION_156 : 420|7@0+ (0.157449,-9.99812) [-9.99812|9.997903] "deg"  IFV
 SG_ CAN_FR_DET_SD_ELEVATION_156 : 429|6@0+ (0.003490659,0) [0|0.20943951] "rad"  IFV
 SG_ CAN_FR_DET_AMPLITUDE_156 : 439|7@0+ (1,-64) [-64|63] "dBsm"  IFV
 SG_ CAN_FR_DET_VALID_FLAG_156 : 432|1@0+ (1,0) [0|1] ""  IFV
 SG_ CAN_FR_DET_SUPER_RES_156 : 440|1@0+ (1,0) [0|1] ""  IFV
 SG_ CAN_FR_DET_LOW_SNR_FLAG_156 : 441|1@0+ (1,0) [0|1] ""  IFV
 SG_ CAN_FR_DET_MIXER_BIAS_FLAG_156 : 442|1@0+ (1,0) [0|1] ""  IFV
 SG_ CAN_FR_DET_RESERVED_FLAGS_156 : 447|5@0+ (1,0) [0|31] ""  IFV
 SG_ CAN_FR_DET_SNR_156 : 455|8@0+ (0.35156,0) [0|89.6478] "dB"  IFV
 SG_ CAN_FR_DET_MULTI_TARGET_PROB_156 : 459|4@0+ (0.06667,0) [0|1] ""  IFV
 SG_ CAN_FR_DET_CONFID_AZIMUTH_156 : 461|2@0+ (1,0) [0|3] ""  IFV
 SG_ CAN_FR_DET_CONFID_ELEVATION_156 : 463|2@0+ (1,0) [0|3] ""  IFV
 SG_ CAN_FR_DET_EXISTENCE_PROB_156 : 467|4@0+ (1,0) [0|15] ""  IFV
 SG_ CAN_FR_DET_CLASS_156 : 471|4@0+ (1,0) [0|15] ""  IFV

BO_ 1063 SODFR_DETECTION_157_160: 64 SODFR
 SG_ CAN_FR_DET_RANGE_157 : 7|14@0+ (0.015625,0) [0|255.984375] "m"  IFV
 SG_ CAN_FR_DET_SD_RANGE_157 : 9|6@0+ (0.025,0) [0|1.5] "m"  IFV
 SG_ CAN_FR_DET_RANGE_RATE_157 : 19|14@0+ (0.015625,-128) [-128|127.984375] "m/s"  IFV
 SG_ CAN_FR_DET_SD_RANGE_RATE_157 : 37|6@0+ (0.02,0) [0|1.2] "m/s"  IFV
 SG_ CAN_FR_DET_AZIMUTH_157 : 47|13@0+ (0.0007668,-3.141593) [-3.141593|3.141593] "rad"  IFV
 SG_ CAN_FR_DET_SD_AZIMUTH_157 : 50|6@0+ (0.001745329,0) [0|0.104719755] "rad"  IFV
 SG_ CAN_FR_DET_ELEVATION_157 : 60|7@0+ (0.157449,-9.99812) [-9.99812|9.997903] "deg"  IFV
 SG_ CAN_FR_DET_SD_ELEVATION_157 : 69|6@0+ (0.003490659,0) [0|0.20943951] "rad"  IFV
 SG_ CAN_FR_DET_AMPLITUDE_157 : 79|7@0+ (1,-64) [-64|63] "dBsm"  IFV
 SG_ CAN_FR_DET_VALID_FLAG_157 : 72|1@0+ (1,0) [0|1] ""  IFV
 SG_ CAN_FR_DET_SUPER_RES_157 : 80|1@0+ (1,0) [0|1] ""  IFV
 SG_ CAN_FR_DET_LOW_SNR_FLAG_157 : 81|1@0+ (1,0) [0|1] ""  IFV
 SG_ CAN_FR_DET_MIXER_BIAS_FLAG_157 : 82|1@0+ (1,0) [0|1] ""  IFV
 SG_ CAN_FR_DET_RESERVED_FLAGS_157 : 87|5@0+ (1,0) [0|31] ""  IFV
 SG_ CAN_FR_DET_SNR_157 : 95|8@0+ (0.35156,0) [0|89.6478] "dB"  IFV
 SG_ CAN_FR_DET_MULTI_TARGET_PROB_157 : 99|4@0+ (0.06667,0) [0|1] ""  IFV
 SG_ CAN_FR_DET_CONFID_AZIMUTH_157 : 101|2@0+ (1,0) [0|3] ""  IFV
 SG_ CAN_FR_DET_CONFID_ELEVATION_157 : 103|2@0+ (1,0) [0|3] ""  IFV
 SG_ CAN_FR_DET_EXISTENCE_PROB_157 : 107|4@0+ (1,0) [0|15] ""  IFV
 SG_ CAN_FR_DET_CLASS_157 : 111|4@0+ (1,0) [0|15] ""  IFV
 SG_ CAN_FR_DET_RANGE_158 : 127|14@0+ (0.015625,0) [0|255.984375] "m"  IFV
 SG_ CAN_FR_DET_SD_RANGE_158 : 129|6@0+ (0.025,0) [0|1.5] "m"  IFV
 SG_ CAN_FR_DET_RANGE_RATE_158 : 139|14@0+ (0.015625,-128) [-128|127.984375] "m/s"  IFV
 SG_ CAN_FR_DET_SD_RANGE_RATE_158 : 157|6@0+ (0.02,0) [0|1.2] "m/s"  IFV
 SG_ CAN_FR_DET_AZIMUTH_158 : 167|13@0+ (0.0007668,-3.141593) [-3.141593|3.141593] "rad"  IFV
 SG_ CAN_FR_DET_SD_AZIMUTH_158 : 170|6@0+ (0.001745329,0) [0|0.104719755] "rad"  IFV
 SG_ CAN_FR_DET_ELEVATION_158 : 180|7@0+ (0.157449,-9.99812) [-9.99812|9.997903] "deg"  IFV
 SG_ CAN_FR_DET_SD_ELEVATION_158 : 189|6@0+ (0.003490659,0) [0|0.20943951] "rad"  IFV
 SG_ CAN_FR_DET_AMPLITUDE_158 : 199|7@0+ (1,-64) [-64|63] "dBsm"  IFV
 SG_ CAN_FR_DET_VALID_FLAG_158 : 192|1@0+ (1,0) [0|1] ""  IFV
 SG_ CAN_FR_DET_SUPER_RES_158 : 200|1@0+ (1,0) [0|1] ""  IFV
 SG_ CAN_FR_DET_LOW_SNR_FLAG_158 : 201|1@0+ (1,0) [0|1] ""  IFV
 SG_ CAN_FR_DET_MIXER_BIAS_FLAG_158 : 202|1@0+ (1,0) [0|1] ""  IFV
 SG_ CAN_FR_DET_RESERVED_FLAGS_158 : 207|5@0+ (1,0) [0|31] ""  IFV
 SG_ CAN_FR_DET_SNR_158 : 215|8@0+ (0.35156,0) [0|89.6478] "dB"  IFV
 SG_ CAN_FR_DET_MULTI_TARGET_PROB_158 : 219|4@0+ (0.06667,0) [0|1] ""  IFV
 SG_ CAN_FR_DET_CONFID_AZIMUTH_158 : 221|2@0+ (1,0) [0|3] ""  IFV
 SG_ CAN_FR_DET_CONFID_ELEVATION_158 : 223|2@0+ (1,0) [0|3] ""  IFV
 SG_ CAN_FR_DET_EXISTENCE_PROB_158 : 227|4@0+ (1,0) [0|15] ""  IFV
 SG_ CAN_FR_DET_CLASS_158 : 231|4@0+ (1,0) [0|15] ""  IFV
 SG_ CAN_FR_DET_RANGE_159 : 247|14@0+ (0.015625,0) [0|255.984375] "m"  IFV
 SG_ CAN_FR_DET_SD_RANGE_159 : 249|6@0+ (0.025,0) [0|1.5] "m"  IFV
 SG_ CAN_FR_DET_RANGE_RATE_159 : 259|14@0+ (0.015625,-128) [-128|127.984375] "m/s"  IFV
 SG_ CAN_FR_DET_SD_RANGE_RATE_159 : 277|6@0+ (0.02,0) [0|1.2] "m/s"  IFV
 SG_ CAN_FR_DET_AZIMUTH_159 : 287|13@0+ (0.0007668,-3.141593) [-3.141593|3.141593] "rad"  IFV
 SG_ CAN_FR_DET_SD_AZIMUTH_159 : 290|6@0+ (0.001745329,0) [0|0.104719755] "rad"  IFV
 SG_ CAN_FR_DET_ELEVATION_159 : 300|7@0+ (0.157449,-9.99812) [-9.99812|9.997903] "deg"  IFV
 SG_ CAN_FR_DET_SD_ELEVATION_159 : 309|6@0+ (0.003490659,0) [0|0.20943951] "rad"  IFV
 SG_ CAN_FR_DET_AMPLITUDE_159 : 319|7@0+ (1,-64) [-64|63] "dBsm"  IFV
 SG_ CAN_FR_DET_VALID_FLAG_159 : 312|1@0+ (1,0) [0|1] ""  IFV
 SG_ CAN_FR_DET_SUPER_RES_159 : 320|1@0+ (1,0) [0|1] ""  IFV
 SG_ CAN_FR_DET_LOW_SNR_FLAG_159 : 321|1@0+ (1,0) [0|1] ""  IFV
 SG_ CAN_FR_DET_MIXER_BIAS_FLAG_159 : 322|1@0+ (1,0) [0|1] ""  IFV
 SG_ CAN_FR_DET_RESERVED_FLAGS_159 : 327|5@0+ (1,0) [0|31] ""  IFV
 SG_ CAN_FR_DET_SNR_159 : 335|8@0+ (0.35156,0) [0|89.6478] "dB"  IFV
 SG_ CAN_FR_DET_MULTI_TARGET_PROB_159 : 339|4@0+ (0.06667,0) [0|1] ""  IFV
 SG_ CAN_FR_DET_CONFID_AZIMUTH_159 : 341|2@0+ (1,0) [0|3] ""  IFV
 SG_ CAN_FR_DET_CONFID_ELEVATION_159 : 343|2@0+ (1,0) [0|3] ""  IFV
 SG_ CAN_FR_DET_EXISTENCE_PROB_159 : 347|4@0+ (1,0) [0|15] ""  IFV
 SG_ CAN_FR_DET_CLASS_159 : 351|4@0+ (1,0) [0|15] ""  IFV
 SG_ CAN_FR_DET_RANGE_160 : 367|14@0+ (0.015625,0) [0|255.984375] "m"  IFV
 SG_ CAN_FR_DET_SD_RANGE_160 : 369|6@0+ (0.025,0) [0|1.5] "m"  IFV
 SG_ CAN_FR_DET_RANGE_RATE_160 : 379|14@0+ (0.015625,-128) [-128|127.984375] "m/s"  IFV
 SG_ CAN_FR_DET_SD_RANGE_RATE_160 : 397|6@0+ (0.02,0) [0|1.2] "m/s"  IFV
 SG_ CAN_FR_DET_AZIMUTH_160 : 407|13@0+ (0.0007668,-3.141593) [-3.141593|3.141593] "rad"  IFV
 SG_ CAN_FR_DET_SD_AZIMUTH_160 : 410|6@0+ (0.001745329,0) [0|0.104719755] "rad"  IFV
 SG_ CAN_FR_DET_ELEVATION_160 : 420|7@0+ (0.157449,-9.99812) [-9.99812|9.997903] "deg"  IFV
 SG_ CAN_FR_DET_SD_ELEVATION_160 : 429|6@0+ (0.003490659,0) [0|0.20943951] "rad"  IFV
 SG_ CAN_FR_DET_AMPLITUDE_160 : 439|7@0+ (1,-64) [-64|63] "dBsm"  IFV
 SG_ CAN_FR_DET_VALID_FLAG_160 : 432|1@0+ (1,0) [0|1] ""  IFV
 SG_ CAN_FR_DET_SUPER_RES_160 : 440|1@0+ (1,0) [0|1] ""  IFV
 SG_ CAN_FR_DET_LOW_SNR_FLAG_160 : 441|1@0+ (1,0) [0|1] ""  IFV
 SG_ CAN_FR_DET_MIXER_BIAS_FLAG_160 : 442|1@0+ (1,0) [0|1] ""  IFV
 SG_ CAN_FR_DET_RESERVED_FLAGS_160 : 447|5@0+ (1,0) [0|31] ""  IFV
 SG_ CAN_FR_DET_SNR_160 : 455|8@0+ (0.35156,0) [0|89.6478] "dB"  IFV
 SG_ CAN_FR_DET_MULTI_TARGET_PROB_160 : 459|4@0+ (0.06667,0) [0|1] ""  IFV
 SG_ CAN_FR_DET_CONFID_AZIMUTH_160 : 461|2@0+ (1,0) [0|3] ""  IFV
 SG_ CAN_FR_DET_CONFID_ELEVATION_160 : 463|2@0+ (1,0) [0|3] ""  IFV
 SG_ CAN_FR_DET_EXISTENCE_PROB_160 : 467|4@0+ (1,0) [0|15] ""  IFV
 SG_ CAN_FR_DET_CLASS_160 : 471|4@0+ (1,0) [0|15] ""  IFV

BA_DEF_ BO_  "VFrameFormat" ENUM  "StandardCAN","ExtendedCAN","reserved","reserved","reserved","reserved","reserved","reserved","reserved","reserved","reserved","reserved","reserved","reserved","StandardCAN_FD","ExtendedCAN_FD";
BA_DEF_ BO_  "CanTpBs" INT 0 255;
BA_DEF_ BO_  "EventRateOfChange" INT 10 10000;
BA_DEF_ SG_  "GenSigTimeoutTime_SRR01RR" INT 0 0;
BA_DEF_ SG_  "GenSigCycleTime" INT 0 0;
BA_DEF_ SG_  "GenSigVtName" STRING ;
BA_DEF_ SG_  "GenSigVtEn" STRING ;
BA_DEF_ SG_  "GenSigCmt" STRING ;
BA_DEF_ SG_  "GenSigSendType" ENUM  "Cyclic","OnWrite","vector_leerstring","OnChange","vector_leerstring","IfActive","vector_leerstring","NoSigSendType";
BA_DEF_ SG_  "GenSigStartValue" INT 0 1000000000;
BA_DEF_ BO_  "GenMsgILSupport" ENUM  "No","Yes";
BA_DEF_ BO_  "GenMsgSendType" ENUM  "FixedPeriodic","Event","EnabledPeriodic","NotUsed","NotUsed","EventPeriodic","NotUsed","NotUsed","NoMsgSendType";
BA_DEF_ BO_  "GenMsgCycleTime" INT 0 100000;
BA_DEF_ BO_  "GenMsgNrOfRepetition" INT 0 100;
BA_DEF_ BO_  "NetworkInitialization" ENUM  "No","Yes";
BA_DEF_DEF_  "VFrameFormat" "StandardCAN_FD";
BA_DEF_DEF_  "CanTpBs" 255;
BA_DEF_DEF_  "EventRateOfChange" 10000;
BA_DEF_DEF_  "GenSigTimeoutTime_SRR01RR" 0;
BA_DEF_DEF_  "GenSigCycleTime" 0;
BA_DEF_DEF_  "GenSigVtName" "";
BA_DEF_DEF_  "GenSigVtEn" "";
BA_DEF_DEF_  "GenSigCmt" "";
BA_DEF_DEF_  "GenSigSendType" "NoSigSendType";
BA_DEF_DEF_  "GenSigStartValue" 0;
BA_DEF_DEF_  "GenMsgILSupport" "Yes";
BA_DEF_DEF_  "GenMsgSendType" "NoMsgSendType";
BA_DEF_DEF_  "GenMsgCycleTime" 0;
BA_DEF_DEF_  "GenMsgNrOfRepetition" 0;
BA_DEF_DEF_  "NetworkInitialization" "Yes";
BA_ "GenMsgCycleTime" BO_ 1034 50;
BA_ "GenMsgCycleTime" BO_ 1035 50;
BA_ "GenMsgCycleTime" BO_ 1036 50;
BA_ "GenMsgCycleTime" BO_ 1037 50;
BA_ "GenMsgCycleTime" BO_ 1038 50;
BA_ "GenMsgCycleTime" BO_ 1039 50;
BA_ "GenMsgCycleTime" BO_ 1040 50;
BA_ "GenMsgCycleTime" BO_ 1041 50;
BA_ "GenMsgCycleTime" BO_ 1042 50;
BA_ "GenMsgCycleTime" BO_ 1043 50;
BA_ "GenMsgCycleTime" BO_ 1044 50;
BA_ "GenMsgCycleTime" BO_ 1045 50;
BA_ "GenMsgCycleTime" BO_ 1046 50;
BA_ "GenMsgCycleTime" BO_ 1047 50;
BA_ "GenMsgCycleTime" BO_ 1048 50;
BA_ "GenMsgCycleTime" BO_ 1049 50;
BA_ "GenMsgCycleTime" BO_ 1050 50;
BA_ "GenMsgCycleTime" BO_ 1051 50;
BA_ "GenMsgCycleTime" BO_ 1052 50;
BA_ "GenMsgCycleTime" BO_ 1053 50;
BA_ "GenMsgCycleTime" BO_ 1054 50;
BA_ "GenMsgCycleTime" BO_ 1055 50;
BA_ "GenMsgCycleTime" BO_ 1056 50;
BA_ "GenMsgCycleTime" BO_ 1057 50;
BA_ "GenMsgCycleTime" BO_ 1058 50;
BA_ "GenMsgCycleTime" BO_ 1059 50;
BA_ "GenMsgCycleTime" BO_ 1060 50;
BA_ "GenMsgCycleTime" BO_ 1061 50;
BA_ "GenMsgCycleTime" BO_ 1062 50;
BA_ "GenMsgCycleTime" BO_ 1063 50;
