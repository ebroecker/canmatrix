VERSION ""

NS_ :

BS_:

BU_: External_Tool IFV SODFR SODFL
VAL_TABLE_ vtSig_FL_CAN_PLATFORM_VARIANT 0 "VARIANT_INVALID" 1 "VARIANT_MRR3" 2 "VARIANT_SRR5" 3 "VARIANT_RACAM" 4 "VARIANT_MRR360" 5 "VARIANT_MRR3LLP_A01" 6 "VARIANT_MRR3LLP" ;
VAL_TABLE_ CAN_RADAR_ALIGN_INCOMPLETE 1 "Alignment Incomplete" 0 "Alignment Completed" ;

BO_ 768 SODFL_DETECTION_001_004: 64 SODFL
 SG_ CAN_FL_DET_RANGE_001 : 7|14@0+ (0.015625,0) [0|255.984375] "m"  IFV
 SG_ CAN_FL_DET_SD_RANGE_001 : 9|6@0+ (0.025,0) [0|1.5] "m"  IFV
 SG_ CAN_FL_DET_RANGE_RATE_001 : 19|14@0+ (0.015625,-128) [-128|127.984375] "m/s"  IFV
 SG_ CAN_FL_DET_SD_RANGE_RATE_001 : 37|6@0+ (0.02,0) [0|1.2] "m/s"  IFV
 SG_ CAN_FL_DET_AZIMUTH_001 : 47|13@0+ (0.0007668,-3.141593) [-3.141593|3.141593] "rad"  IFV
 SG_ CAN_FL_DET_SD_AZIMUTH_001 : 50|6@0+ (0.001745329,0) [0|0.104719755] "rad"  IFV
 SG_ CAN_FL_DET_ELEVATION_001 : 60|7@0+ (0.157449,-9.99812) [-9.99812|9.997903] "deg"  IFV
 SG_ CAN_FL_DET_SD_ELEVATION_001 : 69|6@0+ (0.003490659,0) [0|0.20943951] "rad"  IFV
 SG_ CAN_FL_DET_AMPLITUDE_001 : 79|7@0+ (1,-64) [-64|63] "dBsm"  IFV
 SG_ CAN_FL_DET_VALID_FLAG_001 : 72|1@0+ (1,0) [0|1] ""  IFV
 SG_ CAN_FL_DET_SUPER_RES_001 : 80|1@0+ (1,0) [0|1] ""  IFV
 SG_ CAN_FL_DET_LOW_SNR_FLAG_001 : 81|1@0+ (1,0) [0|1] ""  IFV
 SG_ CAN_FL_DET_MIXER_BIAS_FLAG_001 : 82|1@0+ (1,0) [0|1] ""  IFV
 SG_ CAN_FL_DET_RESERVED_FLAGS_001 : 87|5@0+ (1,0) [0|31] ""  IFV
 SG_ CAN_FL_DET_SNR_001 : 95|8@0+ (0.35156,0) [0|89.6478] "dB"  IFV
 SG_ CAN_FL_DET_MULTI_TARGET_PROB_001 : 99|4@0+ (0.06667,0) [0|1] ""  IFV
 SG_ CAN_FL_DET_CONFID_AZIMUTH_001 : 101|2@0+ (1,0) [0|3] ""  IFV
 SG_ CAN_FL_DET_CONFID_ELEVATION_001 : 103|2@0+ (1,0) [0|3] ""  IFV
 SG_ CAN_FL_DET_EXISTENCE_PROB_001 : 107|4@0+ (1,0) [0|15] ""  IFV
 SG_ CAN_FL_DET_CLASS_001 : 111|4@0+ (1,0) [0|15] ""  IFV
 SG_ CAN_FL_DET_RANGE_002 : 127|14@0+ (0.015625,0) [0|255.984375] "m"  IFV
 SG_ CAN_FL_DET_SD_RANGE_002 : 129|6@0+ (0.025,0) [0|1.5] "m"  IFV
 SG_ CAN_FL_DET_RANGE_RATE_002 : 139|14@0+ (0.015625,-128) [-128|127.984375] "m/s"  IFV
 SG_ CAN_FL_DET_SD_RANGE_RATE_002 : 157|6@0+ (0.02,0) [0|1.2] "m/s"  IFV
 SG_ CAN_FL_DET_AZIMUTH_002 : 167|13@0+ (0.0007668,-3.141593) [-3.141593|3.141593] "rad"  IFV
 SG_ CAN_FL_DET_SD_AZIMUTH_002 : 170|6@0+ (0.001745329,0) [0|0.104719755] "rad"  IFV
 SG_ CAN_FL_DET_ELEVATION_002 : 180|7@0+ (0.157449,-9.99812) [-9.99812|9.997903] "deg"  IFV
 SG_ CAN_FL_DET_SD_ELEVATION_002 : 189|6@0+ (0.003490659,0) [0|0.20943951] "rad"  IFV
 SG_ CAN_FL_DET_AMPLITUDE_002 : 199|7@0+ (1,-64) [-64|63] "dBsm"  IFV
 SG_ CAN_FL_DET_VALID_FLAG_002 : 192|1@0+ (1,0) [0|1] ""  IFV
 SG_ CAN_FL_DET_SUPER_RES_002 : 200|1@0+ (1,0) [0|1] ""  IFV
 SG_ CAN_FL_DET_LOW_SNR_FLAG_002 : 201|1@0+ (1,0) [0|1] ""  IFV
 SG_ CAN_FL_DET_MIXER_BIAS_FLAG_002 : 202|1@0+ (1,0) [0|1] ""  IFV
 SG_ CAN_FL_DET_RESERVED_FLAGS_002 : 207|5@0+ (1,0) [0|31] ""  IFV
 SG_ CAN_FL_DET_SNR_002 : 215|8@0+ (0.35156,0) [0|89.6478] "dB"  IFV
 SG_ CAN_FL_DET_MULTI_TARGET_PROB_002 : 219|4@0+ (0.06667,0) [0|1] ""  IFV
 SG_ CAN_FL_DET_CONFID_AZIMUTH_002 : 221|2@0+ (1,0) [0|3] ""  IFV
 SG_ CAN_FL_DET_CONFID_ELEVATION_002 : 223|2@0+ (1,0) [0|3] ""  IFV
 SG_ CAN_FL_DET_EXISTENCE_PROB_002 : 227|4@0+ (1,0) [0|15] ""  IFV
 SG_ CAN_FL_DET_CLASS_002 : 231|4@0+ (1,0) [0|15] ""  IFV
 SG_ CAN_FL_DET_RANGE_003 : 247|14@0+ (0.015625,0) [0|255.984375] "m"  IFV
 SG_ CAN_FL_DET_SD_RANGE_003 : 249|6@0+ (0.025,0) [0|1.5] "m"  IFV
 SG_ CAN_FL_DET_RANGE_RATE_003 : 259|14@0+ (0.015625,-128) [-128|127.984375] "m/s"  IFV
 SG_ CAN_FL_DET_SD_RANGE_RATE_003 : 277|6@0+ (0.02,0) [0|1.2] "m/s"  IFV
 SG_ CAN_FL_DET_AZIMUTH_003 : 287|13@0+ (0.0007668,-3.141593) [-3.141593|3.141593] "rad"  IFV
 SG_ CAN_FL_DET_SD_AZIMUTH_003 : 290|6@0+ (0.001745329,0) [0|0.104719755] "rad"  IFV
 SG_ CAN_FL_DET_ELEVATION_003 : 300|7@0+ (0.157449,-9.99812) [-9.99812|9.997903] "deg"  IFV
 SG_ CAN_FL_DET_SD_ELEVATION_003 : 309|6@0+ (0.003490659,0) [0|0.20943951] "rad"  IFV
 SG_ CAN_FL_DET_AMPLITUDE_003 : 319|7@0+ (1,-64) [-64|63] "dBsm"  IFV
 SG_ CAN_FL_DET_VALID_FLAG_003 : 312|1@0+ (1,0) [0|1] ""  IFV
 SG_ CAN_FL_DET_SUPER_RES_003 : 320|1@0+ (1,0) [0|1] ""  IFV
 SG_ CAN_FL_DET_LOW_SNR_FLAG_003 : 321|1@0+ (1,0) [0|1] ""  IFV
 SG_ CAN_FL_DET_MIXER_BIAS_FLAG_003 : 322|1@0+ (1,0) [0|1] ""  IFV
 SG_ CAN_FL_DET_RESERVED_FLAGS_003 : 327|5@0+ (1,0) [0|31] ""  IFV
 SG_ CAN_FL_DET_SNR_003 : 335|8@0+ (0.35156,0) [0|89.6478] "dB"  IFV
 SG_ CAN_FL_DET_MULTI_TARGET_PROB_003 : 339|4@0+ (0.06667,0) [0|1] ""  IFV
 SG_ CAN_FL_DET_CONFID_AZIMUTH_003 : 341|2@0+ (1,0) [0|3] ""  IFV
 SG_ CAN_FL_DET_CONFID_ELEVATION_003 : 343|2@0+ (1,0) [0|3] ""  IFV
 SG_ CAN_FL_DET_EXISTENCE_PROB_003 : 347|4@0+ (1,0) [0|15] ""  IFV
 SG_ CAN_FL_DET_CLASS_003 : 351|4@0+ (1,0) [0|15] ""  IFV
 SG_ CAN_FL_DET_RANGE_004 : 367|14@0+ (0.015625,0) [0|255.984375] "m"  IFV
 SG_ CAN_FL_DET_SD_RANGE_004 : 369|6@0+ (0.025,0) [0|1.5] "m"  IFV
 SG_ CAN_FL_DET_RANGE_RATE_004 : 379|14@0+ (0.015625,-128) [-128|127.984375] "m/s"  IFV
 SG_ CAN_FL_DET_SD_RANGE_RATE_004 : 397|6@0+ (0.02,0) [0|1.2] "m/s"  IFV
 SG_ CAN_FL_DET_AZIMUTH_004 : 407|13@0+ (0.0007668,-3.141593) [-3.141593|3.141593] "rad"  IFV
 SG_ CAN_FL_DET_SD_AZIMUTH_004 : 410|6@0+ (0.001745329,0) [0|0.104719755] "rad"  IFV
 SG_ CAN_FL_DET_ELEVATION_004 : 420|7@0+ (0.157449,-9.99812) [-9.99812|9.997903] "deg"  IFV
 SG_ CAN_FL_DET_SD_ELEVATION_004 : 429|6@0+ (0.003490659,0) [0|0.20943951] "rad"  IFV
 SG_ CAN_FL_DET_AMPLITUDE_004 : 439|7@0+ (1,-64) [-64|63] "dBsm"  IFV
 SG_ CAN_FL_DET_VALID_FLAG_004 : 432|1@0+ (1,0) [0|1] ""  IFV
 SG_ CAN_FL_DET_SUPER_RES_004 : 440|1@0+ (1,0) [0|1] ""  IFV
 SG_ CAN_FL_DET_LOW_SNR_FLAG_004 : 441|1@0+ (1,0) [0|1] ""  IFV
 SG_ CAN_FL_DET_MIXER_BIAS_FLAG_004 : 442|1@0+ (1,0) [0|1] ""  IFV
 SG_ CAN_FL_DET_RESERVED_FLAGS_004 : 447|5@0+ (1,0) [0|31] ""  IFV
 SG_ CAN_FL_DET_SNR_004 : 455|8@0+ (0.35156,0) [0|89.6478] "dB"  IFV
 SG_ CAN_FL_DET_MULTI_TARGET_PROB_004 : 459|4@0+ (0.06667,0) [0|1] ""  IFV
 SG_ CAN_FL_DET_CONFID_AZIMUTH_004 : 461|2@0+ (1,0) [0|3] ""  IFV
 SG_ CAN_FL_DET_CONFID_ELEVATION_004 : 463|2@0+ (1,0) [0|3] ""  IFV
 SG_ CAN_FL_DET_EXISTENCE_PROB_004 : 467|4@0+ (1,0) [0|15] ""  IFV
 SG_ CAN_FL_DET_CLASS_004 : 471|4@0+ (1,0) [0|15] ""  IFV

BO_ 769 SODFL_DETECTION_005_008: 64 SODFL
 SG_ CAN_FL_DET_RANGE_005 : 7|14@0+ (0.015625,0) [0|255.984375] "m"  IFV
 SG_ CAN_FL_DET_SD_RANGE_005 : 9|6@0+ (0.025,0) [0|1.5] "m"  IFV
 SG_ CAN_FL_DET_RANGE_RATE_005 : 19|14@0+ (0.015625,-128) [-128|127.984375] "m/s"  IFV
 SG_ CAN_FL_DET_SD_RANGE_RATE_005 : 37|6@0+ (0.02,0) [0|1.2] "m/s"  IFV
 SG_ CAN_FL_DET_AZIMUTH_005 : 47|13@0+ (0.0007668,-3.141593) [-3.141593|3.141593] "rad"  IFV
 SG_ CAN_FL_DET_SD_AZIMUTH_005 : 50|6@0+ (0.001745329,0) [0|0.104719755] "rad"  IFV
 SG_ CAN_FL_DET_ELEVATION_005 : 60|7@0+ (0.157449,-9.99812) [-9.99812|9.997903] "deg"  IFV
 SG_ CAN_FL_DET_SD_ELEVATION_005 : 69|6@0+ (0.003490659,0) [0|0.20943951] "rad"  IFV
 SG_ CAN_FL_DET_AMPLITUDE_005 : 79|7@0+ (1,-64) [-64|63] "dBsm"  IFV
 SG_ CAN_FL_DET_VALID_FLAG_005 : 72|1@0+ (1,0) [0|1] ""  IFV
 SG_ CAN_FL_DET_SUPER_RES_005 : 80|1@0+ (1,0) [0|1] ""  IFV
 SG_ CAN_FL_DET_LOW_SNR_FLAG_005 : 81|1@0+ (1,0) [0|1] ""  IFV
 SG_ CAN_FL_DET_MIXER_BIAS_FLAG_005 : 82|1@0+ (1,0) [0|1] ""  IFV
 SG_ CAN_FL_DET_RESERVED_FLAGS_005 : 87|5@0+ (1,0) [0|31] ""  IFV
 SG_ CAN_FL_DET_SNR_005 : 95|8@0+ (0.35156,0) [0|89.6478] "dB"  IFV
 SG_ CAN_FL_DET_MULTI_TARGET_PROB_005 : 99|4@0+ (0.06667,0) [0|1] ""  IFV
 SG_ CAN_FL_DET_CONFID_AZIMUTH_005 : 101|2@0+ (1,0) [0|3] ""  IFV
 SG_ CAN_FL_DET_CONFID_ELEVATION_005 : 103|2@0+ (1,0) [0|3] ""  IFV
 SG_ CAN_FL_DET_EXISTENCE_PROB_005 : 107|4@0+ (1,0) [0|15] ""  IFV
 SG_ CAN_FL_DET_CLASS_005 : 111|4@0+ (1,0) [0|15] ""  IFV
 SG_ CAN_FL_DET_RANGE_006 : 127|14@0+ (0.015625,0) [0|255.984375] "m"  IFV
 SG_ CAN_FL_DET_SD_RANGE_006 : 129|6@0+ (0.025,0) [0|1.5] "m"  IFV
 SG_ CAN_FL_DET_RANGE_RATE_006 : 139|14@0+ (0.015625,-128) [-128|127.984375] "m/s"  IFV
 SG_ CAN_FL_DET_SD_RANGE_RATE_006 : 157|6@0+ (0.02,0) [0|1.2] "m/s"  IFV
 SG_ CAN_FL_DET_AZIMUTH_006 : 167|13@0+ (0.0007668,-3.141593) [-3.141593|3.141593] "rad"  IFV
 SG_ CAN_FL_DET_SD_AZIMUTH_006 : 170|6@0+ (0.001745329,0) [0|0.104719755] "rad"  IFV
 SG_ CAN_FL_DET_ELEVATION_006 : 180|7@0+ (0.157449,-9.99812) [-9.99812|9.997903] "deg"  IFV
 SG_ CAN_FL_DET_SD_ELEVATION_006 : 189|6@0+ (0.003490659,0) [0|0.20943951] "rad"  IFV
 SG_ CAN_FL_DET_AMPLITUDE_006 : 199|7@0+ (1,-64) [-64|63] "dBsm"  IFV
 SG_ CAN_FL_DET_VALID_FLAG_006 : 192|1@0+ (1,0) [0|1] ""  IFV
 SG_ CAN_FL_DET_SUPER_RES_006 : 200|1@0+ (1,0) [0|1] ""  IFV
 SG_ CAN_FL_DET_LOW_SNR_FLAG_006 : 201|1@0+ (1,0) [0|1] ""  IFV
 SG_ CAN_FL_DET_MIXER_BIAS_FLAG_006 : 202|1@0+ (1,0) [0|1] ""  IFV
 SG_ CAN_FL_DET_RESERVED_FLAGS_006 : 207|5@0+ (1,0) [0|31] ""  IFV
 SG_ CAN_FL_DET_SNR_006 : 215|8@0+ (0.35156,0) [0|89.6478] "dB"  IFV
 SG_ CAN_FL_DET_MULTI_TARGET_PROB_006 : 219|4@0+ (0.06667,0) [0|1] ""  IFV
 SG_ CAN_FL_DET_CONFID_AZIMUTH_006 : 221|2@0+ (1,0) [0|3] ""  IFV
 SG_ CAN_FL_DET_CONFID_ELEVATION_006 : 223|2@0+ (1,0) [0|3] ""  IFV
 SG_ CAN_FL_DET_EXISTENCE_PROB_006 : 227|4@0+ (1,0) [0|15] ""  IFV
 SG_ CAN_FL_DET_CLASS_006 : 231|4@0+ (1,0) [0|15] ""  IFV
 SG_ CAN_FL_DET_RANGE_007 : 247|14@0+ (0.015625,0) [0|255.984375] "m"  IFV
 SG_ CAN_FL_DET_SD_RANGE_007 : 249|6@0+ (0.025,0) [0|1.5] "m"  IFV
 SG_ CAN_FL_DET_RANGE_RATE_007 : 259|14@0+ (0.015625,-128) [-128|127.984375] "m/s"  IFV
 SG_ CAN_FL_DET_SD_RANGE_RATE_007 : 277|6@0+ (0.02,0) [0|1.2] "m/s"  IFV
 SG_ CAN_FL_DET_AZIMUTH_007 : 287|13@0+ (0.0007668,-3.141593) [-3.141593|3.141593] "rad"  IFV
 SG_ CAN_FL_DET_SD_AZIMUTH_007 : 290|6@0+ (0.001745329,0) [0|0.104719755] "rad"  IFV
 SG_ CAN_FL_DET_ELEVATION_007 : 300|7@0+ (0.157449,-9.99812) [-9.99812|9.997903] "deg"  IFV
 SG_ CAN_FL_DET_SD_ELEVATION_007 : 309|6@0+ (0.003490659,0) [0|0.20943951] "rad"  IFV
 SG_ CAN_FL_DET_AMPLITUDE_007 : 319|7@0+ (1,-64) [-64|63] "dBsm"  IFV
 SG_ CAN_FL_DET_VALID_FLAG_007 : 312|1@0+ (1,0) [0|1] ""  IFV
 SG_ CAN_FL_DET_SUPER_RES_007 : 320|1@0+ (1,0) [0|1] ""  IFV
 SG_ CAN_FL_DET_LOW_SNR_FLAG_007 : 321|1@0+ (1,0) [0|1] ""  IFV
 SG_ CAN_FL_DET_MIXER_BIAS_FLAG_007 : 322|1@0+ (1,0) [0|1] ""  IFV
 SG_ CAN_FL_DET_RESERVED_FLAGS_007 : 327|5@0+ (1,0) [0|31] ""  IFV
 SG_ CAN_FL_DET_SNR_007 : 335|8@0+ (0.35156,0) [0|89.6478] "dB"  IFV
 SG_ CAN_FL_DET_MULTI_TARGET_PROB_007 : 339|4@0+ (0.06667,0) [0|1] ""  IFV
 SG_ CAN_FL_DET_CONFID_AZIMUTH_007 : 341|2@0+ (1,0) [0|3] ""  IFV
 SG_ CAN_FL_DET_CONFID_ELEVATION_007 : 343|2@0+ (1,0) [0|3] ""  IFV
 SG_ CAN_FL_DET_EXISTENCE_PROB_007 : 347|4@0+ (1,0) [0|15] ""  IFV
 SG_ CAN_FL_DET_CLASS_007 : 351|4@0+ (1,0) [0|15] ""  IFV
 SG_ CAN_FL_DET_RANGE_008 : 367|14@0+ (0.015625,0) [0|255.984375] "m"  IFV
 SG_ CAN_FL_DET_SD_RANGE_008 : 369|6@0+ (0.025,0) [0|1.5] "m"  IFV
 SG_ CAN_FL_DET_RANGE_RATE_008 : 379|14@0+ (0.015625,-128) [-128|127.984375] "m/s"  IFV
 SG_ CAN_FL_DET_SD_RANGE_RATE_008 : 397|6@0+ (0.02,0) [0|1.2] "m/s"  IFV
 SG_ CAN_FL_DET_AZIMUTH_008 : 407|13@0+ (0.0007668,-3.141593) [-3.141593|3.141593] "rad"  IFV
 SG_ CAN_FL_DET_SD_AZIMUTH_008 : 410|6@0+ (0.001745329,0) [0|0.104719755] "rad"  IFV
 SG_ CAN_FL_DET_ELEVATION_008 : 420|7@0+ (0.157449,-9.99812) [-9.99812|9.997903] "deg"  IFV
 SG_ CAN_FL_DET_SD_ELEVATION_008 : 429|6@0+ (0.003490659,0) [0|0.20943951] "rad"  IFV
 SG_ CAN_FL_DET_AMPLITUDE_008 : 439|7@0+ (1,-64) [-64|63] "dBsm"  IFV
 SG_ CAN_FL_DET_VALID_FLAG_008 : 432|1@0+ (1,0) [0|1] ""  IFV
 SG_ CAN_FL_DET_SUPER_RES_008 : 440|1@0+ (1,0) [0|1] ""  IFV
 SG_ CAN_FL_DET_LOW_SNR_FLAG_008 : 441|1@0+ (1,0) [0|1] ""  IFV
 SG_ CAN_FL_DET_MIXER_BIAS_FLAG_008 : 442|1@0+ (1,0) [0|1] ""  IFV
 SG_ CAN_FL_DET_RESERVED_FLAGS_008 : 447|5@0+ (1,0) [0|31] ""  IFV
 SG_ CAN_FL_DET_SNR_008 : 455|8@0+ (0.35156,0) [0|89.6478] "dB"  IFV
 SG_ CAN_FL_DET_MULTI_TARGET_PROB_008 : 459|4@0+ (0.06667,0) [0|1] ""  IFV
 SG_ CAN_FL_DET_CONFID_AZIMUTH_008 : 461|2@0+ (1,0) [0|3] ""  IFV
 SG_ CAN_FL_DET_CONFID_ELEVATION_008 : 463|2@0+ (1,0) [0|3] ""  IFV
 SG_ CAN_FL_DET_EXISTENCE_PROB_008 : 467|4@0+ (1,0) [0|15] ""  IFV
 SG_ CAN_FL_DET_CLASS_008 : 471|4@0+ (1,0) [0|15] ""  IFV

BO_ 770 SODFL_DETECTION_009_012: 64 SODFL
 SG_ CAN_FL_DET_RANGE_009 : 7|14@0+ (0.015625,0) [0|255.984375] "m"  IFV
 SG_ CAN_FL_DET_SD_RANGE_009 : 9|6@0+ (0.025,0) [0|1.5] "m"  IFV
 SG_ CAN_FL_DET_RANGE_RATE_009 : 19|14@0+ (0.015625,-128) [-128|127.984375] "m/s"  IFV
 SG_ CAN_FL_DET_SD_RANGE_RATE_009 : 37|6@0+ (0.02,0) [0|1.2] "m/s"  IFV
 SG_ CAN_FL_DET_AZIMUTH_009 : 47|13@0+ (0.0007668,-3.141593) [-3.141593|3.141593] "rad"  IFV
 SG_ CAN_FL_DET_SD_AZIMUTH_009 : 50|6@0+ (0.001745329,0) [0|0.104719755] "rad"  IFV
 SG_ CAN_FL_DET_ELEVATION_009 : 60|7@0+ (0.157449,-9.99812) [-9.99812|9.997903] "deg"  IFV
 SG_ CAN_FL_DET_SD_ELEVATION_009 : 69|6@0+ (0.003490659,0) [0|0.20943951] "rad"  IFV
 SG_ CAN_FL_DET_AMPLITUDE_009 : 79|7@0+ (1,-64) [-64|63] "dBsm"  IFV
 SG_ CAN_FL_DET_VALID_FLAG_009 : 72|1@0+ (1,0) [0|1] ""  IFV
 SG_ CAN_FL_DET_SUPER_RES_009 : 80|1@0+ (1,0) [0|1] ""  IFV
 SG_ CAN_FL_DET_LOW_SNR_FLAG_009 : 81|1@0+ (1,0) [0|1] ""  IFV
 SG_ CAN_FL_DET_MIXER_BIAS_FLAG_009 : 82|1@0+ (1,0) [0|1] ""  IFV
 SG_ CAN_FL_DET_RESERVED_FLAGS_009 : 87|5@0+ (1,0) [0|31] ""  IFV
 SG_ CAN_FL_DET_SNR_009 : 95|8@0+ (0.35156,0) [0|89.6478] "dB"  IFV
 SG_ CAN_FL_DET_MULTI_TARGET_PROB_009 : 99|4@0+ (0.06667,0) [0|1] ""  IFV
 SG_ CAN_FL_DET_CONFID_AZIMUTH_009 : 101|2@0+ (1,0) [0|3] ""  IFV
 SG_ CAN_FL_DET_CONFID_ELEVATION_009 : 103|2@0+ (1,0) [0|3] ""  IFV
 SG_ CAN_FL_DET_EXISTENCE_PROB_009 : 107|4@0+ (1,0) [0|15] ""  IFV
 SG_ CAN_FL_DET_CLASS_009 : 111|4@0+ (1,0) [0|15] ""  IFV
 SG_ CAN_FL_DET_RANGE_010 : 127|14@0+ (0.015625,0) [0|255.984375] "m"  IFV
 SG_ CAN_FL_DET_SD_RANGE_010 : 129|6@0+ (0.025,0) [0|1.5] "m"  IFV
 SG_ CAN_FL_DET_RANGE_RATE_010 : 139|14@0+ (0.015625,-128) [-128|127.984375] "m/s"  IFV
 SG_ CAN_FL_DET_SD_RANGE_RATE_010 : 157|6@0+ (0.02,0) [0|1.2] "m/s"  IFV
 SG_ CAN_FL_DET_AZIMUTH_010 : 167|13@0+ (0.0007668,-3.141593) [-3.141593|3.141593] "rad"  IFV
 SG_ CAN_FL_DET_SD_AZIMUTH_010 : 170|6@0+ (0.001745329,0) [0|0.104719755] "rad"  IFV
 SG_ CAN_FL_DET_ELEVATION_010 : 180|7@0+ (0.157449,-9.99812) [-9.99812|9.997903] "deg"  IFV
 SG_ CAN_FL_DET_SD_ELEVATION_010 : 189|6@0+ (0.003490659,0) [0|0.20943951] "rad"  IFV
 SG_ CAN_FL_DET_AMPLITUDE_010 : 199|7@0+ (1,-64) [-64|63] "dBsm"  IFV
 SG_ CAN_FL_DET_VALID_FLAG_010 : 192|1@0+ (1,0) [0|1] ""  IFV
 SG_ CAN_FL_DET_SUPER_RES_010 : 200|1@0+ (1,0) [0|1] ""  IFV
 SG_ CAN_FL_DET_LOW_SNR_FLAG_010 : 201|1@0+ (1,0) [0|1] ""  IFV
 SG_ CAN_FL_DET_MIXER_BIAS_FLAG_010 : 202|1@0+ (1,0) [0|1] ""  IFV
 SG_ CAN_FL_DET_RESERVED_FLAGS_010 : 207|5@0+ (1,0) [0|31] ""  IFV
 SG_ CAN_FL_DET_SNR_010 : 215|8@0+ (0.35156,0) [0|89.6478] "dB"  IFV
 SG_ CAN_FL_DET_MULTI_TARGET_PROB_010 : 219|4@0+ (0.06667,0) [0|1] ""  IFV
 SG_ CAN_FL_DET_CONFID_AZIMUTH_010 : 221|2@0+ (1,0) [0|3] ""  IFV
 SG_ CAN_FL_DET_CONFID_ELEVATION_010 : 223|2@0+ (1,0) [0|3] ""  IFV
 SG_ CAN_FL_DET_EXISTENCE_PROB_010 : 227|4@0+ (1,0) [0|15] ""  IFV
 SG_ CAN_FL_DET_CLASS_010 : 231|4@0+ (1,0) [0|15] ""  IFV
 SG_ CAN_FL_DET_RANGE_011 : 247|14@0+ (0.015625,0) [0|255.984375] "m"  IFV
 SG_ CAN_FL_DET_SD_RANGE_011 : 249|6@0+ (0.025,0) [0|1.5] "m"  IFV
 SG_ CAN_FL_DET_RANGE_RATE_011 : 259|14@0+ (0.015625,-128) [-128|127.984375] "m/s"  IFV
 SG_ CAN_FL_DET_SD_RANGE_RATE_011 : 277|6@0+ (0.02,0) [0|1.2] "m/s"  IFV
 SG_ CAN_FL_DET_AZIMUTH_011 : 287|13@0+ (0.0007668,-3.141593) [-3.141593|3.141593] "rad"  IFV
 SG_ CAN_FL_DET_SD_AZIMUTH_011 : 290|6@0+ (0.001745329,0) [0|0.104719755] "rad"  IFV
 SG_ CAN_FL_DET_ELEVATION_011 : 300|7@0+ (0.157449,-9.99812) [-9.99812|9.997903] "deg"  IFV
 SG_ CAN_FL_DET_SD_ELEVATION_011 : 309|6@0+ (0.003490659,0) [0|0.20943951] "rad"  IFV
 SG_ CAN_FL_DET_AMPLITUDE_011 : 319|7@0+ (1,-64) [-64|63] "dBsm"  IFV
 SG_ CAN_FL_DET_VALID_FLAG_011 : 312|1@0+ (1,0) [0|1] ""  IFV
 SG_ CAN_FL_DET_SUPER_RES_011 : 320|1@0+ (1,0) [0|1] ""  IFV
 SG_ CAN_FL_DET_LOW_SNR_FLAG_011 : 321|1@0+ (1,0) [0|1] ""  IFV
 SG_ CAN_FL_DET_MIXER_BIAS_FLAG_011 : 322|1@0+ (1,0) [0|1] ""  IFV
 SG_ CAN_FL_DET_RESERVED_FLAGS_011 : 327|5@0+ (1,0) [0|31] ""  IFV
 SG_ CAN_FL_DET_SNR_011 : 335|8@0+ (0.35156,0) [0|89.6478] "dB"  IFV
 SG_ CAN_FL_DET_MULTI_TARGET_PROB_011 : 339|4@0+ (0.06667,0) [0|1] ""  IFV
 SG_ CAN_FL_DET_CONFID_AZIMUTH_011 : 341|2@0+ (1,0) [0|3] ""  IFV
 SG_ CAN_FL_DET_CONFID_ELEVATION_011 : 343|2@0+ (1,0) [0|3] ""  IFV
 SG_ CAN_FL_DET_EXISTENCE_PROB_011 : 347|4@0+ (1,0) [0|15] ""  IFV
 SG_ CAN_FL_DET_CLASS_011 : 351|4@0+ (1,0) [0|15] ""  IFV
 SG_ CAN_FL_DET_RANGE_012 : 367|14@0+ (0.015625,0) [0|255.984375] "m"  IFV
 SG_ CAN_FL_DET_SD_RANGE_012 : 369|6@0+ (0.025,0) [0|1.5] "m"  IFV
 SG_ CAN_FL_DET_RANGE_RATE_012 : 379|14@0+ (0.015625,-128) [-128|127.984375] "m/s"  IFV
 SG_ CAN_FL_DET_SD_RANGE_RATE_012 : 397|6@0+ (0.02,0) [0|1.2] "m/s"  IFV
 SG_ CAN_FL_DET_AZIMUTH_012 : 407|13@0+ (0.0007668,-3.141593) [-3.141593|3.141593] "rad"  IFV
 SG_ CAN_FL_DET_SD_AZIMUTH_012 : 410|6@0+ (0.001745329,0) [0|0.104719755] "rad"  IFV
 SG_ CAN_FL_DET_ELEVATION_012 : 420|7@0+ (0.157449,-9.99812) [-9.99812|9.997903] "deg"  IFV
 SG_ CAN_FL_DET_SD_ELEVATION_012 : 429|6@0+ (0.003490659,0) [0|0.20943951] "rad"  IFV
 SG_ CAN_FL_DET_AMPLITUDE_012 : 439|7@0+ (1,-64) [-64|63] "dBsm"  IFV
 SG_ CAN_FL_DET_VALID_FLAG_012 : 432|1@0+ (1,0) [0|1] ""  IFV
 SG_ CAN_FL_DET_SUPER_RES_012 : 440|1@0+ (1,0) [0|1] ""  IFV
 SG_ CAN_FL_DET_LOW_SNR_FLAG_012 : 441|1@0+ (1,0) [0|1] ""  IFV
 SG_ CAN_FL_DET_MIXER_BIAS_FLAG_012 : 442|1@0+ (1,0) [0|1] ""  IFV
 SG_ CAN_FL_DET_RESERVED_FLAGS_012 : 447|5@0+ (1,0) [0|31] ""  IFV
 SG_ CAN_FL_DET_SNR_012 : 455|8@0+ (0.35156,0) [0|89.6478] "dB"  IFV
 SG_ CAN_FL_DET_MULTI_TARGET_PROB_012 : 459|4@0+ (0.06667,0) [0|1] ""  IFV
 SG_ CAN_FL_DET_CONFID_AZIMUTH_012 : 461|2@0+ (1,0) [0|3] ""  IFV
 SG_ CAN_FL_DET_CONFID_ELEVATION_012 : 463|2@0+ (1,0) [0|3] ""  IFV
 SG_ CAN_FL_DET_EXISTENCE_PROB_012 : 467|4@0+ (1,0) [0|15] ""  IFV
 SG_ CAN_FL_DET_CLASS_012 : 471|4@0+ (1,0) [0|15] ""  IFV

BO_ 771 SODFL_DETECTION_013_016: 64 SODFL
 SG_ CAN_FL_DET_RANGE_013 : 7|14@0+ (0.015625,0) [0|255.984375] "m"  IFV
 SG_ CAN_FL_DET_SD_RANGE_013 : 9|6@0+ (0.025,0) [0|1.5] "m"  IFV
 SG_ CAN_FL_DET_RANGE_RATE_013 : 19|14@0+ (0.015625,-128) [-128|127.984375] "m/s"  IFV
 SG_ CAN_FL_DET_SD_RANGE_RATE_013 : 37|6@0+ (0.02,0) [0|1.2] "m/s"  IFV
 SG_ CAN_FL_DET_AZIMUTH_013 : 47|13@0+ (0.0007668,-3.141593) [-3.141593|3.141593] "rad"  IFV
 SG_ CAN_FL_DET_SD_AZIMUTH_013 : 50|6@0+ (0.001745329,0) [0|0.104719755] "rad"  IFV
 SG_ CAN_FL_DET_ELEVATION_013 : 60|7@0+ (0.157449,-9.99812) [-9.99812|9.997903] "deg"  IFV
 SG_ CAN_FL_DET_SD_ELEVATION_013 : 69|6@0+ (0.003490659,0) [0|0.20943951] "rad"  IFV
 SG_ CAN_FL_DET_AMPLITUDE_013 : 79|7@0+ (1,-64) [-64|63] "dBsm"  IFV
 SG_ CAN_FL_DET_VALID_FLAG_013 : 72|1@0+ (1,0) [0|1] ""  IFV
 SG_ CAN_FL_DET_SUPER_RES_013 : 80|1@0+ (1,0) [0|1] ""  IFV
 SG_ CAN_FL_DET_LOW_SNR_FLAG_013 : 81|1@0+ (1,0) [0|1] ""  IFV
 SG_ CAN_FL_DET_MIXER_BIAS_FLAG_013 : 82|1@0+ (1,0) [0|1] ""  IFV
 SG_ CAN_FL_DET_RESERVED_FLAGS_013 : 87|5@0+ (1,0) [0|31] ""  IFV
 SG_ CAN_FL_DET_SNR_013 : 95|8@0+ (0.35156,0) [0|89.6478] "dB"  IFV
 SG_ CAN_FL_DET_MULTI_TARGET_PROB_013 : 99|4@0+ (0.06667,0) [0|1] ""  IFV
 SG_ CAN_FL_DET_CONFID_AZIMUTH_013 : 101|2@0+ (1,0) [0|3] ""  IFV
 SG_ CAN_FL_DET_CONFID_ELEVATION_013 : 103|2@0+ (1,0) [0|3] ""  IFV
 SG_ CAN_FL_DET_EXISTENCE_PROB_013 : 107|4@0+ (1,0) [0|15] ""  IFV
 SG_ CAN_FL_DET_CLASS_013 : 111|4@0+ (1,0) [0|15] ""  IFV
 SG_ CAN_FL_DET_RANGE_014 : 127|14@0+ (0.015625,0) [0|255.984375] "m"  IFV
 SG_ CAN_FL_DET_SD_RANGE_014 : 129|6@0+ (0.025,0) [0|1.5] "m"  IFV
 SG_ CAN_FL_DET_RANGE_RATE_014 : 139|14@0+ (0.015625,-128) [-128|127.984375] "m/s"  IFV
 SG_ CAN_FL_DET_SD_RANGE_RATE_014 : 157|6@0+ (0.02,0) [0|1.2] "m/s"  IFV
 SG_ CAN_FL_DET_AZIMUTH_014 : 167|13@0+ (0.0007668,-3.141593) [-3.141593|3.141593] "rad"  IFV
 SG_ CAN_FL_DET_SD_AZIMUTH_014 : 170|6@0+ (0.001745329,0) [0|0.104719755] "rad"  IFV
 SG_ CAN_FL_DET_ELEVATION_014 : 180|7@0+ (0.157449,-9.99812) [-9.99812|9.997903] "deg"  IFV
 SG_ CAN_FL_DET_SD_ELEVATION_014 : 189|6@0+ (0.003490659,0) [0|0.20943951] "rad"  IFV
 SG_ CAN_FL_DET_AMPLITUDE_014 : 199|7@0+ (1,-64) [-64|63] "dBsm"  IFV
 SG_ CAN_FL_DET_VALID_FLAG_014 : 192|1@0+ (1,0) [0|1] ""  IFV
 SG_ CAN_FL_DET_SUPER_RES_014 : 200|1@0+ (1,0) [0|1] ""  IFV
 SG_ CAN_FL_DET_LOW_SNR_FLAG_014 : 201|1@0+ (1,0) [0|1] ""  IFV
 SG_ CAN_FL_DET_MIXER_BIAS_FLAG_014 : 202|1@0+ (1,0) [0|1] ""  IFV
 SG_ CAN_FL_DET_RESERVED_FLAGS_014 : 207|5@0+ (1,0) [0|31] ""  IFV
 SG_ CAN_FL_DET_SNR_014 : 215|8@0+ (0.35156,0) [0|89.6478] "dB"  IFV
 SG_ CAN_FL_DET_MULTI_TARGET_PROB_014 : 219|4@0+ (0.06667,0) [0|1] ""  IFV
 SG_ CAN_FL_DET_CONFID_AZIMUTH_014 : 221|2@0+ (1,0) [0|3] ""  IFV
 SG_ CAN_FL_DET_CONFID_ELEVATION_014 : 223|2@0+ (1,0) [0|3] ""  IFV
 SG_ CAN_FL_DET_EXISTENCE_PROB_014 : 227|4@0+ (1,0) [0|15] ""  IFV
 SG_ CAN_FL_DET_CLASS_014 : 231|4@0+ (1,0) [0|15] ""  IFV
 SG_ CAN_FL_DET_RANGE_015 : 247|14@0+ (0.015625,0) [0|255.984375] "m"  IFV
 SG_ CAN_FL_DET_SD_RANGE_015 : 249|6@0+ (0.025,0) [0|1.5] "m"  IFV
 SG_ CAN_FL_DET_RANGE_RATE_015 : 259|14@0+ (0.015625,-128) [-128|127.984375] "m/s"  IFV
 SG_ CAN_FL_DET_SD_RANGE_RATE_015 : 277|6@0+ (0.02,0) [0|1.2] "m/s"  IFV
 SG_ CAN_FL_DET_AZIMUTH_015 : 287|13@0+ (0.0007668,-3.141593) [-3.141593|3.141593] "rad"  IFV
 SG_ CAN_FL_DET_SD_AZIMUTH_015 : 290|6@0+ (0.001745329,0) [0|0.104719755] "rad"  IFV
 SG_ CAN_FL_DET_ELEVATION_015 : 300|7@0+ (0.157449,-9.99812) [-9.99812|9.997903] "deg"  IFV
 SG_ CAN_FL_DET_SD_ELEVATION_015 : 309|6@0+ (0.003490659,0) [0|0.20943951] "rad"  IFV
 SG_ CAN_FL_DET_AMPLITUDE_015 : 319|7@0+ (1,-64) [-64|63] "dBsm"  IFV
 SG_ CAN_FL_DET_VALID_FLAG_015 : 312|1@0+ (1,0) [0|1] ""  IFV
 SG_ CAN_FL_DET_SUPER_RES_015 : 320|1@0+ (1,0) [0|1] ""  IFV
 SG_ CAN_FL_DET_LOW_SNR_FLAG_015 : 321|1@0+ (1,0) [0|1] ""  IFV
 SG_ CAN_FL_DET_MIXER_BIAS_FLAG_015 : 322|1@0+ (1,0) [0|1] ""  IFV
 SG_ CAN_FL_DET_RESERVED_FLAGS_015 : 327|5@0+ (1,0) [0|31] ""  IFV
 SG_ CAN_FL_DET_SNR_015 : 335|8@0+ (0.35156,0) [0|89.6478] "dB"  IFV
 SG_ CAN_FL_DET_MULTI_TARGET_PROB_015 : 339|4@0+ (0.06667,0) [0|1] ""  IFV
 SG_ CAN_FL_DET_CONFID_AZIMUTH_015 : 341|2@0+ (1,0) [0|3] ""  IFV
 SG_ CAN_FL_DET_CONFID_ELEVATION_015 : 343|2@0+ (1,0) [0|3] ""  IFV
 SG_ CAN_FL_DET_EXISTENCE_PROB_015 : 347|4@0+ (1,0) [0|15] ""  IFV
 SG_ CAN_FL_DET_CLASS_015 : 351|4@0+ (1,0) [0|15] ""  IFV
 SG_ CAN_FL_DET_RANGE_016 : 367|14@0+ (0.015625,0) [0|255.984375] "m"  IFV
 SG_ CAN_FL_DET_SD_RANGE_016 : 369|6@0+ (0.025,0) [0|1.5] "m"  IFV
 SG_ CAN_FL_DET_RANGE_RATE_016 : 379|14@0+ (0.015625,-128) [-128|127.984375] "m/s"  IFV
 SG_ CAN_FL_DET_SD_RANGE_RATE_016 : 397|6@0+ (0.02,0) [0|1.2] "m/s"  IFV
 SG_ CAN_FL_DET_AZIMUTH_016 : 407|13@0+ (0.0007668,-3.141593) [-3.141593|3.141593] "rad"  IFV
 SG_ CAN_FL_DET_SD_AZIMUTH_016 : 410|6@0+ (0.001745329,0) [0|0.104719755] "rad"  IFV
 SG_ CAN_FL_DET_ELEVATION_016 : 420|7@0+ (0.157449,-9.99812) [-9.99812|9.997903] "deg"  IFV
 SG_ CAN_FL_DET_SD_ELEVATION_016 : 429|6@0+ (0.003490659,0) [0|0.20943951] "rad"  IFV
 SG_ CAN_FL_DET_AMPLITUDE_016 : 439|7@0+ (1,-64) [-64|63] "dBsm"  IFV
 SG_ CAN_FL_DET_VALID_FLAG_016 : 432|1@0+ (1,0) [0|1] ""  IFV
 SG_ CAN_FL_DET_SUPER_RES_016 : 440|1@0+ (1,0) [0|1] ""  IFV
 SG_ CAN_FL_DET_LOW_SNR_FLAG_016 : 441|1@0+ (1,0) [0|1] ""  IFV
 SG_ CAN_FL_DET_MIXER_BIAS_FLAG_016 : 442|1@0+ (1,0) [0|1] ""  IFV
 SG_ CAN_FL_DET_RESERVED_FLAGS_016 : 447|5@0+ (1,0) [0|31] ""  IFV
 SG_ CAN_FL_DET_SNR_016 : 455|8@0+ (0.35156,0) [0|89.6478] "dB"  IFV
 SG_ CAN_FL_DET_MULTI_TARGET_PROB_016 : 459|4@0+ (0.06667,0) [0|1] ""  IFV
 SG_ CAN_FL_DET_CONFID_AZIMUTH_016 : 461|2@0+ (1,0) [0|3] ""  IFV
 SG_ CAN_FL_DET_CONFID_ELEVATION_016 : 463|2@0+ (1,0) [0|3] ""  IFV
 SG_ CAN_FL_DET_EXISTENCE_PROB_016 : 467|4@0+ (1,0) [0|15] ""  IFV
 SG_ CAN_FL_DET_CLASS_016 : 471|4@0+ (1,0) [0|15] ""  IFV

BO_ 772 SODFL_DETECTION_017_020: 64 SODFL
 SG_ CAN_FL_DET_RANGE_017 : 7|14@0+ (0.015625,0) [0|255.984375] "m"  IFV
 SG_ CAN_FL_DET_SD_RANGE_017 : 9|6@0+ (0.025,0) [0|1.5] "m"  IFV
 SG_ CAN_FL_DET_RANGE_RATE_017 : 19|14@0+ (0.015625,-128) [-128|127.984375] "m/s"  IFV
 SG_ CAN_FL_DET_SD_RANGE_RATE_017 : 37|6@0+ (0.02,0) [0|1.2] "m/s"  IFV
 SG_ CAN_FL_DET_AZIMUTH_017 : 47|13@0+ (0.0007668,-3.141593) [-3.141593|3.141593] "rad"  IFV
 SG_ CAN_FL_DET_SD_AZIMUTH_017 : 50|6@0+ (0.001745329,0) [0|0.104719755] "rad"  IFV
 SG_ CAN_FL_DET_ELEVATION_017 : 60|7@0+ (0.157449,-9.99812) [-9.99812|9.997903] "deg"  IFV
 SG_ CAN_FL_DET_SD_ELEVATION_017 : 69|6@0+ (0.003490659,0) [0|0.20943951] "rad"  IFV
 SG_ CAN_FL_DET_AMPLITUDE_017 : 79|7@0+ (1,-64) [-64|63] "dBsm"  IFV
 SG_ CAN_FL_DET_VALID_FLAG_017 : 72|1@0+ (1,0) [0|1] ""  IFV
 SG_ CAN_FL_DET_SUPER_RES_017 : 80|1@0+ (1,0) [0|1] ""  IFV
 SG_ CAN_FL_DET_LOW_SNR_FLAG_017 : 81|1@0+ (1,0) [0|1] ""  IFV
 SG_ CAN_FL_DET_MIXER_BIAS_FLAG_017 : 82|1@0+ (1,0) [0|1] ""  IFV
 SG_ CAN_FL_DET_RESERVED_FLAGS_017 : 87|5@0+ (1,0) [0|31] ""  IFV
 SG_ CAN_FL_DET_SNR_017 : 95|8@0+ (0.35156,0) [0|89.6478] "dB"  IFV
 SG_ CAN_FL_DET_MULTI_TARGET_PROB_017 : 99|4@0+ (0.06667,0) [0|1] ""  IFV
 SG_ CAN_FL_DET_CONFID_AZIMUTH_017 : 101|2@0+ (1,0) [0|3] ""  IFV
 SG_ CAN_FL_DET_CONFID_ELEVATION_017 : 103|2@0+ (1,0) [0|3] ""  IFV
 SG_ CAN_FL_DET_EXISTENCE_PROB_017 : 107|4@0+ (1,0) [0|15] ""  IFV
 SG_ CAN_FL_DET_CLASS_017 : 111|4@0+ (1,0) [0|15] ""  IFV
 SG_ CAN_FL_DET_RANGE_018 : 127|14@0+ (0.015625,0) [0|255.984375] "m"  IFV
 SG_ CAN_FL_DET_SD_RANGE_018 : 129|6@0+ (0.025,0) [0|1.5] "m"  IFV
 SG_ CAN_FL_DET_RANGE_RATE_018 : 139|14@0+ (0.015625,-128) [-128|127.984375] "m/s"  IFV
 SG_ CAN_FL_DET_SD_RANGE_RATE_018 : 157|6@0+ (0.02,0) [0|1.2] "m/s"  IFV
 SG_ CAN_FL_DET_AZIMUTH_018 : 167|13@0+ (0.0007668,-3.141593) [-3.141593|3.141593] "rad"  IFV
 SG_ CAN_FL_DET_SD_AZIMUTH_018 : 170|6@0+ (0.001745329,0) [0|0.104719755] "rad"  IFV
 SG_ CAN_FL_DET_ELEVATION_018 : 180|7@0+ (0.157449,-9.99812) [-9.99812|9.997903] "deg"  IFV
 SG_ CAN_FL_DET_SD_ELEVATION_018 : 189|6@0+ (0.003490659,0) [0|0.20943951] "rad"  IFV
 SG_ CAN_FL_DET_AMPLITUDE_018 : 199|7@0+ (1,-64) [-64|63] "dBsm"  IFV
 SG_ CAN_FL_DET_VALID_FLAG_018 : 192|1@0+ (1,0) [0|1] ""  IFV
 SG_ CAN_FL_DET_SUPER_RES_018 : 200|1@0+ (1,0) [0|1] ""  IFV
 SG_ CAN_FL_DET_LOW_SNR_FLAG_018 : 201|1@0+ (1,0) [0|1] ""  IFV
 SG_ CAN_FL_DET_MIXER_BIAS_FLAG_018 : 202|1@0+ (1,0) [0|1] ""  IFV
 SG_ CAN_FL_DET_RESERVED_FLAGS_018 : 207|5@0+ (1,0) [0|31] ""  IFV
 SG_ CAN_FL_DET_SNR_018 : 215|8@0+ (0.35156,0) [0|89.6478] "dB"  IFV
 SG_ CAN_FL_DET_MULTI_TARGET_PROB_018 : 219|4@0+ (0.06667,0) [0|1] ""  IFV
 SG_ CAN_FL_DET_CONFID_AZIMUTH_018 : 221|2@0+ (1,0) [0|3] ""  IFV
 SG_ CAN_FL_DET_CONFID_ELEVATION_018 : 223|2@0+ (1,0) [0|3] ""  IFV
 SG_ CAN_FL_DET_EXISTENCE_PROB_018 : 227|4@0+ (1,0) [0|15] ""  IFV
 SG_ CAN_FL_DET_CLASS_018 : 231|4@0+ (1,0) [0|15] ""  IFV
 SG_ CAN_FL_DET_RANGE_019 : 247|14@0+ (0.015625,0) [0|255.984375] "m"  IFV
 SG_ CAN_FL_DET_SD_RANGE_019 : 249|6@0+ (0.025,0) [0|1.5] "m"  IFV
 SG_ CAN_FL_DET_RANGE_RATE_019 : 259|14@0+ (0.015625,-128) [-128|127.984375] "m/s"  IFV
 SG_ CAN_FL_DET_SD_RANGE_RATE_019 : 277|6@0+ (0.02,0) [0|1.2] "m/s"  IFV
 SG_ CAN_FL_DET_AZIMUTH_019 : 287|13@0+ (0.0007668,-3.141593) [-3.141593|3.141593] "rad"  IFV
 SG_ CAN_FL_DET_SD_AZIMUTH_019 : 290|6@0+ (0.001745329,0) [0|0.104719755] "rad"  IFV
 SG_ CAN_FL_DET_ELEVATION_019 : 300|7@0+ (0.157449,-9.99812) [-9.99812|9.997903] "deg"  IFV
 SG_ CAN_FL_DET_SD_ELEVATION_019 : 309|6@0+ (0.003490659,0) [0|0.20943951] "rad"  IFV
 SG_ CAN_FL_DET_AMPLITUDE_019 : 319|7@0+ (1,-64) [-64|63] "dBsm"  IFV
 SG_ CAN_FL_DET_VALID_FLAG_019 : 312|1@0+ (1,0) [0|1] ""  IFV
 SG_ CAN_FL_DET_SUPER_RES_019 : 320|1@0+ (1,0) [0|1] ""  IFV
 SG_ CAN_FL_DET_LOW_SNR_FLAG_019 : 321|1@0+ (1,0) [0|1] ""  IFV
 SG_ CAN_FL_DET_MIXER_BIAS_FLAG_019 : 322|1@0+ (1,0) [0|1] ""  IFV
 SG_ CAN_FL_DET_RESERVED_FLAGS_019 : 327|5@0+ (1,0) [0|31] ""  IFV
 SG_ CAN_FL_DET_SNR_019 : 335|8@0+ (0.35156,0) [0|89.6478] "dB"  IFV
 SG_ CAN_FL_DET_MULTI_TARGET_PROB_019 : 339|4@0+ (0.06667,0) [0|1] ""  IFV
 SG_ CAN_FL_DET_CONFID_AZIMUTH_019 : 341|2@0+ (1,0) [0|3] ""  IFV
 SG_ CAN_FL_DET_CONFID_ELEVATION_019 : 343|2@0+ (1,0) [0|3] ""  IFV
 SG_ CAN_FL_DET_EXISTENCE_PROB_019 : 347|4@0+ (1,0) [0|15] ""  IFV
 SG_ CAN_FL_DET_CLASS_019 : 351|4@0+ (1,0) [0|15] ""  IFV
 SG_ CAN_FL_DET_RANGE_020 : 367|14@0+ (0.015625,0) [0|255.984375] "m"  IFV
 SG_ CAN_FL_DET_SD_RANGE_020 : 369|6@0+ (0.025,0) [0|1.5] "m"  IFV
 SG_ CAN_FL_DET_RANGE_RATE_020 : 379|14@0+ (0.015625,-128) [-128|127.984375] "m/s"  IFV
 SG_ CAN_FL_DET_SD_RANGE_RATE_020 : 397|6@0+ (0.02,0) [0|1.2] "m/s"  IFV
 SG_ CAN_FL_DET_AZIMUTH_020 : 407|13@0+ (0.0007668,-3.141593) [-3.141593|3.141593] "rad"  IFV
 SG_ CAN_FL_DET_SD_AZIMUTH_020 : 410|6@0+ (0.001745329,0) [0|0.104719755] "rad"  IFV
 SG_ CAN_FL_DET_ELEVATION_020 : 420|7@0+ (0.157449,-9.99812) [-9.99812|9.997903] "deg"  IFV
 SG_ CAN_FL_DET_SD_ELEVATION_020 : 429|6@0+ (0.003490659,0) [0|0.20943951] "rad"  IFV
 SG_ CAN_FL_DET_AMPLITUDE_020 : 439|7@0+ (1,-64) [-64|63] "dBsm"  IFV
 SG_ CAN_FL_DET_VALID_FLAG_020 : 432|1@0+ (1,0) [0|1] ""  IFV
 SG_ CAN_FL_DET_SUPER_RES_020 : 440|1@0+ (1,0) [0|1] ""  IFV
 SG_ CAN_FL_DET_LOW_SNR_FLAG_020 : 441|1@0+ (1,0) [0|1] ""  IFV
 SG_ CAN_FL_DET_MIXER_BIAS_FLAG_020 : 442|1@0+ (1,0) [0|1] ""  IFV
 SG_ CAN_FL_DET_RESERVED_FLAGS_020 : 447|5@0+ (1,0) [0|31] ""  IFV
 SG_ CAN_FL_DET_SNR_020 : 455|8@0+ (0.35156,0) [0|89.6478] "dB"  IFV
 SG_ CAN_FL_DET_MULTI_TARGET_PROB_020 : 459|4@0+ (0.06667,0) [0|1] ""  IFV
 SG_ CAN_FL_DET_CONFID_AZIMUTH_020 : 461|2@0+ (1,0) [0|3] ""  IFV
 SG_ CAN_FL_DET_CONFID_ELEVATION_020 : 463|2@0+ (1,0) [0|3] ""  IFV
 SG_ CAN_FL_DET_EXISTENCE_PROB_020 : 467|4@0+ (1,0) [0|15] ""  IFV
 SG_ CAN_FL_DET_CLASS_020 : 471|4@0+ (1,0) [0|15] ""  IFV

BO_ 773 SODFL_DETECTION_021_024: 64 SODFL
 SG_ CAN_FL_DET_RANGE_021 : 7|14@0+ (0.015625,0) [0|255.984375] "m"  IFV
 SG_ CAN_FL_DET_SD_RANGE_021 : 9|6@0+ (0.025,0) [0|1.5] "m"  IFV
 SG_ CAN_FL_DET_RANGE_RATE_021 : 19|14@0+ (0.015625,-128) [-128|127.984375] "m/s"  IFV
 SG_ CAN_FL_DET_SD_RANGE_RATE_021 : 37|6@0+ (0.02,0) [0|1.2] "m/s"  IFV
 SG_ CAN_FL_DET_AZIMUTH_021 : 47|13@0+ (0.0007668,-3.141593) [-3.141593|3.141593] "rad"  IFV
 SG_ CAN_FL_DET_SD_AZIMUTH_021 : 50|6@0+ (0.001745329,0) [0|0.104719755] "rad"  IFV
 SG_ CAN_FL_DET_ELEVATION_021 : 60|7@0+ (0.157449,-9.99812) [-9.99812|9.997903] "deg"  IFV
 SG_ CAN_FL_DET_SD_ELEVATION_021 : 69|6@0+ (0.003490659,0) [0|0.20943951] "rad"  IFV
 SG_ CAN_FL_DET_AMPLITUDE_021 : 79|7@0+ (1,-64) [-64|63] "dBsm"  IFV
 SG_ CAN_FL_DET_VALID_FLAG_021 : 72|1@0+ (1,0) [0|1] ""  IFV
 SG_ CAN_FL_DET_SUPER_RES_021 : 80|1@0+ (1,0) [0|1] ""  IFV
 SG_ CAN_FL_DET_LOW_SNR_FLAG_021 : 81|1@0+ (1,0) [0|1] ""  IFV
 SG_ CAN_FL_DET_MIXER_BIAS_FLAG_021 : 82|1@0+ (1,0) [0|1] ""  IFV
 SG_ CAN_FL_DET_RESERVED_FLAGS_021 : 87|5@0+ (1,0) [0|31] ""  IFV
 SG_ CAN_FL_DET_SNR_021 : 95|8@0+ (0.35156,0) [0|89.6478] "dB"  IFV
 SG_ CAN_FL_DET_MULTI_TARGET_PROB_021 : 99|4@0+ (0.06667,0) [0|1] ""  IFV
 SG_ CAN_FL_DET_CONFID_AZIMUTH_021 : 101|2@0+ (1,0) [0|3] ""  IFV
 SG_ CAN_FL_DET_CONFID_ELEVATION_021 : 103|2@0+ (1,0) [0|3] ""  IFV
 SG_ CAN_FL_DET_EXISTENCE_PROB_021 : 107|4@0+ (1,0) [0|15] ""  IFV
 SG_ CAN_FL_DET_CLASS_021 : 111|4@0+ (1,0) [0|15] ""  IFV
 SG_ CAN_FL_DET_RANGE_022 : 127|14@0+ (0.015625,0) [0|255.984375] "m"  IFV
 SG_ CAN_FL_DET_SD_RANGE_022 : 129|6@0+ (0.025,0) [0|1.5] "m"  IFV
 SG_ CAN_FL_DET_RANGE_RATE_022 : 139|14@0+ (0.015625,-128) [-128|127.984375] "m/s"  IFV
 SG_ CAN_FL_DET_SD_RANGE_RATE_022 : 157|6@0+ (0.02,0) [0|1.2] "m/s"  IFV
 SG_ CAN_FL_DET_AZIMUTH_022 : 167|13@0+ (0.0007668,-3.141593) [-3.141593|3.141593] "rad"  IFV
 SG_ CAN_FL_DET_SD_AZIMUTH_022 : 170|6@0+ (0.001745329,0) [0|0.104719755] "rad"  IFV
 SG_ CAN_FL_DET_ELEVATION_022 : 180|7@0+ (0.157449,-9.99812) [-9.99812|9.997903] "deg"  IFV
 SG_ CAN_FL_DET_SD_ELEVATION_022 : 189|6@0+ (0.003490659,0) [0|0.20943951] "rad"  IFV
 SG_ CAN_FL_DET_AMPLITUDE_022 : 199|7@0+ (1,-64) [-64|63] "dBsm"  IFV
 SG_ CAN_FL_DET_VALID_FLAG_022 : 192|1@0+ (1,0) [0|1] ""  IFV
 SG_ CAN_FL_DET_SUPER_RES_022 : 200|1@0+ (1,0) [0|1] ""  IFV
 SG_ CAN_FL_DET_LOW_SNR_FLAG_022 : 201|1@0+ (1,0) [0|1] ""  IFV
 SG_ CAN_FL_DET_MIXER_BIAS_FLAG_022 : 202|1@0+ (1,0) [0|1] ""  IFV
 SG_ CAN_FL_DET_RESERVED_FLAGS_022 : 207|5@0+ (1,0) [0|31] ""  IFV
 SG_ CAN_FL_DET_SNR_022 : 215|8@0+ (0.35156,0) [0|89.6478] "dB"  IFV
 SG_ CAN_FL_DET_MULTI_TARGET_PROB_022 : 219|4@0+ (0.06667,0) [0|1] ""  IFV
 SG_ CAN_FL_DET_CONFID_AZIMUTH_022 : 221|2@0+ (1,0) [0|3] ""  IFV
 SG_ CAN_FL_DET_CONFID_ELEVATION_022 : 223|2@0+ (1,0) [0|3] ""  IFV
 SG_ CAN_FL_DET_EXISTENCE_PROB_022 : 227|4@0+ (1,0) [0|15] ""  IFV
 SG_ CAN_FL_DET_CLASS_022 : 231|4@0+ (1,0) [0|15] ""  IFV
 SG_ CAN_FL_DET_RANGE_023 : 247|14@0+ (0.015625,0) [0|255.984375] "m"  IFV
 SG_ CAN_FL_DET_SD_RANGE_023 : 249|6@0+ (0.025,0) [0|1.5] "m"  IFV
 SG_ CAN_FL_DET_RANGE_RATE_023 : 259|14@0+ (0.015625,-128) [-128|127.984375] "m/s"  IFV
 SG_ CAN_FL_DET_SD_RANGE_RATE_023 : 277|6@0+ (0.02,0) [0|1.2] "m/s"  IFV
 SG_ CAN_FL_DET_AZIMUTH_023 : 287|13@0+ (0.0007668,-3.141593) [-3.141593|3.141593] "rad"  IFV
 SG_ CAN_FL_DET_SD_AZIMUTH_023 : 290|6@0+ (0.001745329,0) [0|0.104719755] "rad"  IFV
 SG_ CAN_FL_DET_ELEVATION_023 : 300|7@0+ (0.157449,-9.99812) [-9.99812|9.997903] "deg"  IFV
 SG_ CAN_FL_DET_SD_ELEVATION_023 : 309|6@0+ (0.003490659,0) [0|0.20943951] "rad"  IFV
 SG_ CAN_FL_DET_AMPLITUDE_023 : 319|7@0+ (1,-64) [-64|63] "dBsm"  IFV
 SG_ CAN_FL_DET_VALID_FLAG_023 : 312|1@0+ (1,0) [0|1] ""  IFV
 SG_ CAN_FL_DET_SUPER_RES_023 : 320|1@0+ (1,0) [0|1] ""  IFV
 SG_ CAN_FL_DET_LOW_SNR_FLAG_023 : 321|1@0+ (1,0) [0|1] ""  IFV
 SG_ CAN_FL_DET_MIXER_BIAS_FLAG_023 : 322|1@0+ (1,0) [0|1] ""  IFV
 SG_ CAN_FL_DET_RESERVED_FLAGS_023 : 327|5@0+ (1,0) [0|31] ""  IFV
 SG_ CAN_FL_DET_SNR_023 : 335|8@0+ (0.35156,0) [0|89.6478] "dB"  IFV
 SG_ CAN_FL_DET_MULTI_TARGET_PROB_023 : 339|4@0+ (0.06667,0) [0|1] ""  IFV
 SG_ CAN_FL_DET_CONFID_AZIMUTH_023 : 341|2@0+ (1,0) [0|3] ""  IFV
 SG_ CAN_FL_DET_CONFID_ELEVATION_023 : 343|2@0+ (1,0) [0|3] ""  IFV
 SG_ CAN_FL_DET_EXISTENCE_PROB_023 : 347|4@0+ (1,0) [0|15] ""  IFV
 SG_ CAN_FL_DET_CLASS_023 : 351|4@0+ (1,0) [0|15] ""  IFV
 SG_ CAN_FL_DET_RANGE_024 : 367|14@0+ (0.015625,0) [0|255.984375] "m"  IFV
 SG_ CAN_FL_DET_SD_RANGE_024 : 369|6@0+ (0.025,0) [0|1.5] "m"  IFV
 SG_ CAN_FL_DET_RANGE_RATE_024 : 379|14@0+ (0.015625,-128) [-128|127.984375] "m/s"  IFV
 SG_ CAN_FL_DET_SD_RANGE_RATE_024 : 397|6@0+ (0.02,0) [0|1.2] "m/s"  IFV
 SG_ CAN_FL_DET_AZIMUTH_024 : 407|13@0+ (0.0007668,-3.141593) [-3.141593|3.141593] "rad"  IFV
 SG_ CAN_FL_DET_SD_AZIMUTH_024 : 410|6@0+ (0.001745329,0) [0|0.104719755] "rad"  IFV
 SG_ CAN_FL_DET_ELEVATION_024 : 420|7@0+ (0.157449,-9.99812) [-9.99812|9.997903] "deg"  IFV
 SG_ CAN_FL_DET_SD_ELEVATION_024 : 429|6@0+ (0.003490659,0) [0|0.20943951] "rad"  IFV
 SG_ CAN_FL_DET_AMPLITUDE_024 : 439|7@0+ (1,-64) [-64|63] "dBsm"  IFV
 SG_ CAN_FL_DET_VALID_FLAG_024 : 432|1@0+ (1,0) [0|1] ""  IFV
 SG_ CAN_FL_DET_SUPER_RES_024 : 440|1@0+ (1,0) [0|1] ""  IFV
 SG_ CAN_FL_DET_LOW_SNR_FLAG_024 : 441|1@0+ (1,0) [0|1] ""  IFV
 SG_ CAN_FL_DET_MIXER_BIAS_FLAG_024 : 442|1@0+ (1,0) [0|1] ""  IFV
 SG_ CAN_FL_DET_RESERVED_FLAGS_024 : 447|5@0+ (1,0) [0|31] ""  IFV
 SG_ CAN_FL_DET_SNR_024 : 455|8@0+ (0.35156,0) [0|89.6478] "dB"  IFV
 SG_ CAN_FL_DET_MULTI_TARGET_PROB_024 : 459|4@0+ (0.06667,0) [0|1] ""  IFV
 SG_ CAN_FL_DET_CONFID_AZIMUTH_024 : 461|2@0+ (1,0) [0|3] ""  IFV
 SG_ CAN_FL_DET_CONFID_ELEVATION_024 : 463|2@0+ (1,0) [0|3] ""  IFV
 SG_ CAN_FL_DET_EXISTENCE_PROB_024 : 467|4@0+ (1,0) [0|15] ""  IFV
 SG_ CAN_FL_DET_CLASS_024 : 471|4@0+ (1,0) [0|15] ""  IFV

BO_ 774 SODFL_DETECTION_025_028: 64 SODFL
 SG_ CAN_FL_DET_RANGE_025 : 7|14@0+ (0.015625,0) [0|255.984375] "m"  IFV
 SG_ CAN_FL_DET_SD_RANGE_025 : 9|6@0+ (0.025,0) [0|1.5] "m"  IFV
 SG_ CAN_FL_DET_RANGE_RATE_025 : 19|14@0+ (0.015625,-128) [-128|127.984375] "m/s"  IFV
 SG_ CAN_FL_DET_SD_RANGE_RATE_025 : 37|6@0+ (0.02,0) [0|1.2] "m/s"  IFV
 SG_ CAN_FL_DET_AZIMUTH_025 : 47|13@0+ (0.0007668,-3.141593) [-3.141593|3.141593] "rad"  IFV
 SG_ CAN_FL_DET_SD_AZIMUTH_025 : 50|6@0+ (0.001745329,0) [0|0.104719755] "rad"  IFV
 SG_ CAN_FL_DET_ELEVATION_025 : 60|7@0+ (0.157449,-9.99812) [-9.99812|9.997903] "deg"  IFV
 SG_ CAN_FL_DET_SD_ELEVATION_025 : 69|6@0+ (0.003490659,0) [0|0.20943951] "rad"  IFV
 SG_ CAN_FL_DET_AMPLITUDE_025 : 79|7@0+ (1,-64) [-64|63] "dBsm"  IFV
 SG_ CAN_FL_DET_VALID_FLAG_025 : 72|1@0+ (1,0) [0|1] ""  IFV
 SG_ CAN_FL_DET_SUPER_RES_025 : 80|1@0+ (1,0) [0|1] ""  IFV
 SG_ CAN_FL_DET_LOW_SNR_FLAG_025 : 81|1@0+ (1,0) [0|1] ""  IFV
 SG_ CAN_FL_DET_MIXER_BIAS_FLAG_025 : 82|1@0+ (1,0) [0|1] ""  IFV
 SG_ CAN_FL_DET_RESERVED_FLAGS_025 : 87|5@0+ (1,0) [0|31] ""  IFV
 SG_ CAN_FL_DET_SNR_025 : 95|8@0+ (0.35156,0) [0|89.6478] "dB"  IFV
 SG_ CAN_FL_DET_MULTI_TARGET_PROB_025 : 99|4@0+ (0.06667,0) [0|1] ""  IFV
 SG_ CAN_FL_DET_CONFID_AZIMUTH_025 : 101|2@0+ (1,0) [0|3] ""  IFV
 SG_ CAN_FL_DET_CONFID_ELEVATION_025 : 103|2@0+ (1,0) [0|3] ""  IFV
 SG_ CAN_FL_DET_EXISTENCE_PROB_025 : 107|4@0+ (1,0) [0|15] ""  IFV
 SG_ CAN_FL_DET_CLASS_025 : 111|4@0+ (1,0) [0|15] ""  IFV
 SG_ CAN_FL_DET_RANGE_026 : 127|14@0+ (0.015625,0) [0|255.984375] "m"  IFV
 SG_ CAN_FL_DET_SD_RANGE_026 : 129|6@0+ (0.025,0) [0|1.5] "m"  IFV
 SG_ CAN_FL_DET_RANGE_RATE_026 : 139|14@0+ (0.015625,-128) [-128|127.984375] "m/s"  IFV
 SG_ CAN_FL_DET_SD_RANGE_RATE_026 : 157|6@0+ (0.02,0) [0|1.2] "m/s"  IFV
 SG_ CAN_FL_DET_AZIMUTH_026 : 167|13@0+ (0.0007668,-3.141593) [-3.141593|3.141593] "rad"  IFV
 SG_ CAN_FL_DET_SD_AZIMUTH_026 : 170|6@0+ (0.001745329,0) [0|0.104719755] "rad"  IFV
 SG_ CAN_FL_DET_ELEVATION_026 : 180|7@0+ (0.157449,-9.99812) [-9.99812|9.997903] "deg"  IFV
 SG_ CAN_FL_DET_SD_ELEVATION_026 : 189|6@0+ (0.003490659,0) [0|0.20943951] "rad"  IFV
 SG_ CAN_FL_DET_AMPLITUDE_026 : 199|7@0+ (1,-64) [-64|63] "dBsm"  IFV
 SG_ CAN_FL_DET_VALID_FLAG_026 : 192|1@0+ (1,0) [0|1] ""  IFV
 SG_ CAN_FL_DET_SUPER_RES_026 : 200|1@0+ (1,0) [0|1] ""  IFV
 SG_ CAN_FL_DET_LOW_SNR_FLAG_026 : 201|1@0+ (1,0) [0|1] ""  IFV
 SG_ CAN_FL_DET_MIXER_BIAS_FLAG_026 : 202|1@0+ (1,0) [0|1] ""  IFV
 SG_ CAN_FL_DET_RESERVED_FLAGS_026 : 207|5@0+ (1,0) [0|31] ""  IFV
 SG_ CAN_FL_DET_SNR_026 : 215|8@0+ (0.35156,0) [0|89.6478] "dB"  IFV
 SG_ CAN_FL_DET_MULTI_TARGET_PROB_026 : 219|4@0+ (0.06667,0) [0|1] ""  IFV
 SG_ CAN_FL_DET_CONFID_AZIMUTH_026 : 221|2@0+ (1,0) [0|3] ""  IFV
 SG_ CAN_FL_DET_CONFID_ELEVATION_026 : 223|2@0+ (1,0) [0|3] ""  IFV
 SG_ CAN_FL_DET_EXISTENCE_PROB_026 : 227|4@0+ (1,0) [0|15] ""  IFV
 SG_ CAN_FL_DET_CLASS_026 : 231|4@0+ (1,0) [0|15] ""  IFV
 SG_ CAN_FL_DET_RANGE_027 : 247|14@0+ (0.015625,0) [0|255.984375] "m"  IFV
 SG_ CAN_FL_DET_SD_RANGE_027 : 249|6@0+ (0.025,0) [0|1.5] "m"  IFV
 SG_ CAN_FL_DET_RANGE_RATE_027 : 259|14@0+ (0.015625,-128) [-128|127.984375] "m/s"  IFV
 SG_ CAN_FL_DET_SD_RANGE_RATE_027 : 277|6@0+ (0.02,0) [0|1.2] "m/s"  IFV
 SG_ CAN_FL_DET_AZIMUTH_027 : 287|13@0+ (0.0007668,-3.141593) [-3.141593|3.141593] "rad"  IFV
 SG_ CAN_FL_DET_SD_AZIMUTH_027 : 290|6@0+ (0.001745329,0) [0|0.104719755] "rad"  IFV
 SG_ CAN_FL_DET_ELEVATION_027 : 300|7@0+ (0.157449,-9.99812) [-9.99812|9.997903] "deg"  IFV
 SG_ CAN_FL_DET_SD_ELEVATION_027 : 309|6@0+ (0.003490659,0) [0|0.20943951] "rad"  IFV
 SG_ CAN_FL_DET_AMPLITUDE_027 : 319|7@0+ (1,-64) [-64|63] "dBsm"  IFV
 SG_ CAN_FL_DET_VALID_FLAG_027 : 312|1@0+ (1,0) [0|1] ""  IFV
 SG_ CAN_FL_DET_SUPER_RES_027 : 320|1@0+ (1,0) [0|1] ""  IFV
 SG_ CAN_FL_DET_LOW_SNR_FLAG_027 : 321|1@0+ (1,0) [0|1] ""  IFV
 SG_ CAN_FL_DET_MIXER_BIAS_FLAG_027 : 322|1@0+ (1,0) [0|1] ""  IFV
 SG_ CAN_FL_DET_RESERVED_FLAGS_027 : 327|5@0+ (1,0) [0|31] ""  IFV
 SG_ CAN_FL_DET_SNR_027 : 335|8@0+ (0.35156,0) [0|89.6478] "dB"  IFV
 SG_ CAN_FL_DET_MULTI_TARGET_PROB_027 : 339|4@0+ (0.06667,0) [0|1] ""  IFV
 SG_ CAN_FL_DET_CONFID_AZIMUTH_027 : 341|2@0+ (1,0) [0|3] ""  IFV
 SG_ CAN_FL_DET_CONFID_ELEVATION_027 : 343|2@0+ (1,0) [0|3] ""  IFV
 SG_ CAN_FL_DET_EXISTENCE_PROB_027 : 347|4@0+ (1,0) [0|15] ""  IFV
 SG_ CAN_FL_DET_CLASS_027 : 351|4@0+ (1,0) [0|15] ""  IFV
 SG_ CAN_FL_DET_RANGE_028 : 367|14@0+ (0.015625,0) [0|255.984375] "m"  IFV
 SG_ CAN_FL_DET_SD_RANGE_028 : 369|6@0+ (0.025,0) [0|1.5] "m"  IFV
 SG_ CAN_FL_DET_RANGE_RATE_028 : 379|14@0+ (0.015625,-128) [-128|127.984375] "m/s"  IFV
 SG_ CAN_FL_DET_SD_RANGE_RATE_028 : 397|6@0+ (0.02,0) [0|1.2] "m/s"  IFV
 SG_ CAN_FL_DET_AZIMUTH_028 : 407|13@0+ (0.0007668,-3.141593) [-3.141593|3.141593] "rad"  IFV
 SG_ CAN_FL_DET_SD_AZIMUTH_028 : 410|6@0+ (0.001745329,0) [0|0.104719755] "rad"  IFV
 SG_ CAN_FL_DET_ELEVATION_028 : 420|7@0+ (0.157449,-9.99812) [-9.99812|9.997903] "deg"  IFV
 SG_ CAN_FL_DET_SD_ELEVATION_028 : 429|6@0+ (0.003490659,0) [0|0.20943951] "rad"  IFV
 SG_ CAN_FL_DET_AMPLITUDE_028 : 439|7@0+ (1,-64) [-64|63] "dBsm"  IFV
 SG_ CAN_FL_DET_VALID_FLAG_028 : 432|1@0+ (1,0) [0|1] ""  IFV
 SG_ CAN_FL_DET_SUPER_RES_028 : 440|1@0+ (1,0) [0|1] ""  IFV
 SG_ CAN_FL_DET_LOW_SNR_FLAG_028 : 441|1@0+ (1,0) [0|1] ""  IFV
 SG_ CAN_FL_DET_MIXER_BIAS_FLAG_028 : 442|1@0+ (1,0) [0|1] ""  IFV
 SG_ CAN_FL_DET_RESERVED_FLAGS_028 : 447|5@0+ (1,0) [0|31] ""  IFV
 SG_ CAN_FL_DET_SNR_028 : 455|8@0+ (0.35156,0) [0|89.6478] "dB"  IFV
 SG_ CAN_FL_DET_MULTI_TARGET_PROB_028 : 459|4@0+ (0.06667,0) [0|1] ""  IFV
 SG_ CAN_FL_DET_CONFID_AZIMUTH_028 : 461|2@0+ (1,0) [0|3] ""  IFV
 SG_ CAN_FL_DET_CONFID_ELEVATION_028 : 463|2@0+ (1,0) [0|3] ""  IFV
 SG_ CAN_FL_DET_EXISTENCE_PROB_028 : 467|4@0+ (1,0) [0|15] ""  IFV
 SG_ CAN_FL_DET_CLASS_028 : 471|4@0+ (1,0) [0|15] ""  IFV

BO_ 775 SODFL_DETECTION_029_032: 64 SODFL
 SG_ CAN_FL_DET_RANGE_029 : 7|14@0+ (0.015625,0) [0|255.984375] "m"  IFV
 SG_ CAN_FL_DET_SD_RANGE_029 : 9|6@0+ (0.025,0) [0|1.5] "m"  IFV
 SG_ CAN_FL_DET_RANGE_RATE_029 : 19|14@0+ (0.015625,-128) [-128|127.984375] "m/s"  IFV
 SG_ CAN_FL_DET_SD_RANGE_RATE_029 : 37|6@0+ (0.02,0) [0|1.2] "m/s"  IFV
 SG_ CAN_FL_DET_AZIMUTH_029 : 47|13@0+ (0.0007668,-3.141593) [-3.141593|3.141593] "rad"  IFV
 SG_ CAN_FL_DET_SD_AZIMUTH_029 : 50|6@0+ (0.001745329,0) [0|0.104719755] "rad"  IFV
 SG_ CAN_FL_DET_ELEVATION_029 : 60|7@0+ (0.157449,-9.99812) [-9.99812|9.997903] "deg"  IFV
 SG_ CAN_FL_DET_SD_ELEVATION_029 : 69|6@0+ (0.003490659,0) [0|0.20943951] "rad"  IFV
 SG_ CAN_FL_DET_AMPLITUDE_029 : 79|7@0+ (1,-64) [-64|63] "dBsm"  IFV
 SG_ CAN_FL_DET_VALID_FLAG_029 : 72|1@0+ (1,0) [0|1] ""  IFV
 SG_ CAN_FL_DET_SUPER_RES_029 : 80|1@0+ (1,0) [0|1] ""  IFV
 SG_ CAN_FL_DET_LOW_SNR_FLAG_029 : 81|1@0+ (1,0) [0|1] ""  IFV
 SG_ CAN_FL_DET_MIXER_BIAS_FLAG_029 : 82|1@0+ (1,0) [0|1] ""  IFV
 SG_ CAN_FL_DET_RESERVED_FLAGS_029 : 87|5@0+ (1,0) [0|31] ""  IFV
 SG_ CAN_FL_DET_SNR_029 : 95|8@0+ (0.35156,0) [0|89.6478] "dB"  IFV
 SG_ CAN_FL_DET_MULTI_TARGET_PROB_029 : 99|4@0+ (0.06667,0) [0|1] ""  IFV
 SG_ CAN_FL_DET_CONFID_AZIMUTH_029 : 101|2@0+ (1,0) [0|3] ""  IFV
 SG_ CAN_FL_DET_CONFID_ELEVATION_029 : 103|2@0+ (1,0) [0|3] ""  IFV
 SG_ CAN_FL_DET_EXISTENCE_PROB_029 : 107|4@0+ (1,0) [0|15] ""  IFV
 SG_ CAN_FL_DET_CLASS_029 : 111|4@0+ (1,0) [0|15] ""  IFV
 SG_ CAN_FL_DET_RANGE_030 : 127|14@0+ (0.015625,0) [0|255.984375] "m"  IFV
 SG_ CAN_FL_DET_SD_RANGE_030 : 129|6@0+ (0.025,0) [0|1.5] "m"  IFV
 SG_ CAN_FL_DET_RANGE_RATE_030 : 139|14@0+ (0.015625,-128) [-128|127.984375] "m/s"  IFV
 SG_ CAN_FL_DET_SD_RANGE_RATE_030 : 157|6@0+ (0.02,0) [0|1.2] "m/s"  IFV
 SG_ CAN_FL_DET_AZIMUTH_030 : 167|13@0+ (0.0007668,-3.141593) [-3.141593|3.141593] "rad"  IFV
 SG_ CAN_FL_DET_SD_AZIMUTH_030 : 170|6@0+ (0.001745329,0) [0|0.104719755] "rad"  IFV
 SG_ CAN_FL_DET_ELEVATION_030 : 180|7@0+ (0.157449,-9.99812) [-9.99812|9.997903] "deg"  IFV
 SG_ CAN_FL_DET_SD_ELEVATION_030 : 189|6@0+ (0.003490659,0) [0|0.20943951] "rad"  IFV
 SG_ CAN_FL_DET_AMPLITUDE_030 : 199|7@0+ (1,-64) [-64|63] "dBsm"  IFV
 SG_ CAN_FL_DET_VALID_FLAG_030 : 192|1@0+ (1,0) [0|1] ""  IFV
 SG_ CAN_FL_DET_SUPER_RES_030 : 200|1@0+ (1,0) [0|1] ""  IFV
 SG_ CAN_FL_DET_LOW_SNR_FLAG_030 : 201|1@0+ (1,0) [0|1] ""  IFV
 SG_ CAN_FL_DET_MIXER_BIAS_FLAG_030 : 202|1@0+ (1,0) [0|1] ""  IFV
 SG_ CAN_FL_DET_RESERVED_FLAGS_030 : 207|5@0+ (1,0) [0|31] ""  IFV
 SG_ CAN_FL_DET_SNR_030 : 215|8@0+ (0.35156,0) [0|89.6478] "dB"  IFV
 SG_ CAN_FL_DET_MULTI_TARGET_PROB_030 : 219|4@0+ (0.06667,0) [0|1] ""  IFV
 SG_ CAN_FL_DET_CONFID_AZIMUTH_030 : 221|2@0+ (1,0) [0|3] ""  IFV
 SG_ CAN_FL_DET_CONFID_ELEVATION_030 : 223|2@0+ (1,0) [0|3] ""  IFV
 SG_ CAN_FL_DET_EXISTENCE_PROB_030 : 227|4@0+ (1,0) [0|15] ""  IFV
 SG_ CAN_FL_DET_CLASS_030 : 231|4@0+ (1,0) [0|15] ""  IFV
 SG_ CAN_FL_DET_RANGE_031 : 247|14@0+ (0.015625,0) [0|255.984375] "m"  IFV
 SG_ CAN_FL_DET_SD_RANGE_031 : 249|6@0+ (0.025,0) [0|1.5] "m"  IFV
 SG_ CAN_FL_DET_RANGE_RATE_031 : 259|14@0+ (0.015625,-128) [-128|127.984375] "m/s"  IFV
 SG_ CAN_FL_DET_SD_RANGE_RATE_031 : 277|6@0+ (0.02,0) [0|1.2] "m/s"  IFV
 SG_ CAN_FL_DET_AZIMUTH_031 : 287|13@0+ (0.0007668,-3.141593) [-3.141593|3.141593] "rad"  IFV
 SG_ CAN_FL_DET_SD_AZIMUTH_031 : 290|6@0+ (0.001745329,0) [0|0.104719755] "rad"  IFV
 SG_ CAN_FL_DET_ELEVATION_031 : 300|7@0+ (0.157449,-9.99812) [-9.99812|9.997903] "deg"  IFV
 SG_ CAN_FL_DET_SD_ELEVATION_031 : 309|6@0+ (0.003490659,0) [0|0.20943951] "rad"  IFV
 SG_ CAN_FL_DET_AMPLITUDE_031 : 319|7@0+ (1,-64) [-64|63] "dBsm"  IFV
 SG_ CAN_FL_DET_VALID_FLAG_031 : 312|1@0+ (1,0) [0|1] ""  IFV
 SG_ CAN_FL_DET_SUPER_RES_031 : 320|1@0+ (1,0) [0|1] ""  IFV
 SG_ CAN_FL_DET_LOW_SNR_FLAG_031 : 321|1@0+ (1,0) [0|1] ""  IFV
 SG_ CAN_FL_DET_MIXER_BIAS_FLAG_031 : 322|1@0+ (1,0) [0|1] ""  IFV
 SG_ CAN_FL_DET_RESERVED_FLAGS_031 : 327|5@0+ (1,0) [0|31] ""  IFV
 SG_ CAN_FL_DET_SNR_031 : 335|8@0+ (0.35156,0) [0|89.6478] "dB"  IFV
 SG_ CAN_FL_DET_MULTI_TARGET_PROB_031 : 339|4@0+ (0.06667,0) [0|1] ""  IFV
 SG_ CAN_FL_DET_CONFID_AZIMUTH_031 : 341|2@0+ (1,0) [0|3] ""  IFV
 SG_ CAN_FL_DET_CONFID_ELEVATION_031 : 343|2@0+ (1,0) [0|3] ""  IFV
 SG_ CAN_FL_DET_EXISTENCE_PROB_031 : 347|4@0+ (1,0) [0|15] ""  IFV
 SG_ CAN_FL_DET_CLASS_031 : 351|4@0+ (1,0) [0|15] ""  IFV
 SG_ CAN_FL_DET_RANGE_032 : 367|14@0+ (0.015625,0) [0|255.984375] "m"  IFV
 SG_ CAN_FL_DET_SD_RANGE_032 : 369|6@0+ (0.025,0) [0|1.5] "m"  IFV
 SG_ CAN_FL_DET_RANGE_RATE_032 : 379|14@0+ (0.015625,-128) [-128|127.984375] "m/s"  IFV
 SG_ CAN_FL_DET_SD_RANGE_RATE_032 : 397|6@0+ (0.02,0) [0|1.2] "m/s"  IFV
 SG_ CAN_FL_DET_AZIMUTH_032 : 407|13@0+ (0.0007668,-3.141593) [-3.141593|3.141593] "rad"  IFV
 SG_ CAN_FL_DET_SD_AZIMUTH_032 : 410|6@0+ (0.001745329,0) [0|0.104719755] "rad"  IFV
 SG_ CAN_FL_DET_ELEVATION_032 : 420|7@0+ (0.157449,-9.99812) [-9.99812|9.997903] "deg"  IFV
 SG_ CAN_FL_DET_SD_ELEVATION_032 : 429|6@0+ (0.003490659,0) [0|0.20943951] "rad"  IFV
 SG_ CAN_FL_DET_AMPLITUDE_032 : 439|7@0+ (1,-64) [-64|63] "dBsm"  IFV
 SG_ CAN_FL_DET_VALID_FLAG_032 : 432|1@0+ (1,0) [0|1] ""  IFV
 SG_ CAN_FL_DET_SUPER_RES_032 : 440|1@0+ (1,0) [0|1] ""  IFV
 SG_ CAN_FL_DET_LOW_SNR_FLAG_032 : 441|1@0+ (1,0) [0|1] ""  IFV
 SG_ CAN_FL_DET_MIXER_BIAS_FLAG_032 : 442|1@0+ (1,0) [0|1] ""  IFV
 SG_ CAN_FL_DET_RESERVED_FLAGS_032 : 447|5@0+ (1,0) [0|31] ""  IFV
 SG_ CAN_FL_DET_SNR_032 : 455|8@0+ (0.35156,0) [0|89.6478] "dB"  IFV
 SG_ CAN_FL_DET_MULTI_TARGET_PROB_032 : 459|4@0+ (0.06667,0) [0|1] ""  IFV
 SG_ CAN_FL_DET_CONFID_AZIMUTH_032 : 461|2@0+ (1,0) [0|3] ""  IFV
 SG_ CAN_FL_DET_CONFID_ELEVATION_032 : 463|2@0+ (1,0) [0|3] ""  IFV
 SG_ CAN_FL_DET_EXISTENCE_PROB_032 : 467|4@0+ (1,0) [0|15] ""  IFV
 SG_ CAN_FL_DET_CLASS_032 : 471|4@0+ (1,0) [0|15] ""  IFV

BO_ 776 SODFL_DETECTION_033_036: 64 SODFL
 SG_ CAN_FL_DET_RANGE_033 : 7|14@0+ (0.015625,0) [0|255.984375] "m"  IFV
 SG_ CAN_FL_DET_SD_RANGE_033 : 9|6@0+ (0.025,0) [0|1.5] "m"  IFV
 SG_ CAN_FL_DET_RANGE_RATE_033 : 19|14@0+ (0.015625,-128) [-128|127.984375] "m/s"  IFV
 SG_ CAN_FL_DET_SD_RANGE_RATE_033 : 37|6@0+ (0.02,0) [0|1.2] "m/s"  IFV
 SG_ CAN_FL_DET_AZIMUTH_033 : 47|13@0+ (0.0007668,-3.141593) [-3.141593|3.141593] "rad"  IFV
 SG_ CAN_FL_DET_SD_AZIMUTH_033 : 50|6@0+ (0.001745329,0) [0|0.104719755] "rad"  IFV
 SG_ CAN_FL_DET_ELEVATION_033 : 60|7@0+ (0.157449,-9.99812) [-9.99812|9.997903] "deg"  IFV
 SG_ CAN_FL_DET_SD_ELEVATION_033 : 69|6@0+ (0.003490659,0) [0|0.20943951] "rad"  IFV
 SG_ CAN_FL_DET_AMPLITUDE_033 : 79|7@0+ (1,-64) [-64|63] "dBsm"  IFV
 SG_ CAN_FL_DET_VALID_FLAG_033 : 72|1@0+ (1,0) [0|1] ""  IFV
 SG_ CAN_FL_DET_SUPER_RES_033 : 80|1@0+ (1,0) [0|1] ""  IFV
 SG_ CAN_FL_DET_LOW_SNR_FLAG_033 : 81|1@0+ (1,0) [0|1] ""  IFV
 SG_ CAN_FL_DET_MIXER_BIAS_FLAG_033 : 82|1@0+ (1,0) [0|1] ""  IFV
 SG_ CAN_FL_DET_RESERVED_FLAGS_033 : 87|5@0+ (1,0) [0|31] ""  IFV
 SG_ CAN_FL_DET_SNR_033 : 95|8@0+ (0.35156,0) [0|89.6478] "dB"  IFV
 SG_ CAN_FL_DET_MULTI_TARGET_PROB_033 : 99|4@0+ (0.06667,0) [0|1] ""  IFV
 SG_ CAN_FL_DET_CONFID_AZIMUTH_033 : 101|2@0+ (1,0) [0|3] ""  IFV
 SG_ CAN_FL_DET_CONFID_ELEVATION_033 : 103|2@0+ (1,0) [0|3] ""  IFV
 SG_ CAN_FL_DET_EXISTENCE_PROB_033 : 107|4@0+ (1,0) [0|15] ""  IFV
 SG_ CAN_FL_DET_CLASS_033 : 111|4@0+ (1,0) [0|15] ""  IFV
 SG_ CAN_FL_DET_RANGE_034 : 127|14@0+ (0.015625,0) [0|255.984375] "m"  IFV
 SG_ CAN_FL_DET_SD_RANGE_034 : 129|6@0+ (0.025,0) [0|1.5] "m"  IFV
 SG_ CAN_FL_DET_RANGE_RATE_034 : 139|14@0+ (0.015625,-128) [-128|127.984375] "m/s"  IFV
 SG_ CAN_FL_DET_SD_RANGE_RATE_034 : 157|6@0+ (0.02,0) [0|1.2] "m/s"  IFV
 SG_ CAN_FL_DET_AZIMUTH_034 : 167|13@0+ (0.0007668,-3.141593) [-3.141593|3.141593] "rad"  IFV
 SG_ CAN_FL_DET_SD_AZIMUTH_034 : 170|6@0+ (0.001745329,0) [0|0.104719755] "rad"  IFV
 SG_ CAN_FL_DET_ELEVATION_034 : 180|7@0+ (0.157449,-9.99812) [-9.99812|9.997903] "deg"  IFV
 SG_ CAN_FL_DET_SD_ELEVATION_034 : 189|6@0+ (0.003490659,0) [0|0.20943951] "rad"  IFV
 SG_ CAN_FL_DET_AMPLITUDE_034 : 199|7@0+ (1,-64) [-64|63] "dBsm"  IFV
 SG_ CAN_FL_DET_VALID_FLAG_034 : 192|1@0+ (1,0) [0|1] ""  IFV
 SG_ CAN_FL_DET_SUPER_RES_034 : 200|1@0+ (1,0) [0|1] ""  IFV
 SG_ CAN_FL_DET_LOW_SNR_FLAG_034 : 201|1@0+ (1,0) [0|1] ""  IFV
 SG_ CAN_FL_DET_MIXER_BIAS_FLAG_034 : 202|1@0+ (1,0) [0|1] ""  IFV
 SG_ CAN_FL_DET_RESERVED_FLAGS_034 : 207|5@0+ (1,0) [0|31] ""  IFV
 SG_ CAN_FL_DET_SNR_034 : 215|8@0+ (0.35156,0) [0|89.6478] "dB"  IFV
 SG_ CAN_FL_DET_MULTI_TARGET_PROB_034 : 219|4@0+ (0.06667,0) [0|1] ""  IFV
 SG_ CAN_FL_DET_CONFID_AZIMUTH_034 : 221|2@0+ (1,0) [0|3] ""  IFV
 SG_ CAN_FL_DET_CONFID_ELEVATION_034 : 223|2@0+ (1,0) [0|3] ""  IFV
 SG_ CAN_FL_DET_EXISTENCE_PROB_034 : 227|4@0+ (1,0) [0|15] ""  IFV
 SG_ CAN_FL_DET_CLASS_034 : 231|4@0+ (1,0) [0|15] ""  IFV
 SG_ CAN_FL_DET_RANGE_035 : 247|14@0+ (0.015625,0) [0|255.984375] "m"  IFV
 SG_ CAN_FL_DET_SD_RANGE_035 : 249|6@0+ (0.025,0) [0|1.5] "m"  IFV
 SG_ CAN_FL_DET_RANGE_RATE_035 : 259|14@0+ (0.015625,-128) [-128|127.984375] "m/s"  IFV
 SG_ CAN_FL_DET_SD_RANGE_RATE_035 : 277|6@0+ (0.02,0) [0|1.2] "m/s"  IFV
 SG_ CAN_FL_DET_AZIMUTH_035 : 287|13@0+ (0.0007668,-3.141593) [-3.141593|3.141593] "rad"  IFV
 SG_ CAN_FL_DET_SD_AZIMUTH_035 : 290|6@0+ (0.001745329,0) [0|0.104719755] "rad"  IFV
 SG_ CAN_FL_DET_ELEVATION_035 : 300|7@0+ (0.157449,-9.99812) [-9.99812|9.997903] "deg"  IFV
 SG_ CAN_FL_DET_SD_ELEVATION_035 : 309|6@0+ (0.003490659,0) [0|0.20943951] "rad"  IFV
 SG_ CAN_FL_DET_AMPLITUDE_035 : 319|7@0+ (1,-64) [-64|63] "dBsm"  IFV
 SG_ CAN_FL_DET_VALID_FLAG_035 : 312|1@0+ (1,0) [0|1] ""  IFV
 SG_ CAN_FL_DET_SUPER_RES_035 : 320|1@0+ (1,0) [0|1] ""  IFV
 SG_ CAN_FL_DET_LOW_SNR_FLAG_035 : 321|1@0+ (1,0) [0|1] ""  IFV
 SG_ CAN_FL_DET_MIXER_BIAS_FLAG_035 : 322|1@0+ (1,0) [0|1] ""  IFV
 SG_ CAN_FL_DET_RESERVED_FLAGS_035 : 327|5@0+ (1,0) [0|31] ""  IFV
 SG_ CAN_FL_DET_SNR_035 : 335|8@0+ (0.35156,0) [0|89.6478] "dB"  IFV
 SG_ CAN_FL_DET_MULTI_TARGET_PROB_035 : 339|4@0+ (0.06667,0) [0|1] ""  IFV
 SG_ CAN_FL_DET_CONFID_AZIMUTH_035 : 341|2@0+ (1,0) [0|3] ""  IFV
 SG_ CAN_FL_DET_CONFID_ELEVATION_035 : 343|2@0+ (1,0) [0|3] ""  IFV
 SG_ CAN_FL_DET_EXISTENCE_PROB_035 : 347|4@0+ (1,0) [0|15] ""  IFV
 SG_ CAN_FL_DET_CLASS_035 : 351|4@0+ (1,0) [0|15] ""  IFV
 SG_ CAN_FL_DET_RANGE_036 : 367|14@0+ (0.015625,0) [0|255.984375] "m"  IFV
 SG_ CAN_FL_DET_SD_RANGE_036 : 369|6@0+ (0.025,0) [0|1.5] "m"  IFV
 SG_ CAN_FL_DET_RANGE_RATE_036 : 379|14@0+ (0.015625,-128) [-128|127.984375] "m/s"  IFV
 SG_ CAN_FL_DET_SD_RANGE_RATE_036 : 397|6@0+ (0.02,0) [0|1.2] "m/s"  IFV
 SG_ CAN_FL_DET_AZIMUTH_036 : 407|13@0+ (0.0007668,-3.141593) [-3.141593|3.141593] "rad"  IFV
 SG_ CAN_FL_DET_SD_AZIMUTH_036 : 410|6@0+ (0.001745329,0) [0|0.104719755] "rad"  IFV
 SG_ CAN_FL_DET_ELEVATION_036 : 420|7@0+ (0.157449,-9.99812) [-9.99812|9.997903] "deg"  IFV
 SG_ CAN_FL_DET_SD_ELEVATION_036 : 429|6@0+ (0.003490659,0) [0|0.20943951] "rad"  IFV
 SG_ CAN_FL_DET_AMPLITUDE_036 : 439|7@0+ (1,-64) [-64|63] "dBsm"  IFV
 SG_ CAN_FL_DET_VALID_FLAG_036 : 432|1@0+ (1,0) [0|1] ""  IFV
 SG_ CAN_FL_DET_SUPER_RES_036 : 440|1@0+ (1,0) [0|1] ""  IFV
 SG_ CAN_FL_DET_LOW_SNR_FLAG_036 : 441|1@0+ (1,0) [0|1] ""  IFV
 SG_ CAN_FL_DET_MIXER_BIAS_FLAG_036 : 442|1@0+ (1,0) [0|1] ""  IFV
 SG_ CAN_FL_DET_RESERVED_FLAGS_036 : 447|5@0+ (1,0) [0|31] ""  IFV
 SG_ CAN_FL_DET_SNR_036 : 455|8@0+ (0.35156,0) [0|89.6478] "dB"  IFV
 SG_ CAN_FL_DET_MULTI_TARGET_PROB_036 : 459|4@0+ (0.06667,0) [0|1] ""  IFV
 SG_ CAN_FL_DET_CONFID_AZIMUTH_036 : 461|2@0+ (1,0) [0|3] ""  IFV
 SG_ CAN_FL_DET_CONFID_ELEVATION_036 : 463|2@0+ (1,0) [0|3] ""  IFV
 SG_ CAN_FL_DET_EXISTENCE_PROB_036 : 467|4@0+ (1,0) [0|15] ""  IFV
 SG_ CAN_FL_DET_CLASS_036 : 471|4@0+ (1,0) [0|15] ""  IFV

BO_ 777 SODFL_DETECTION_037_040: 64 SODFL
 SG_ CAN_FL_DET_RANGE_037 : 7|14@0+ (0.015625,0) [0|255.984375] "m"  IFV
 SG_ CAN_FL_DET_SD_RANGE_037 : 9|6@0+ (0.025,0) [0|1.5] "m"  IFV
 SG_ CAN_FL_DET_RANGE_RATE_037 : 19|14@0+ (0.015625,-128) [-128|127.984375] "m/s"  IFV
 SG_ CAN_FL_DET_SD_RANGE_RATE_037 : 37|6@0+ (0.02,0) [0|1.2] "m/s"  IFV
 SG_ CAN_FL_DET_AZIMUTH_037 : 47|13@0+ (0.0007668,-3.141593) [-3.141593|3.141593] "rad"  IFV
 SG_ CAN_FL_DET_SD_AZIMUTH_037 : 50|6@0+ (0.001745329,0) [0|0.104719755] "rad"  IFV
 SG_ CAN_FL_DET_ELEVATION_037 : 60|7@0+ (0.157449,-9.99812) [-9.99812|9.997903] "deg"  IFV
 SG_ CAN_FL_DET_SD_ELEVATION_037 : 69|6@0+ (0.003490659,0) [0|0.20943951] "rad"  IFV
 SG_ CAN_FL_DET_AMPLITUDE_037 : 79|7@0+ (1,-64) [-64|63] "dBsm"  IFV
 SG_ CAN_FL_DET_VALID_FLAG_037 : 72|1@0+ (1,0) [0|1] ""  IFV
 SG_ CAN_FL_DET_SUPER_RES_037 : 80|1@0+ (1,0) [0|1] ""  IFV
 SG_ CAN_FL_DET_LOW_SNR_FLAG_037 : 81|1@0+ (1,0) [0|1] ""  IFV
 SG_ CAN_FL_DET_MIXER_BIAS_FLAG_037 : 82|1@0+ (1,0) [0|1] ""  IFV
 SG_ CAN_FL_DET_RESERVED_FLAGS_037 : 87|5@0+ (1,0) [0|31] ""  IFV
 SG_ CAN_FL_DET_SNR_037 : 95|8@0+ (0.35156,0) [0|89.6478] "dB"  IFV
 SG_ CAN_FL_DET_MULTI_TARGET_PROB_037 : 99|4@0+ (0.06667,0) [0|1] ""  IFV
 SG_ CAN_FL_DET_CONFID_AZIMUTH_037 : 101|2@0+ (1,0) [0|3] ""  IFV
 SG_ CAN_FL_DET_CONFID_ELEVATION_037 : 103|2@0+ (1,0) [0|3] ""  IFV
 SG_ CAN_FL_DET_EXISTENCE_PROB_037 : 107|4@0+ (1,0) [0|15] ""  IFV
 SG_ CAN_FL_DET_CLASS_037 : 111|4@0+ (1,0) [0|15] ""  IFV
 SG_ CAN_FL_DET_RANGE_038 : 127|14@0+ (0.015625,0) [0|255.984375] "m"  IFV
 SG_ CAN_FL_DET_SD_RANGE_038 : 129|6@0+ (0.025,0) [0|1.5] "m"  IFV
 SG_ CAN_FL_DET_RANGE_RATE_038 : 139|14@0+ (0.015625,-128) [-128|127.984375] "m/s"  IFV
 SG_ CAN_FL_DET_SD_RANGE_RATE_038 : 157|6@0+ (0.02,0) [0|1.2] "m/s"  IFV
 SG_ CAN_FL_DET_AZIMUTH_038 : 167|13@0+ (0.0007668,-3.141593) [-3.141593|3.141593] "rad"  IFV
 SG_ CAN_FL_DET_SD_AZIMUTH_038 : 170|6@0+ (0.001745329,0) [0|0.104719755] "rad"  IFV
 SG_ CAN_FL_DET_ELEVATION_038 : 180|7@0+ (0.157449,-9.99812) [-9.99812|9.997903] "deg"  IFV
 SG_ CAN_FL_DET_SD_ELEVATION_038 : 189|6@0+ (0.003490659,0) [0|0.20943951] "rad"  IFV
 SG_ CAN_FL_DET_AMPLITUDE_038 : 199|7@0+ (1,-64) [-64|63] "dBsm"  IFV
 SG_ CAN_FL_DET_VALID_FLAG_038 : 192|1@0+ (1,0) [0|1] ""  IFV
 SG_ CAN_FL_DET_SUPER_RES_038 : 200|1@0+ (1,0) [0|1] ""  IFV
 SG_ CAN_FL_DET_LOW_SNR_FLAG_038 : 201|1@0+ (1,0) [0|1] ""  IFV
 SG_ CAN_FL_DET_MIXER_BIAS_FLAG_038 : 202|1@0+ (1,0) [0|1] ""  IFV
 SG_ CAN_FL_DET_RESERVED_FLAGS_038 : 207|5@0+ (1,0) [0|31] ""  IFV
 SG_ CAN_FL_DET_SNR_038 : 215|8@0+ (0.35156,0) [0|89.6478] "dB"  IFV
 SG_ CAN_FL_DET_MULTI_TARGET_PROB_038 : 219|4@0+ (0.06667,0) [0|1] ""  IFV
 SG_ CAN_FL_DET_CONFID_AZIMUTH_038 : 221|2@0+ (1,0) [0|3] ""  IFV
 SG_ CAN_FL_DET_CONFID_ELEVATION_038 : 223|2@0+ (1,0) [0|3] ""  IFV
 SG_ CAN_FL_DET_EXISTENCE_PROB_038 : 227|4@0+ (1,0) [0|15] ""  IFV
 SG_ CAN_FL_DET_CLASS_038 : 231|4@0+ (1,0) [0|15] ""  IFV
 SG_ CAN_FL_DET_RANGE_039 : 247|14@0+ (0.015625,0) [0|255.984375] "m"  IFV
 SG_ CAN_FL_DET_SD_RANGE_039 : 249|6@0+ (0.025,0) [0|1.5] "m"  IFV
 SG_ CAN_FL_DET_RANGE_RATE_039 : 259|14@0+ (0.015625,-128) [-128|127.984375] "m/s"  IFV
 SG_ CAN_FL_DET_SD_RANGE_RATE_039 : 277|6@0+ (0.02,0) [0|1.2] "m/s"  IFV
 SG_ CAN_FL_DET_AZIMUTH_039 : 287|13@0+ (0.0007668,-3.141593) [-3.141593|3.141593] "rad"  IFV
 SG_ CAN_FL_DET_SD_AZIMUTH_039 : 290|6@0+ (0.001745329,0) [0|0.104719755] "rad"  IFV
 SG_ CAN_FL_DET_ELEVATION_039 : 300|7@0+ (0.157449,-9.99812) [-9.99812|9.997903] "deg"  IFV
 SG_ CAN_FL_DET_SD_ELEVATION_039 : 309|6@0+ (0.003490659,0) [0|0.20943951] "rad"  IFV
 SG_ CAN_FL_DET_AMPLITUDE_039 : 319|7@0+ (1,-64) [-64|63] "dBsm"  IFV
 SG_ CAN_FL_DET_VALID_FLAG_039 : 312|1@0+ (1,0) [0|1] ""  IFV
 SG_ CAN_FL_DET_SUPER_RES_039 : 320|1@0+ (1,0) [0|1] ""  IFV
 SG_ CAN_FL_DET_LOW_SNR_FLAG_039 : 321|1@0+ (1,0) [0|1] ""  IFV
 SG_ CAN_FL_DET_MIXER_BIAS_FLAG_039 : 322|1@0+ (1,0) [0|1] ""  IFV
 SG_ CAN_FL_DET_RESERVED_FLAGS_039 : 327|5@0+ (1,0) [0|31] ""  IFV
 SG_ CAN_FL_DET_SNR_039 : 335|8@0+ (0.35156,0) [0|89.6478] "dB"  IFV
 SG_ CAN_FL_DET_MULTI_TARGET_PROB_039 : 339|4@0+ (0.06667,0) [0|1] ""  IFV
 SG_ CAN_FL_DET_CONFID_AZIMUTH_039 : 341|2@0+ (1,0) [0|3] ""  IFV
 SG_ CAN_FL_DET_CONFID_ELEVATION_039 : 343|2@0+ (1,0) [0|3] ""  IFV
 SG_ CAN_FL_DET_EXISTENCE_PROB_039 : 347|4@0+ (1,0) [0|15] ""  IFV
 SG_ CAN_FL_DET_CLASS_039 : 351|4@0+ (1,0) [0|15] ""  IFV
 SG_ CAN_FL_DET_RANGE_040 : 367|14@0+ (0.015625,0) [0|255.984375] "m"  IFV
 SG_ CAN_FL_DET_SD_RANGE_040 : 369|6@0+ (0.025,0) [0|1.5] "m"  IFV
 SG_ CAN_FL_DET_RANGE_RATE_040 : 379|14@0+ (0.015625,-128) [-128|127.984375] "m/s"  IFV
 SG_ CAN_FL_DET_SD_RANGE_RATE_040 : 397|6@0+ (0.02,0) [0|1.2] "m/s"  IFV
 SG_ CAN_FL_DET_AZIMUTH_040 : 407|13@0+ (0.0007668,-3.141593) [-3.141593|3.141593] "rad"  IFV
 SG_ CAN_FL_DET_SD_AZIMUTH_040 : 410|6@0+ (0.001745329,0) [0|0.104719755] "rad"  IFV
 SG_ CAN_FL_DET_ELEVATION_040 : 420|7@0+ (0.157449,-9.99812) [-9.99812|9.997903] "deg"  IFV
 SG_ CAN_FL_DET_SD_ELEVATION_040 : 429|6@0+ (0.003490659,0) [0|0.20943951] "rad"  IFV
 SG_ CAN_FL_DET_AMPLITUDE_040 : 439|7@0+ (1,-64) [-64|63] "dBsm"  IFV
 SG_ CAN_FL_DET_VALID_FLAG_040 : 432|1@0+ (1,0) [0|1] ""  IFV
 SG_ CAN_FL_DET_SUPER_RES_040 : 440|1@0+ (1,0) [0|1] ""  IFV
 SG_ CAN_FL_DET_LOW_SNR_FLAG_040 : 441|1@0+ (1,0) [0|1] ""  IFV
 SG_ CAN_FL_DET_MIXER_BIAS_FLAG_040 : 442|1@0+ (1,0) [0|1] ""  IFV
 SG_ CAN_FL_DET_RESERVED_FLAGS_040 : 447|5@0+ (1,0) [0|31] ""  IFV
 SG_ CAN_FL_DET_SNR_040 : 455|8@0+ (0.35156,0) [0|89.6478] "dB"  IFV
 SG_ CAN_FL_DET_MULTI_TARGET_PROB_040 : 459|4@0+ (0.06667,0) [0|1] ""  IFV
 SG_ CAN_FL_DET_CONFID_AZIMUTH_040 : 461|2@0+ (1,0) [0|3] ""  IFV
 SG_ CAN_FL_DET_CONFID_ELEVATION_040 : 463|2@0+ (1,0) [0|3] ""  IFV
 SG_ CAN_FL_DET_EXISTENCE_PROB_040 : 467|4@0+ (1,0) [0|15] ""  IFV
 SG_ CAN_FL_DET_CLASS_040 : 471|4@0+ (1,0) [0|15] ""  IFV

BO_ 778 SODFL_DETECTION_041_044: 64 SODFL
 SG_ CAN_FL_DET_RANGE_041 : 7|14@0+ (0.015625,0) [0|255.984375] "m"  IFV
 SG_ CAN_FL_DET_SD_RANGE_041 : 9|6@0+ (0.025,0) [0|1.5] "m"  IFV
 SG_ CAN_FL_DET_RANGE_RATE_041 : 19|14@0+ (0.015625,-128) [-128|127.984375] "m/s"  IFV
 SG_ CAN_FL_DET_SD_RANGE_RATE_041 : 37|6@0+ (0.02,0) [0|1.2] "m/s"  IFV
 SG_ CAN_FL_DET_AZIMUTH_041 : 47|13@0+ (0.0007668,-3.141593) [-3.141593|3.141593] "rad"  IFV
 SG_ CAN_FL_DET_SD_AZIMUTH_041 : 50|6@0+ (0.001745329,0) [0|0.104719755] "rad"  IFV
 SG_ CAN_FL_DET_ELEVATION_041 : 60|7@0+ (0.157449,-9.99812) [-9.99812|9.997903] "deg"  IFV
 SG_ CAN_FL_DET_SD_ELEVATION_041 : 69|6@0+ (0.003490659,0) [0|0.20943951] "rad"  IFV
 SG_ CAN_FL_DET_AMPLITUDE_041 : 79|7@0+ (1,-64) [-64|63] "dBsm"  IFV
 SG_ CAN_FL_DET_VALID_FLAG_041 : 72|1@0+ (1,0) [0|1] ""  IFV
 SG_ CAN_FL_DET_SUPER_RES_041 : 80|1@0+ (1,0) [0|1] ""  IFV
 SG_ CAN_FL_DET_LOW_SNR_FLAG_041 : 81|1@0+ (1,0) [0|1] ""  IFV
 SG_ CAN_FL_DET_MIXER_BIAS_FLAG_041 : 82|1@0+ (1,0) [0|1] ""  IFV
 SG_ CAN_FL_DET_RESERVED_FLAGS_041 : 87|5@0+ (1,0) [0|31] ""  IFV
 SG_ CAN_FL_DET_SNR_041 : 95|8@0+ (0.35156,0) [0|89.6478] "dB"  IFV
 SG_ CAN_FL_DET_MULTI_TARGET_PROB_041 : 99|4@0+ (0.06667,0) [0|1] ""  IFV
 SG_ CAN_FL_DET_CONFID_AZIMUTH_041 : 101|2@0+ (1,0) [0|3] ""  IFV
 SG_ CAN_FL_DET_CONFID_ELEVATION_041 : 103|2@0+ (1,0) [0|3] ""  IFV
 SG_ CAN_FL_DET_EXISTENCE_PROB_041 : 107|4@0+ (1,0) [0|15] ""  IFV
 SG_ CAN_FL_DET_CLASS_041 : 111|4@0+ (1,0) [0|15] ""  IFV
 SG_ CAN_FL_DET_RANGE_042 : 127|14@0+ (0.015625,0) [0|255.984375] "m"  IFV
 SG_ CAN_FL_DET_SD_RANGE_042 : 129|6@0+ (0.025,0) [0|1.5] "m"  IFV
 SG_ CAN_FL_DET_RANGE_RATE_042 : 139|14@0+ (0.015625,-128) [-128|127.984375] "m/s"  IFV
 SG_ CAN_FL_DET_SD_RANGE_RATE_042 : 157|6@0+ (0.02,0) [0|1.2] "m/s"  IFV
 SG_ CAN_FL_DET_AZIMUTH_042 : 167|13@0+ (0.0007668,-3.141593) [-3.141593|3.141593] "rad"  IFV
 SG_ CAN_FL_DET_SD_AZIMUTH_042 : 170|6@0+ (0.001745329,0) [0|0.104719755] "rad"  IFV
 SG_ CAN_FL_DET_ELEVATION_042 : 180|7@0+ (0.157449,-9.99812) [-9.99812|9.997903] "deg"  IFV
 SG_ CAN_FL_DET_SD_ELEVATION_042 : 189|6@0+ (0.003490659,0) [0|0.20943951] "rad"  IFV
 SG_ CAN_FL_DET_AMPLITUDE_042 : 199|7@0+ (1,-64) [-64|63] "dBsm"  IFV
 SG_ CAN_FL_DET_VALID_FLAG_042 : 192|1@0+ (1,0) [0|1] ""  IFV
 SG_ CAN_FL_DET_SUPER_RES_042 : 200|1@0+ (1,0) [0|1] ""  IFV
 SG_ CAN_FL_DET_LOW_SNR_FLAG_042 : 201|1@0+ (1,0) [0|1] ""  IFV
 SG_ CAN_FL_DET_MIXER_BIAS_FLAG_042 : 202|1@0+ (1,0) [0|1] ""  IFV
 SG_ CAN_FL_DET_RESERVED_FLAGS_042 : 207|5@0+ (1,0) [0|31] ""  IFV
 SG_ CAN_FL_DET_SNR_042 : 215|8@0+ (0.35156,0) [0|89.6478] "dB"  IFV
 SG_ CAN_FL_DET_MULTI_TARGET_PROB_042 : 219|4@0+ (0.06667,0) [0|1] ""  IFV
 SG_ CAN_FL_DET_CONFID_AZIMUTH_042 : 221|2@0+ (1,0) [0|3] ""  IFV
 SG_ CAN_FL_DET_CONFID_ELEVATION_042 : 223|2@0+ (1,0) [0|3] ""  IFV
 SG_ CAN_FL_DET_EXISTENCE_PROB_042 : 227|4@0+ (1,0) [0|15] ""  IFV
 SG_ CAN_FL_DET_CLASS_042 : 231|4@0+ (1,0) [0|15] ""  IFV
 SG_ CAN_FL_DET_RANGE_043 : 247|14@0+ (0.015625,0) [0|255.984375] "m"  IFV
 SG_ CAN_FL_DET_SD_RANGE_043 : 249|6@0+ (0.025,0) [0|1.5] "m"  IFV
 SG_ CAN_FL_DET_RANGE_RATE_043 : 259|14@0+ (0.015625,-128) [-128|127.984375] "m/s"  IFV
 SG_ CAN_FL_DET_SD_RANGE_RATE_043 : 277|6@0+ (0.02,0) [0|1.2] "m/s"  IFV
 SG_ CAN_FL_DET_AZIMUTH_043 : 287|13@0+ (0.0007668,-3.141593) [-3.141593|3.141593] "rad"  IFV
 SG_ CAN_FL_DET_SD_AZIMUTH_043 : 290|6@0+ (0.001745329,0) [0|0.104719755] "rad"  IFV
 SG_ CAN_FL_DET_ELEVATION_043 : 300|7@0+ (0.157449,-9.99812) [-9.99812|9.997903] "deg"  IFV
 SG_ CAN_FL_DET_SD_ELEVATION_043 : 309|6@0+ (0.003490659,0) [0|0.20943951] "rad"  IFV
 SG_ CAN_FL_DET_AMPLITUDE_043 : 319|7@0+ (1,-64) [-64|63] "dBsm"  IFV
 SG_ CAN_FL_DET_VALID_FLAG_043 : 312|1@0+ (1,0) [0|1] ""  IFV
 SG_ CAN_FL_DET_SUPER_RES_043 : 320|1@0+ (1,0) [0|1] ""  IFV
 SG_ CAN_FL_DET_LOW_SNR_FLAG_043 : 321|1@0+ (1,0) [0|1] ""  IFV
 SG_ CAN_FL_DET_MIXER_BIAS_FLAG_043 : 322|1@0+ (1,0) [0|1] ""  IFV
 SG_ CAN_FL_DET_RESERVED_FLAGS_043 : 327|5@0+ (1,0) [0|31] ""  IFV
 SG_ CAN_FL_DET_SNR_043 : 335|8@0+ (0.35156,0) [0|89.6478] "dB"  IFV
 SG_ CAN_FL_DET_MULTI_TARGET_PROB_043 : 339|4@0+ (0.06667,0) [0|1] ""  IFV
 SG_ CAN_FL_DET_CONFID_AZIMUTH_043 : 341|2@0+ (1,0) [0|3] ""  IFV
 SG_ CAN_FL_DET_CONFID_ELEVATION_043 : 343|2@0+ (1,0) [0|3] ""  IFV
 SG_ CAN_FL_DET_EXISTENCE_PROB_043 : 347|4@0+ (1,0) [0|15] ""  IFV
 SG_ CAN_FL_DET_CLASS_043 : 351|4@0+ (1,0) [0|15] ""  IFV
 SG_ CAN_FL_DET_RANGE_044 : 367|14@0+ (0.015625,0) [0|255.984375] "m"  IFV
 SG_ CAN_FL_DET_SD_RANGE_044 : 369|6@0+ (0.025,0) [0|1.5] "m"  IFV
 SG_ CAN_FL_DET_RANGE_RATE_044 : 379|14@0+ (0.015625,-128) [-128|127.984375] "m/s"  IFV
 SG_ CAN_FL_DET_SD_RANGE_RATE_044 : 397|6@0+ (0.02,0) [0|1.2] "m/s"  IFV
 SG_ CAN_FL_DET_AZIMUTH_044 : 407|13@0+ (0.0007668,-3.141593) [-3.141593|3.141593] "rad"  IFV
 SG_ CAN_FL_DET_SD_AZIMUTH_044 : 410|6@0+ (0.001745329,0) [0|0.104719755] "rad"  IFV
 SG_ CAN_FL_DET_ELEVATION_044 : 420|7@0+ (0.157449,-9.99812) [-9.99812|9.997903] "deg"  IFV
 SG_ CAN_FL_DET_SD_ELEVATION_044 : 429|6@0+ (0.003490659,0) [0|0.20943951] "rad"  IFV
 SG_ CAN_FL_DET_AMPLITUDE_044 : 439|7@0+ (1,-64) [-64|63] "dBsm"  IFV
 SG_ CAN_FL_DET_VALID_FLAG_044 : 432|1@0+ (1,0) [0|1] ""  IFV
 SG_ CAN_FL_DET_SUPER_RES_044 : 440|1@0+ (1,0) [0|1] ""  IFV
 SG_ CAN_FL_DET_LOW_SNR_FLAG_044 : 441|1@0+ (1,0) [0|1] ""  IFV
 SG_ CAN_FL_DET_MIXER_BIAS_FLAG_044 : 442|1@0+ (1,0) [0|1] ""  IFV
 SG_ CAN_FL_DET_RESERVED_FLAGS_044 : 447|5@0+ (1,0) [0|31] ""  IFV
 SG_ CAN_FL_DET_SNR_044 : 455|8@0+ (0.35156,0) [0|89.6478] "dB"  IFV
 SG_ CAN_FL_DET_MULTI_TARGET_PROB_044 : 459|4@0+ (0.06667,0) [0|1] ""  IFV
 SG_ CAN_FL_DET_CONFID_AZIMUTH_044 : 461|2@0+ (1,0) [0|3] ""  IFV
 SG_ CAN_FL_DET_CONFID_ELEVATION_044 : 463|2@0+ (1,0) [0|3] ""  IFV
 SG_ CAN_FL_DET_EXISTENCE_PROB_044 : 467|4@0+ (1,0) [0|15] ""  IFV
 SG_ CAN_FL_DET_CLASS_044 : 471|4@0+ (1,0) [0|15] ""  IFV

BO_ 779 SODFL_DETECTION_045_048: 64 SODFL
 SG_ CAN_FL_DET_RANGE_045 : 7|14@0+ (0.015625,0) [0|255.984375] "m"  IFV
 SG_ CAN_FL_DET_SD_RANGE_045 : 9|6@0+ (0.025,0) [0|1.5] "m"  IFV
 SG_ CAN_FL_DET_RANGE_RATE_045 : 19|14@0+ (0.015625,-128) [-128|127.984375] "m/s"  IFV
 SG_ CAN_FL_DET_SD_RANGE_RATE_045 : 37|6@0+ (0.02,0) [0|1.2] "m/s"  IFV
 SG_ CAN_FL_DET_AZIMUTH_045 : 47|13@0+ (0.0007668,-3.141593) [-3.141593|3.141593] "rad"  IFV
 SG_ CAN_FL_DET_SD_AZIMUTH_045 : 50|6@0+ (0.001745329,0) [0|0.104719755] "rad"  IFV
 SG_ CAN_FL_DET_ELEVATION_045 : 60|7@0+ (0.157449,-9.99812) [-9.99812|9.997903] "deg"  IFV
 SG_ CAN_FL_DET_SD_ELEVATION_045 : 69|6@0+ (0.003490659,0) [0|0.20943951] "rad"  IFV
 SG_ CAN_FL_DET_AMPLITUDE_045 : 79|7@0+ (1,-64) [-64|63] "dBsm"  IFV
 SG_ CAN_FL_DET_VALID_FLAG_045 : 72|1@0+ (1,0) [0|1] ""  IFV
 SG_ CAN_FL_DET_SUPER_RES_045 : 80|1@0+ (1,0) [0|1] ""  IFV
 SG_ CAN_FL_DET_LOW_SNR_FLAG_045 : 81|1@0+ (1,0) [0|1] ""  IFV
 SG_ CAN_FL_DET_MIXER_BIAS_FLAG_045 : 82|1@0+ (1,0) [0|1] ""  IFV
 SG_ CAN_FL_DET_RESERVED_FLAGS_045 : 87|5@0+ (1,0) [0|31] ""  IFV
 SG_ CAN_FL_DET_SNR_045 : 95|8@0+ (0.35156,0) [0|89.6478] "dB"  IFV
 SG_ CAN_FL_DET_MULTI_TARGET_PROB_045 : 99|4@0+ (0.06667,0) [0|1] ""  IFV
 SG_ CAN_FL_DET_CONFID_AZIMUTH_045 : 101|2@0+ (1,0) [0|3] ""  IFV
 SG_ CAN_FL_DET_CONFID_ELEVATION_045 : 103|2@0+ (1,0) [0|3] ""  IFV
 SG_ CAN_FL_DET_EXISTENCE_PROB_045 : 107|4@0+ (1,0) [0|15] ""  IFV
 SG_ CAN_FL_DET_CLASS_045 : 111|4@0+ (1,0) [0|15] ""  IFV
 SG_ CAN_FL_DET_RANGE_046 : 127|14@0+ (0.015625,0) [0|255.984375] "m"  IFV
 SG_ CAN_FL_DET_SD_RANGE_046 : 129|6@0+ (0.025,0) [0|1.5] "m"  IFV
 SG_ CAN_FL_DET_RANGE_RATE_046 : 139|14@0+ (0.015625,-128) [-128|127.984375] "m/s"  IFV
 SG_ CAN_FL_DET_SD_RANGE_RATE_046 : 157|6@0+ (0.02,0) [0|1.2] "m/s"  IFV
 SG_ CAN_FL_DET_AZIMUTH_046 : 167|13@0+ (0.0007668,-3.141593) [-3.141593|3.141593] "rad"  IFV
 SG_ CAN_FL_DET_SD_AZIMUTH_046 : 170|6@0+ (0.001745329,0) [0|0.104719755] "rad"  IFV
 SG_ CAN_FL_DET_ELEVATION_046 : 180|7@0+ (0.157449,-9.99812) [-9.99812|9.997903] "deg"  IFV
 SG_ CAN_FL_DET_SD_ELEVATION_046 : 189|6@0+ (0.003490659,0) [0|0.20943951] "rad"  IFV
 SG_ CAN_FL_DET_AMPLITUDE_046 : 199|7@0+ (1,-64) [-64|63] "dBsm"  IFV
 SG_ CAN_FL_DET_VALID_FLAG_046 : 192|1@0+ (1,0) [0|1] ""  IFV
 SG_ CAN_FL_DET_SUPER_RES_046 : 200|1@0+ (1,0) [0|1] ""  IFV
 SG_ CAN_FL_DET_LOW_SNR_FLAG_046 : 201|1@0+ (1,0) [0|1] ""  IFV
 SG_ CAN_FL_DET_MIXER_BIAS_FLAG_046 : 202|1@0+ (1,0) [0|1] ""  IFV
 SG_ CAN_FL_DET_RESERVED_FLAGS_046 : 207|5@0+ (1,0) [0|31] ""  IFV
 SG_ CAN_FL_DET_SNR_046 : 215|8@0+ (0.35156,0) [0|89.6478] "dB"  IFV
 SG_ CAN_FL_DET_MULTI_TARGET_PROB_046 : 219|4@0+ (0.06667,0) [0|1] ""  IFV
 SG_ CAN_FL_DET_CONFID_AZIMUTH_046 : 221|2@0+ (1,0) [0|3] ""  IFV
 SG_ CAN_FL_DET_CONFID_ELEVATION_046 : 223|2@0+ (1,0) [0|3] ""  IFV
 SG_ CAN_FL_DET_EXISTENCE_PROB_046 : 227|4@0+ (1,0) [0|15] ""  IFV
 SG_ CAN_FL_DET_CLASS_046 : 231|4@0+ (1,0) [0|15] ""  IFV
 SG_ CAN_FL_DET_RANGE_047 : 247|14@0+ (0.015625,0) [0|255.984375] "m"  IFV
 SG_ CAN_FL_DET_SD_RANGE_047 : 249|6@0+ (0.025,0) [0|1.5] "m"  IFV
 SG_ CAN_FL_DET_RANGE_RATE_047 : 259|14@0+ (0.015625,-128) [-128|127.984375] "m/s"  IFV
 SG_ CAN_FL_DET_SD_RANGE_RATE_047 : 277|6@0+ (0.02,0) [0|1.2] "m/s"  IFV
 SG_ CAN_FL_DET_AZIMUTH_047 : 287|13@0+ (0.0007668,-3.141593) [-3.141593|3.141593] "rad"  IFV
 SG_ CAN_FL_DET_SD_AZIMUTH_047 : 290|6@0+ (0.001745329,0) [0|0.104719755] "rad"  IFV
 SG_ CAN_FL_DET_ELEVATION_047 : 300|7@0+ (0.157449,-9.99812) [-9.99812|9.997903] "deg"  IFV
 SG_ CAN_FL_DET_SD_ELEVATION_047 : 309|6@0+ (0.003490659,0) [0|0.20943951] "rad"  IFV
 SG_ CAN_FL_DET_AMPLITUDE_047 : 319|7@0+ (1,-64) [-64|63] "dBsm"  IFV
 SG_ CAN_FL_DET_VALID_FLAG_047 : 312|1@0+ (1,0) [0|1] ""  IFV
 SG_ CAN_FL_DET_SUPER_RES_047 : 320|1@0+ (1,0) [0|1] ""  IFV
 SG_ CAN_FL_DET_LOW_SNR_FLAG_047 : 321|1@0+ (1,0) [0|1] ""  IFV
 SG_ CAN_FL_DET_MIXER_BIAS_FLAG_047 : 322|1@0+ (1,0) [0|1] ""  IFV
 SG_ CAN_FL_DET_RESERVED_FLAGS_047 : 327|5@0+ (1,0) [0|31] ""  IFV
 SG_ CAN_FL_DET_SNR_047 : 335|8@0+ (0.35156,0) [0|89.6478] "dB"  IFV
 SG_ CAN_FL_DET_MULTI_TARGET_PROB_047 : 339|4@0+ (0.06667,0) [0|1] ""  IFV
 SG_ CAN_FL_DET_CONFID_AZIMUTH_047 : 341|2@0+ (1,0) [0|3] ""  IFV
 SG_ CAN_FL_DET_CONFID_ELEVATION_047 : 343|2@0+ (1,0) [0|3] ""  IFV
 SG_ CAN_FL_DET_EXISTENCE_PROB_047 : 347|4@0+ (1,0) [0|15] ""  IFV
 SG_ CAN_FL_DET_CLASS_047 : 351|4@0+ (1,0) [0|15] ""  IFV
 SG_ CAN_FL_DET_RANGE_048 : 367|14@0+ (0.015625,0) [0|255.984375] "m"  IFV
 SG_ CAN_FL_DET_SD_RANGE_048 : 369|6@0+ (0.025,0) [0|1.5] "m"  IFV
 SG_ CAN_FL_DET_RANGE_RATE_048 : 379|14@0+ (0.015625,-128) [-128|127.984375] "m/s"  IFV
 SG_ CAN_FL_DET_SD_RANGE_RATE_048 : 397|6@0+ (0.02,0) [0|1.2] "m/s"  IFV
 SG_ CAN_FL_DET_AZIMUTH_048 : 407|13@0+ (0.0007668,-3.141593) [-3.141593|3.141593] "rad"  IFV
 SG_ CAN_FL_DET_SD_AZIMUTH_048 : 410|6@0+ (0.001745329,0) [0|0.104719755] "rad"  IFV
 SG_ CAN_FL_DET_ELEVATION_048 : 420|7@0+ (0.157449,-9.99812) [-9.99812|9.997903] "deg"  IFV
 SG_ CAN_FL_DET_SD_ELEVATION_048 : 429|6@0+ (0.003490659,0) [0|0.20943951] "rad"  IFV
 SG_ CAN_FL_DET_AMPLITUDE_048 : 439|7@0+ (1,-64) [-64|63] "dBsm"  IFV
 SG_ CAN_FL_DET_VALID_FLAG_048 : 432|1@0+ (1,0) [0|1] ""  IFV
 SG_ CAN_FL_DET_SUPER_RES_048 : 440|1@0+ (1,0) [0|1] ""  IFV
 SG_ CAN_FL_DET_LOW_SNR_FLAG_048 : 441|1@0+ (1,0) [0|1] ""  IFV
 SG_ CAN_FL_DET_MIXER_BIAS_FLAG_048 : 442|1@0+ (1,0) [0|1] ""  IFV
 SG_ CAN_FL_DET_RESERVED_FLAGS_048 : 447|5@0+ (1,0) [0|31] ""  IFV
 SG_ CAN_FL_DET_SNR_048 : 455|8@0+ (0.35156,0) [0|89.6478] "dB"  IFV
 SG_ CAN_FL_DET_MULTI_TARGET_PROB_048 : 459|4@0+ (0.06667,0) [0|1] ""  IFV
 SG_ CAN_FL_DET_CONFID_AZIMUTH_048 : 461|2@0+ (1,0) [0|3] ""  IFV
 SG_ CAN_FL_DET_CONFID_ELEVATION_048 : 463|2@0+ (1,0) [0|3] ""  IFV
 SG_ CAN_FL_DET_EXISTENCE_PROB_048 : 467|4@0+ (1,0) [0|15] ""  IFV
 SG_ CAN_FL_DET_CLASS_048 : 471|4@0+ (1,0) [0|15] ""  IFV

BO_ 780 SODFL_DETECTION_049_052: 64 SODFL
 SG_ CAN_FL_DET_RANGE_049 : 7|14@0+ (0.015625,0) [0|255.984375] "m"  IFV
 SG_ CAN_FL_DET_SD_RANGE_049 : 9|6@0+ (0.025,0) [0|1.5] "m"  IFV
 SG_ CAN_FL_DET_RANGE_RATE_049 : 19|14@0+ (0.015625,-128) [-128|127.984375] "m/s"  IFV
 SG_ CAN_FL_DET_SD_RANGE_RATE_049 : 37|6@0+ (0.02,0) [0|1.2] "m/s"  IFV
 SG_ CAN_FL_DET_AZIMUTH_049 : 47|13@0+ (0.0007668,-3.141593) [-3.141593|3.141593] "rad"  IFV
 SG_ CAN_FL_DET_SD_AZIMUTH_049 : 50|6@0+ (0.001745329,0) [0|0.104719755] "rad"  IFV
 SG_ CAN_FL_DET_ELEVATION_049 : 60|7@0+ (0.157449,-9.99812) [-9.99812|9.997903] "deg"  IFV
 SG_ CAN_FL_DET_SD_ELEVATION_049 : 69|6@0+ (0.003490659,0) [0|0.20943951] "rad"  IFV
 SG_ CAN_FL_DET_AMPLITUDE_049 : 79|7@0+ (1,-64) [-64|63] "dBsm"  IFV
 SG_ CAN_FL_DET_VALID_FLAG_049 : 72|1@0+ (1,0) [0|1] ""  IFV
 SG_ CAN_FL_DET_SUPER_RES_049 : 80|1@0+ (1,0) [0|1] ""  IFV
 SG_ CAN_FL_DET_LOW_SNR_FLAG_049 : 81|1@0+ (1,0) [0|1] ""  IFV
 SG_ CAN_FL_DET_MIXER_BIAS_FLAG_049 : 82|1@0+ (1,0) [0|1] ""  IFV
 SG_ CAN_FL_DET_RESERVED_FLAGS_049 : 87|5@0+ (1,0) [0|31] ""  IFV
 SG_ CAN_FL_DET_SNR_049 : 95|8@0+ (0.35156,0) [0|89.6478] "dB"  IFV
 SG_ CAN_FL_DET_MULTI_TARGET_PROB_049 : 99|4@0+ (0.06667,0) [0|1] ""  IFV
 SG_ CAN_FL_DET_CONFID_AZIMUTH_049 : 101|2@0+ (1,0) [0|3] ""  IFV
 SG_ CAN_FL_DET_CONFID_ELEVATION_049 : 103|2@0+ (1,0) [0|3] ""  IFV
 SG_ CAN_FL_DET_EXISTENCE_PROB_049 : 107|4@0+ (1,0) [0|15] ""  IFV
 SG_ CAN_FL_DET_CLASS_049 : 111|4@0+ (1,0) [0|15] ""  IFV
 SG_ CAN_FL_DET_RANGE_050 : 127|14@0+ (0.015625,0) [0|255.984375] "m"  IFV
 SG_ CAN_FL_DET_SD_RANGE_050 : 129|6@0+ (0.025,0) [0|1.5] "m"  IFV
 SG_ CAN_FL_DET_RANGE_RATE_050 : 139|14@0+ (0.015625,-128) [-128|127.984375] "m/s"  IFV
 SG_ CAN_FL_DET_SD_RANGE_RATE_050 : 157|6@0+ (0.02,0) [0|1.2] "m/s"  IFV
 SG_ CAN_FL_DET_AZIMUTH_050 : 167|13@0+ (0.0007668,-3.141593) [-3.141593|3.141593] "rad"  IFV
 SG_ CAN_FL_DET_SD_AZIMUTH_050 : 170|6@0+ (0.001745329,0) [0|0.104719755] "rad"  IFV
 SG_ CAN_FL_DET_ELEVATION_050 : 180|7@0+ (0.157449,-9.99812) [-9.99812|9.997903] "deg"  IFV
 SG_ CAN_FL_DET_SD_ELEVATION_050 : 189|6@0+ (0.003490659,0) [0|0.20943951] "rad"  IFV
 SG_ CAN_FL_DET_AMPLITUDE_050 : 199|7@0+ (1,-64) [-64|63] "dBsm"  IFV
 SG_ CAN_FL_DET_VALID_FLAG_050 : 192|1@0+ (1,0) [0|1] ""  IFV
 SG_ CAN_FL_DET_SUPER_RES_050 : 200|1@0+ (1,0) [0|1] ""  IFV
 SG_ CAN_FL_DET_LOW_SNR_FLAG_050 : 201|1@0+ (1,0) [0|1] ""  IFV
 SG_ CAN_FL_DET_MIXER_BIAS_FLAG_050 : 202|1@0+ (1,0) [0|1] ""  IFV
 SG_ CAN_FL_DET_RESERVED_FLAGS_050 : 207|5@0+ (1,0) [0|31] ""  IFV
 SG_ CAN_FL_DET_SNR_050 : 215|8@0+ (0.35156,0) [0|89.6478] "dB"  IFV
 SG_ CAN_FL_DET_MULTI_TARGET_PROB_050 : 219|4@0+ (0.06667,0) [0|1] ""  IFV
 SG_ CAN_FL_DET_CONFID_AZIMUTH_050 : 221|2@0+ (1,0) [0|3] ""  IFV
 SG_ CAN_FL_DET_CONFID_ELEVATION_050 : 223|2@0+ (1,0) [0|3] ""  IFV
 SG_ CAN_FL_DET_EXISTENCE_PROB_050 : 227|4@0+ (1,0) [0|15] ""  IFV
 SG_ CAN_FL_DET_CLASS_050 : 231|4@0+ (1,0) [0|15] ""  IFV
 SG_ CAN_FL_DET_RANGE_051 : 247|14@0+ (0.015625,0) [0|255.984375] "m"  IFV
 SG_ CAN_FL_DET_SD_RANGE_051 : 249|6@0+ (0.025,0) [0|1.5] "m"  IFV
 SG_ CAN_FL_DET_RANGE_RATE_051 : 259|14@0+ (0.015625,-128) [-128|127.984375] "m/s"  IFV
 SG_ CAN_FL_DET_SD_RANGE_RATE_051 : 277|6@0+ (0.02,0) [0|1.2] "m/s"  IFV
 SG_ CAN_FL_DET_AZIMUTH_051 : 287|13@0+ (0.0007668,-3.141593) [-3.141593|3.141593] "rad"  IFV
 SG_ CAN_FL_DET_SD_AZIMUTH_051 : 290|6@0+ (0.001745329,0) [0|0.104719755] "rad"  IFV
 SG_ CAN_FL_DET_ELEVATION_051 : 300|7@0+ (0.157449,-9.99812) [-9.99812|9.997903] "deg"  IFV
 SG_ CAN_FL_DET_SD_ELEVATION_051 : 309|6@0+ (0.003490659,0) [0|0.20943951] "rad"  IFV
 SG_ CAN_FL_DET_AMPLITUDE_051 : 319|7@0+ (1,-64) [-64|63] "dBsm"  IFV
 SG_ CAN_FL_DET_VALID_FLAG_051 : 312|1@0+ (1,0) [0|1] ""  IFV
 SG_ CAN_FL_DET_SUPER_RES_051 : 320|1@0+ (1,0) [0|1] ""  IFV
 SG_ CAN_FL_DET_LOW_SNR_FLAG_051 : 321|1@0+ (1,0) [0|1] ""  IFV
 SG_ CAN_FL_DET_MIXER_BIAS_FLAG_051 : 322|1@0+ (1,0) [0|1] ""  IFV
 SG_ CAN_FL_DET_RESERVED_FLAGS_051 : 327|5@0+ (1,0) [0|31] ""  IFV
 SG_ CAN_FL_DET_SNR_051 : 335|8@0+ (0.35156,0) [0|89.6478] "dB"  IFV
 SG_ CAN_FL_DET_MULTI_TARGET_PROB_051 : 339|4@0+ (0.06667,0) [0|1] ""  IFV
 SG_ CAN_FL_DET_CONFID_AZIMUTH_051 : 341|2@0+ (1,0) [0|3] ""  IFV
 SG_ CAN_FL_DET_CONFID_ELEVATION_051 : 343|2@0+ (1,0) [0|3] ""  IFV
 SG_ CAN_FL_DET_EXISTENCE_PROB_051 : 347|4@0+ (1,0) [0|15] ""  IFV
 SG_ CAN_FL_DET_CLASS_051 : 351|4@0+ (1,0) [0|15] ""  IFV
 SG_ CAN_FL_DET_RANGE_052 : 367|14@0+ (0.015625,0) [0|255.984375] "m"  IFV
 SG_ CAN_FL_DET_SD_RANGE_052 : 369|6@0+ (0.025,0) [0|1.5] "m"  IFV
 SG_ CAN_FL_DET_RANGE_RATE_052 : 379|14@0+ (0.015625,-128) [-128|127.984375] "m/s"  IFV
 SG_ CAN_FL_DET_SD_RANGE_RATE_052 : 397|6@0+ (0.02,0) [0|1.2] "m/s"  IFV
 SG_ CAN_FL_DET_AZIMUTH_052 : 407|13@0+ (0.0007668,-3.141593) [-3.141593|3.141593] "rad"  IFV
 SG_ CAN_FL_DET_SD_AZIMUTH_052 : 410|6@0+ (0.001745329,0) [0|0.104719755] "rad"  IFV
 SG_ CAN_FL_DET_ELEVATION_052 : 420|7@0+ (0.157449,-9.99812) [-9.99812|9.997903] "deg"  IFV
 SG_ CAN_FL_DET_SD_ELEVATION_052 : 429|6@0+ (0.003490659,0) [0|0.20943951] "rad"  IFV
 SG_ CAN_FL_DET_AMPLITUDE_052 : 439|7@0+ (1,-64) [-64|63] "dBsm"  IFV
 SG_ CAN_FL_DET_VALID_FLAG_052 : 432|1@0+ (1,0) [0|1] ""  IFV
 SG_ CAN_FL_DET_SUPER_RES_052 : 440|1@0+ (1,0) [0|1] ""  IFV
 SG_ CAN_FL_DET_LOW_SNR_FLAG_052 : 441|1@0+ (1,0) [0|1] ""  IFV
 SG_ CAN_FL_DET_MIXER_BIAS_FLAG_052 : 442|1@0+ (1,0) [0|1] ""  IFV
 SG_ CAN_FL_DET_RESERVED_FLAGS_052 : 447|5@0+ (1,0) [0|31] ""  IFV
 SG_ CAN_FL_DET_SNR_052 : 455|8@0+ (0.35156,0) [0|89.6478] "dB"  IFV
 SG_ CAN_FL_DET_MULTI_TARGET_PROB_052 : 459|4@0+ (0.06667,0) [0|1] ""  IFV
 SG_ CAN_FL_DET_CONFID_AZIMUTH_052 : 461|2@0+ (1,0) [0|3] ""  IFV
 SG_ CAN_FL_DET_CONFID_ELEVATION_052 : 463|2@0+ (1,0) [0|3] ""  IFV
 SG_ CAN_FL_DET_EXISTENCE_PROB_052 : 467|4@0+ (1,0) [0|15] ""  IFV
 SG_ CAN_FL_DET_CLASS_052 : 471|4@0+ (1,0) [0|15] ""  IFV

BO_ 781 SODFL_DETECTION_053_056: 64 SODFL
 SG_ CAN_FL_DET_RANGE_053 : 7|14@0+ (0.015625,0) [0|255.984375] "m"  IFV
 SG_ CAN_FL_DET_SD_RANGE_053 : 9|6@0+ (0.025,0) [0|1.5] "m"  IFV
 SG_ CAN_FL_DET_RANGE_RATE_053 : 19|14@0+ (0.015625,-128) [-128|127.984375] "m/s"  IFV
 SG_ CAN_FL_DET_SD_RANGE_RATE_053 : 37|6@0+ (0.02,0) [0|1.2] "m/s"  IFV
 SG_ CAN_FL_DET_AZIMUTH_053 : 47|13@0+ (0.0007668,-3.141593) [-3.141593|3.141593] "rad"  IFV
 SG_ CAN_FL_DET_SD_AZIMUTH_053 : 50|6@0+ (0.001745329,0) [0|0.104719755] "rad"  IFV
 SG_ CAN_FL_DET_ELEVATION_053 : 60|7@0+ (0.157449,-9.99812) [-9.99812|9.997903] "deg"  IFV
 SG_ CAN_FL_DET_SD_ELEVATION_053 : 69|6@0+ (0.003490659,0) [0|0.20943951] "rad"  IFV
 SG_ CAN_FL_DET_AMPLITUDE_053 : 79|7@0+ (1,-64) [-64|63] "dBsm"  IFV
 SG_ CAN_FL_DET_VALID_FLAG_053 : 72|1@0+ (1,0) [0|1] ""  IFV
 SG_ CAN_FL_DET_SUPER_RES_053 : 80|1@0+ (1,0) [0|1] ""  IFV
 SG_ CAN_FL_DET_LOW_SNR_FLAG_053 : 81|1@0+ (1,0) [0|1] ""  IFV
 SG_ CAN_FL_DET_MIXER_BIAS_FLAG_053 : 82|1@0+ (1,0) [0|1] ""  IFV
 SG_ CAN_FL_DET_RESERVED_FLAGS_053 : 87|5@0+ (1,0) [0|31] ""  IFV
 SG_ CAN_FL_DET_SNR_053 : 95|8@0+ (0.35156,0) [0|89.6478] "dB"  IFV
 SG_ CAN_FL_DET_MULTI_TARGET_PROB_053 : 99|4@0+ (0.06667,0) [0|1] ""  IFV
 SG_ CAN_FL_DET_CONFID_AZIMUTH_053 : 101|2@0+ (1,0) [0|3] ""  IFV
 SG_ CAN_FL_DET_CONFID_ELEVATION_053 : 103|2@0+ (1,0) [0|3] ""  IFV
 SG_ CAN_FL_DET_EXISTENCE_PROB_053 : 107|4@0+ (1,0) [0|15] ""  IFV
 SG_ CAN_FL_DET_CLASS_053 : 111|4@0+ (1,0) [0|15] ""  IFV
 SG_ CAN_FL_DET_RANGE_054 : 127|14@0+ (0.015625,0) [0|255.984375] "m"  IFV
 SG_ CAN_FL_DET_SD_RANGE_054 : 129|6@0+ (0.025,0) [0|1.5] "m"  IFV
 SG_ CAN_FL_DET_RANGE_RATE_054 : 139|14@0+ (0.015625,-128) [-128|127.984375] "m/s"  IFV
 SG_ CAN_FL_DET_SD_RANGE_RATE_054 : 157|6@0+ (0.02,0) [0|1.2] "m/s"  IFV
 SG_ CAN_FL_DET_AZIMUTH_054 : 167|13@0+ (0.0007668,-3.141593) [-3.141593|3.141593] "rad"  IFV
 SG_ CAN_FL_DET_SD_AZIMUTH_054 : 170|6@0+ (0.001745329,0) [0|0.104719755] "rad"  IFV
 SG_ CAN_FL_DET_ELEVATION_054 : 180|7@0+ (0.157449,-9.99812) [-9.99812|9.997903] "deg"  IFV
 SG_ CAN_FL_DET_SD_ELEVATION_054 : 189|6@0+ (0.003490659,0) [0|0.20943951] "rad"  IFV
 SG_ CAN_FL_DET_AMPLITUDE_054 : 199|7@0+ (1,-64) [-64|63] "dBsm"  IFV
 SG_ CAN_FL_DET_VALID_FLAG_054 : 192|1@0+ (1,0) [0|1] ""  IFV
 SG_ CAN_FL_DET_SUPER_RES_054 : 200|1@0+ (1,0) [0|1] ""  IFV
 SG_ CAN_FL_DET_LOW_SNR_FLAG_054 : 201|1@0+ (1,0) [0|1] ""  IFV
 SG_ CAN_FL_DET_MIXER_BIAS_FLAG_054 : 202|1@0+ (1,0) [0|1] ""  IFV
 SG_ CAN_FL_DET_RESERVED_FLAGS_054 : 207|5@0+ (1,0) [0|31] ""  IFV
 SG_ CAN_FL_DET_SNR_054 : 215|8@0+ (0.35156,0) [0|89.6478] "dB"  IFV
 SG_ CAN_FL_DET_MULTI_TARGET_PROB_054 : 219|4@0+ (0.06667,0) [0|1] ""  IFV
 SG_ CAN_FL_DET_CONFID_AZIMUTH_054 : 221|2@0+ (1,0) [0|3] ""  IFV
 SG_ CAN_FL_DET_CONFID_ELEVATION_054 : 223|2@0+ (1,0) [0|3] ""  IFV
 SG_ CAN_FL_DET_EXISTENCE_PROB_054 : 227|4@0+ (1,0) [0|15] ""  IFV
 SG_ CAN_FL_DET_CLASS_054 : 231|4@0+ (1,0) [0|15] ""  IFV
 SG_ CAN_FL_DET_RANGE_055 : 247|14@0+ (0.015625,0) [0|255.984375] "m"  IFV
 SG_ CAN_FL_DET_SD_RANGE_055 : 249|6@0+ (0.025,0) [0|1.5] "m"  IFV
 SG_ CAN_FL_DET_RANGE_RATE_055 : 259|14@0+ (0.015625,-128) [-128|127.984375] "m/s"  IFV
 SG_ CAN_FL_DET_SD_RANGE_RATE_055 : 277|6@0+ (0.02,0) [0|1.2] "m/s"  IFV
 SG_ CAN_FL_DET_AZIMUTH_055 : 287|13@0+ (0.0007668,-3.141593) [-3.141593|3.141593] "rad"  IFV
 SG_ CAN_FL_DET_SD_AZIMUTH_055 : 290|6@0+ (0.001745329,0) [0|0.104719755] "rad"  IFV
 SG_ CAN_FL_DET_ELEVATION_055 : 300|7@0+ (0.157449,-9.99812) [-9.99812|9.997903] "deg"  IFV
 SG_ CAN_FL_DET_SD_ELEVATION_055 : 309|6@0+ (0.003490659,0) [0|0.20943951] "rad"  IFV
 SG_ CAN_FL_DET_AMPLITUDE_055 : 319|7@0+ (1,-64) [-64|63] "dBsm"  IFV
 SG_ CAN_FL_DET_VALID_FLAG_055 : 312|1@0+ (1,0) [0|1] ""  IFV
 SG_ CAN_FL_DET_SUPER_RES_055 : 320|1@0+ (1,0) [0|1] ""  IFV
 SG_ CAN_FL_DET_LOW_SNR_FLAG_055 : 321|1@0+ (1,0) [0|1] ""  IFV
 SG_ CAN_FL_DET_MIXER_BIAS_FLAG_055 : 322|1@0+ (1,0) [0|1] ""  IFV
 SG_ CAN_FL_DET_RESERVED_FLAGS_055 : 327|5@0+ (1,0) [0|31] ""  IFV
 SG_ CAN_FL_DET_SNR_055 : 335|8@0+ (0.35156,0) [0|89.6478] "dB"  IFV
 SG_ CAN_FL_DET_MULTI_TARGET_PROB_055 : 339|4@0+ (0.06667,0) [0|1] ""  IFV
 SG_ CAN_FL_DET_CONFID_AZIMUTH_055 : 341|2@0+ (1,0) [0|3] ""  IFV
 SG_ CAN_FL_DET_CONFID_ELEVATION_055 : 343|2@0+ (1,0) [0|3] ""  IFV
 SG_ CAN_FL_DET_EXISTENCE_PROB_055 : 347|4@0+ (1,0) [0|15] ""  IFV
 SG_ CAN_FL_DET_CLASS_055 : 351|4@0+ (1,0) [0|15] ""  IFV
 SG_ CAN_FL_DET_RANGE_056 : 367|14@0+ (0.015625,0) [0|255.984375] "m"  IFV
 SG_ CAN_FL_DET_SD_RANGE_056 : 369|6@0+ (0.025,0) [0|1.5] "m"  IFV
 SG_ CAN_FL_DET_RANGE_RATE_056 : 379|14@0+ (0.015625,-128) [-128|127.984375] "m/s"  IFV
 SG_ CAN_FL_DET_SD_RANGE_RATE_056 : 397|6@0+ (0.02,0) [0|1.2] "m/s"  IFV
 SG_ CAN_FL_DET_AZIMUTH_056 : 407|13@0+ (0.0007668,-3.141593) [-3.141593|3.141593] "rad"  IFV
 SG_ CAN_FL_DET_SD_AZIMUTH_056 : 410|6@0+ (0.001745329,0) [0|0.104719755] "rad"  IFV
 SG_ CAN_FL_DET_ELEVATION_056 : 420|7@0+ (0.157449,-9.99812) [-9.99812|9.997903] "deg"  IFV
 SG_ CAN_FL_DET_SD_ELEVATION_056 : 429|6@0+ (0.003490659,0) [0|0.20943951] "rad"  IFV
 SG_ CAN_FL_DET_AMPLITUDE_056 : 439|7@0+ (1,-64) [-64|63] "dBsm"  IFV
 SG_ CAN_FL_DET_VALID_FLAG_056 : 432|1@0+ (1,0) [0|1] ""  IFV
 SG_ CAN_FL_DET_SUPER_RES_056 : 440|1@0+ (1,0) [0|1] ""  IFV
 SG_ CAN_FL_DET_LOW_SNR_FLAG_056 : 441|1@0+ (1,0) [0|1] ""  IFV
 SG_ CAN_FL_DET_MIXER_BIAS_FLAG_056 : 442|1@0+ (1,0) [0|1] ""  IFV
 SG_ CAN_FL_DET_RESERVED_FLAGS_056 : 447|5@0+ (1,0) [0|31] ""  IFV
 SG_ CAN_FL_DET_SNR_056 : 455|8@0+ (0.35156,0) [0|89.6478] "dB"  IFV
 SG_ CAN_FL_DET_MULTI_TARGET_PROB_056 : 459|4@0+ (0.06667,0) [0|1] ""  IFV
 SG_ CAN_FL_DET_CONFID_AZIMUTH_056 : 461|2@0+ (1,0) [0|3] ""  IFV
 SG_ CAN_FL_DET_CONFID_ELEVATION_056 : 463|2@0+ (1,0) [0|3] ""  IFV
 SG_ CAN_FL_DET_EXISTENCE_PROB_056 : 467|4@0+ (1,0) [0|15] ""  IFV
 SG_ CAN_FL_DET_CLASS_056 : 471|4@0+ (1,0) [0|15] ""  IFV

BO_ 782 SODFL_DETECTION_057_060: 64 SODFL
 SG_ CAN_FL_DET_RANGE_057 : 7|14@0+ (0.015625,0) [0|255.984375] "m"  IFV
 SG_ CAN_FL_DET_SD_RANGE_057 : 9|6@0+ (0.025,0) [0|1.5] "m"  IFV
 SG_ CAN_FL_DET_RANGE_RATE_057 : 19|14@0+ (0.015625,-128) [-128|127.984375] "m/s"  IFV
 SG_ CAN_FL_DET_SD_RANGE_RATE_057 : 37|6@0+ (0.02,0) [0|1.2] "m/s"  IFV
 SG_ CAN_FL_DET_AZIMUTH_057 : 47|13@0+ (0.0007668,-3.141593) [-3.141593|3.141593] "rad"  IFV
 SG_ CAN_FL_DET_SD_AZIMUTH_057 : 50|6@0+ (0.001745329,0) [0|0.104719755] "rad"  IFV
 SG_ CAN_FL_DET_ELEVATION_057 : 60|7@0+ (0.157449,-9.99812) [-9.99812|9.997903] "deg"  IFV
 SG_ CAN_FL_DET_SD_ELEVATION_057 : 69|6@0+ (0.003490659,0) [0|0.20943951] "rad"  IFV
 SG_ CAN_FL_DET_AMPLITUDE_057 : 79|7@0+ (1,-64) [-64|63] "dBsm"  IFV
 SG_ CAN_FL_DET_VALID_FLAG_057 : 72|1@0+ (1,0) [0|1] ""  IFV
 SG_ CAN_FL_DET_SUPER_RES_057 : 80|1@0+ (1,0) [0|1] ""  IFV
 SG_ CAN_FL_DET_LOW_SNR_FLAG_057 : 81|1@0+ (1,0) [0|1] ""  IFV
 SG_ CAN_FL_DET_MIXER_BIAS_FLAG_057 : 82|1@0+ (1,0) [0|1] ""  IFV
 SG_ CAN_FL_DET_RESERVED_FLAGS_057 : 87|5@0+ (1,0) [0|31] ""  IFV
 SG_ CAN_FL_DET_SNR_057 : 95|8@0+ (0.35156,0) [0|89.6478] "dB"  IFV
 SG_ CAN_FL_DET_MULTI_TARGET_PROB_057 : 99|4@0+ (0.06667,0) [0|1] ""  IFV
 SG_ CAN_FL_DET_CONFID_AZIMUTH_057 : 101|2@0+ (1,0) [0|3] ""  IFV
 SG_ CAN_FL_DET_CONFID_ELEVATION_057 : 103|2@0+ (1,0) [0|3] ""  IFV
 SG_ CAN_FL_DET_EXISTENCE_PROB_057 : 107|4@0+ (1,0) [0|15] ""  IFV
 SG_ CAN_FL_DET_CLASS_057 : 111|4@0+ (1,0) [0|15] ""  IFV
 SG_ CAN_FL_DET_RANGE_058 : 127|14@0+ (0.015625,0) [0|255.984375] "m"  IFV
 SG_ CAN_FL_DET_SD_RANGE_058 : 129|6@0+ (0.025,0) [0|1.5] "m"  IFV
 SG_ CAN_FL_DET_RANGE_RATE_058 : 139|14@0+ (0.015625,-128) [-128|127.984375] "m/s"  IFV
 SG_ CAN_FL_DET_SD_RANGE_RATE_058 : 157|6@0+ (0.02,0) [0|1.2] "m/s"  IFV
 SG_ CAN_FL_DET_AZIMUTH_058 : 167|13@0+ (0.0007668,-3.141593) [-3.141593|3.141593] "rad"  IFV
 SG_ CAN_FL_DET_SD_AZIMUTH_058 : 170|6@0+ (0.001745329,0) [0|0.104719755] "rad"  IFV
 SG_ CAN_FL_DET_ELEVATION_058 : 180|7@0+ (0.157449,-9.99812) [-9.99812|9.997903] "deg"  IFV
 SG_ CAN_FL_DET_SD_ELEVATION_058 : 189|6@0+ (0.003490659,0) [0|0.20943951] "rad"  IFV
 SG_ CAN_FL_DET_AMPLITUDE_058 : 199|7@0+ (1,-64) [-64|63] "dBsm"  IFV
 SG_ CAN_FL_DET_VALID_FLAG_058 : 192|1@0+ (1,0) [0|1] ""  IFV
 SG_ CAN_FL_DET_SUPER_RES_058 : 200|1@0+ (1,0) [0|1] ""  IFV
 SG_ CAN_FL_DET_LOW_SNR_FLAG_058 : 201|1@0+ (1,0) [0|1] ""  IFV
 SG_ CAN_FL_DET_MIXER_BIAS_FLAG_058 : 202|1@0+ (1,0) [0|1] ""  IFV
 SG_ CAN_FL_DET_RESERVED_FLAGS_058 : 207|5@0+ (1,0) [0|31] ""  IFV
 SG_ CAN_FL_DET_SNR_058 : 215|8@0+ (0.35156,0) [0|89.6478] "dB"  IFV
 SG_ CAN_FL_DET_MULTI_TARGET_PROB_058 : 219|4@0+ (0.06667,0) [0|1] ""  IFV
 SG_ CAN_FL_DET_CONFID_AZIMUTH_058 : 221|2@0+ (1,0) [0|3] ""  IFV
 SG_ CAN_FL_DET_CONFID_ELEVATION_058 : 223|2@0+ (1,0) [0|3] ""  IFV
 SG_ CAN_FL_DET_EXISTENCE_PROB_058 : 227|4@0+ (1,0) [0|15] ""  IFV
 SG_ CAN_FL_DET_CLASS_058 : 231|4@0+ (1,0) [0|15] ""  IFV
 SG_ CAN_FL_DET_RANGE_059 : 247|14@0+ (0.015625,0) [0|255.984375] "m"  IFV
 SG_ CAN_FL_DET_SD_RANGE_059 : 249|6@0+ (0.025,0) [0|1.5] "m"  IFV
 SG_ CAN_FL_DET_RANGE_RATE_059 : 259|14@0+ (0.015625,-128) [-128|127.984375] "m/s"  IFV
 SG_ CAN_FL_DET_SD_RANGE_RATE_059 : 277|6@0+ (0.02,0) [0|1.2] "m/s"  IFV
 SG_ CAN_FL_DET_AZIMUTH_059 : 287|13@0+ (0.0007668,-3.141593) [-3.141593|3.141593] "rad"  IFV
 SG_ CAN_FL_DET_SD_AZIMUTH_059 : 290|6@0+ (0.001745329,0) [0|0.104719755] "rad"  IFV
 SG_ CAN_FL_DET_ELEVATION_059 : 300|7@0+ (0.157449,-9.99812) [-9.99812|9.997903] "deg"  IFV
 SG_ CAN_FL_DET_SD_ELEVATION_059 : 309|6@0+ (0.003490659,0) [0|0.20943951] "rad"  IFV
 SG_ CAN_FL_DET_AMPLITUDE_059 : 319|7@0+ (1,-64) [-64|63] "dBsm"  IFV
 SG_ CAN_FL_DET_VALID_FLAG_059 : 312|1@0+ (1,0) [0|1] ""  IFV
 SG_ CAN_FL_DET_SUPER_RES_059 : 320|1@0+ (1,0) [0|1] ""  IFV
 SG_ CAN_FL_DET_LOW_SNR_FLAG_059 : 321|1@0+ (1,0) [0|1] ""  IFV
 SG_ CAN_FL_DET_MIXER_BIAS_FLAG_059 : 322|1@0+ (1,0) [0|1] ""  IFV
 SG_ CAN_FL_DET_RESERVED_FLAGS_059 : 327|5@0+ (1,0) [0|31] ""  IFV
 SG_ CAN_FL_DET_SNR_059 : 335|8@0+ (0.35156,0) [0|89.6478] "dB"  IFV
 SG_ CAN_FL_DET_MULTI_TARGET_PROB_059 : 339|4@0+ (0.06667,0) [0|1] ""  IFV
 SG_ CAN_FL_DET_CONFID_AZIMUTH_059 : 341|2@0+ (1,0) [0|3] ""  IFV
 SG_ CAN_FL_DET_CONFID_ELEVATION_059 : 343|2@0+ (1,0) [0|3] ""  IFV
 SG_ CAN_FL_DET_EXISTENCE_PROB_059 : 347|4@0+ (1,0) [0|15] ""  IFV
 SG_ CAN_FL_DET_CLASS_059 : 351|4@0+ (1,0) [0|15] ""  IFV
 SG_ CAN_FL_DET_RANGE_060 : 367|14@0+ (0.015625,0) [0|255.984375] "m"  IFV
 SG_ CAN_FL_DET_SD_RANGE_060 : 369|6@0+ (0.025,0) [0|1.5] "m"  IFV
 SG_ CAN_FL_DET_RANGE_RATE_060 : 379|14@0+ (0.015625,-128) [-128|127.984375] "m/s"  IFV
 SG_ CAN_FL_DET_SD_RANGE_RATE_060 : 397|6@0+ (0.02,0) [0|1.2] "m/s"  IFV
 SG_ CAN_FL_DET_AZIMUTH_060 : 407|13@0+ (0.0007668,-3.141593) [-3.141593|3.141593] "rad"  IFV
 SG_ CAN_FL_DET_SD_AZIMUTH_060 : 410|6@0+ (0.001745329,0) [0|0.104719755] "rad"  IFV
 SG_ CAN_FL_DET_ELEVATION_060 : 420|7@0+ (0.157449,-9.99812) [-9.99812|9.997903] "deg"  IFV
 SG_ CAN_FL_DET_SD_ELEVATION_060 : 429|6@0+ (0.003490659,0) [0|0.20943951] "rad"  IFV
 SG_ CAN_FL_DET_AMPLITUDE_060 : 439|7@0+ (1,-64) [-64|63] "dBsm"  IFV
 SG_ CAN_FL_DET_VALID_FLAG_060 : 432|1@0+ (1,0) [0|1] ""  IFV
 SG_ CAN_FL_DET_SUPER_RES_060 : 440|1@0+ (1,0) [0|1] ""  IFV
 SG_ CAN_FL_DET_LOW_SNR_FLAG_060 : 441|1@0+ (1,0) [0|1] ""  IFV
 SG_ CAN_FL_DET_MIXER_BIAS_FLAG_060 : 442|1@0+ (1,0) [0|1] ""  IFV
 SG_ CAN_FL_DET_RESERVED_FLAGS_060 : 447|5@0+ (1,0) [0|31] ""  IFV
 SG_ CAN_FL_DET_SNR_060 : 455|8@0+ (0.35156,0) [0|89.6478] "dB"  IFV
 SG_ CAN_FL_DET_MULTI_TARGET_PROB_060 : 459|4@0+ (0.06667,0) [0|1] ""  IFV
 SG_ CAN_FL_DET_CONFID_AZIMUTH_060 : 461|2@0+ (1,0) [0|3] ""  IFV
 SG_ CAN_FL_DET_CONFID_ELEVATION_060 : 463|2@0+ (1,0) [0|3] ""  IFV
 SG_ CAN_FL_DET_EXISTENCE_PROB_060 : 467|4@0+ (1,0) [0|15] ""  IFV
 SG_ CAN_FL_DET_CLASS_060 : 471|4@0+ (1,0) [0|15] ""  IFV

BO_ 783 SODFL_DETECTION_061_064: 64 SODFL
 SG_ CAN_FL_DET_RANGE_061 : 7|14@0+ (0.015625,0) [0|255.984375] "m"  IFV
 SG_ CAN_FL_DET_SD_RANGE_061 : 9|6@0+ (0.025,0) [0|1.5] "m"  IFV
 SG_ CAN_FL_DET_RANGE_RATE_061 : 19|14@0+ (0.015625,-128) [-128|127.984375] "m/s"  IFV
 SG_ CAN_FL_DET_SD_RANGE_RATE_061 : 37|6@0+ (0.02,0) [0|1.2] "m/s"  IFV
 SG_ CAN_FL_DET_AZIMUTH_061 : 47|13@0+ (0.0007668,-3.141593) [-3.141593|3.141593] "rad"  IFV
 SG_ CAN_FL_DET_SD_AZIMUTH_061 : 50|6@0+ (0.001745329,0) [0|0.104719755] "rad"  IFV
 SG_ CAN_FL_DET_ELEVATION_061 : 60|7@0+ (0.157449,-9.99812) [-9.99812|9.997903] "deg"  IFV
 SG_ CAN_FL_DET_SD_ELEVATION_061 : 69|6@0+ (0.003490659,0) [0|0.20943951] "rad"  IFV
 SG_ CAN_FL_DET_AMPLITUDE_061 : 79|7@0+ (1,-64) [-64|63] "dBsm"  IFV
 SG_ CAN_FL_DET_VALID_FLAG_061 : 72|1@0+ (1,0) [0|1] ""  IFV
 SG_ CAN_FL_DET_SUPER_RES_061 : 80|1@0+ (1,0) [0|1] ""  IFV
 SG_ CAN_FL_DET_LOW_SNR_FLAG_061 : 81|1@0+ (1,0) [0|1] ""  IFV
 SG_ CAN_FL_DET_MIXER_BIAS_FLAG_061 : 82|1@0+ (1,0) [0|1] ""  IFV
 SG_ CAN_FL_DET_RESERVED_FLAGS_061 : 87|5@0+ (1,0) [0|31] ""  IFV
 SG_ CAN_FL_DET_SNR_061 : 95|8@0+ (0.35156,0) [0|89.6478] "dB"  IFV
 SG_ CAN_FL_DET_MULTI_TARGET_PROB_061 : 99|4@0+ (0.06667,0) [0|1] ""  IFV
 SG_ CAN_FL_DET_CONFID_AZIMUTH_061 : 101|2@0+ (1,0) [0|3] ""  IFV
 SG_ CAN_FL_DET_CONFID_ELEVATION_061 : 103|2@0+ (1,0) [0|3] ""  IFV
 SG_ CAN_FL_DET_EXISTENCE_PROB_061 : 107|4@0+ (1,0) [0|15] ""  IFV
 SG_ CAN_FL_DET_CLASS_061 : 111|4@0+ (1,0) [0|15] ""  IFV
 SG_ CAN_FL_DET_RANGE_062 : 127|14@0+ (0.015625,0) [0|255.984375] "m"  IFV
 SG_ CAN_FL_DET_SD_RANGE_062 : 129|6@0+ (0.025,0) [0|1.5] "m"  IFV
 SG_ CAN_FL_DET_RANGE_RATE_062 : 139|14@0+ (0.015625,-128) [-128|127.984375] "m/s"  IFV
 SG_ CAN_FL_DET_SD_RANGE_RATE_062 : 157|6@0+ (0.02,0) [0|1.2] "m/s"  IFV
 SG_ CAN_FL_DET_AZIMUTH_062 : 167|13@0+ (0.0007668,-3.141593) [-3.141593|3.141593] "rad"  IFV
 SG_ CAN_FL_DET_SD_AZIMUTH_062 : 170|6@0+ (0.001745329,0) [0|0.104719755] "rad"  IFV
 SG_ CAN_FL_DET_ELEVATION_062 : 180|7@0+ (0.157449,-9.99812) [-9.99812|9.997903] "deg"  IFV
 SG_ CAN_FL_DET_SD_ELEVATION_062 : 189|6@0+ (0.003490659,0) [0|0.20943951] "rad"  IFV
 SG_ CAN_FL_DET_AMPLITUDE_062 : 199|7@0+ (1,-64) [-64|63] "dBsm"  IFV
 SG_ CAN_FL_DET_VALID_FLAG_062 : 192|1@0+ (1,0) [0|1] ""  IFV
 SG_ CAN_FL_DET_SUPER_RES_062 : 200|1@0+ (1,0) [0|1] ""  IFV
 SG_ CAN_FL_DET_LOW_SNR_FLAG_062 : 201|1@0+ (1,0) [0|1] ""  IFV
 SG_ CAN_FL_DET_MIXER_BIAS_FLAG_062 : 202|1@0+ (1,0) [0|1] ""  IFV
 SG_ CAN_FL_DET_RESERVED_FLAGS_062 : 207|5@0+ (1,0) [0|31] ""  IFV
 SG_ CAN_FL_DET_SNR_062 : 215|8@0+ (0.35156,0) [0|89.6478] "dB"  IFV
 SG_ CAN_FL_DET_MULTI_TARGET_PROB_062 : 219|4@0+ (0.06667,0) [0|1] ""  IFV
 SG_ CAN_FL_DET_CONFID_AZIMUTH_062 : 221|2@0+ (1,0) [0|3] ""  IFV
 SG_ CAN_FL_DET_CONFID_ELEVATION_062 : 223|2@0+ (1,0) [0|3] ""  IFV
 SG_ CAN_FL_DET_EXISTENCE_PROB_062 : 227|4@0+ (1,0) [0|15] ""  IFV
 SG_ CAN_FL_DET_CLASS_062 : 231|4@0+ (1,0) [0|15] ""  IFV
 SG_ CAN_FL_DET_RANGE_063 : 247|14@0+ (0.015625,0) [0|255.984375] "m"  IFV
 SG_ CAN_FL_DET_SD_RANGE_063 : 249|6@0+ (0.025,0) [0|1.5] "m"  IFV
 SG_ CAN_FL_DET_RANGE_RATE_063 : 259|14@0+ (0.015625,-128) [-128|127.984375] "m/s"  IFV
 SG_ CAN_FL_DET_SD_RANGE_RATE_063 : 277|6@0+ (0.02,0) [0|1.2] "m/s"  IFV
 SG_ CAN_FL_DET_AZIMUTH_063 : 287|13@0+ (0.0007668,-3.141593) [-3.141593|3.141593] "rad"  IFV
 SG_ CAN_FL_DET_SD_AZIMUTH_063 : 290|6@0+ (0.001745329,0) [0|0.104719755] "rad"  IFV
 SG_ CAN_FL_DET_ELEVATION_063 : 300|7@0+ (0.157449,-9.99812) [-9.99812|9.997903] "deg"  IFV
 SG_ CAN_FL_DET_SD_ELEVATION_063 : 309|6@0+ (0.003490659,0) [0|0.20943951] "rad"  IFV
 SG_ CAN_FL_DET_AMPLITUDE_063 : 319|7@0+ (1,-64) [-64|63] "dBsm"  IFV
 SG_ CAN_FL_DET_VALID_FLAG_063 : 312|1@0+ (1,0) [0|1] ""  IFV
 SG_ CAN_FL_DET_SUPER_RES_063 : 320|1@0+ (1,0) [0|1] ""  IFV
 SG_ CAN_FL_DET_LOW_SNR_FLAG_063 : 321|1@0+ (1,0) [0|1] ""  IFV
 SG_ CAN_FL_DET_MIXER_BIAS_FLAG_063 : 322|1@0+ (1,0) [0|1] ""  IFV
 SG_ CAN_FL_DET_RESERVED_FLAGS_063 : 327|5@0+ (1,0) [0|31] ""  IFV
 SG_ CAN_FL_DET_SNR_063 : 335|8@0+ (0.35156,0) [0|89.6478] "dB"  IFV
 SG_ CAN_FL_DET_MULTI_TARGET_PROB_063 : 339|4@0+ (0.06667,0) [0|1] ""  IFV
 SG_ CAN_FL_DET_CONFID_AZIMUTH_063 : 341|2@0+ (1,0) [0|3] ""  IFV
 SG_ CAN_FL_DET_CONFID_ELEVATION_063 : 343|2@0+ (1,0) [0|3] ""  IFV
 SG_ CAN_FL_DET_EXISTENCE_PROB_063 : 347|4@0+ (1,0) [0|15] ""  IFV
 SG_ CAN_FL_DET_CLASS_063 : 351|4@0+ (1,0) [0|15] ""  IFV
 SG_ CAN_FL_DET_RANGE_064 : 367|14@0+ (0.015625,0) [0|255.984375] "m"  IFV
 SG_ CAN_FL_DET_SD_RANGE_064 : 369|6@0+ (0.025,0) [0|1.5] "m"  IFV
 SG_ CAN_FL_DET_RANGE_RATE_064 : 379|14@0+ (0.015625,-128) [-128|127.984375] "m/s"  IFV
 SG_ CAN_FL_DET_SD_RANGE_RATE_064 : 397|6@0+ (0.02,0) [0|1.2] "m/s"  IFV
 SG_ CAN_FL_DET_AZIMUTH_064 : 407|13@0+ (0.0007668,-3.141593) [-3.141593|3.141593] "rad"  IFV
 SG_ CAN_FL_DET_SD_AZIMUTH_064 : 410|6@0+ (0.001745329,0) [0|0.104719755] "rad"  IFV
 SG_ CAN_FL_DET_ELEVATION_064 : 420|7@0+ (0.157449,-9.99812) [-9.99812|9.997903] "deg"  IFV
 SG_ CAN_FL_DET_SD_ELEVATION_064 : 429|6@0+ (0.003490659,0) [0|0.20943951] "rad"  IFV
 SG_ CAN_FL_DET_AMPLITUDE_064 : 439|7@0+ (1,-64) [-64|63] "dBsm"  IFV
 SG_ CAN_FL_DET_VALID_FLAG_064 : 432|1@0+ (1,0) [0|1] ""  IFV
 SG_ CAN_FL_DET_SUPER_RES_064 : 440|1@0+ (1,0) [0|1] ""  IFV
 SG_ CAN_FL_DET_LOW_SNR_FLAG_064 : 441|1@0+ (1,0) [0|1] ""  IFV
 SG_ CAN_FL_DET_MIXER_BIAS_FLAG_064 : 442|1@0+ (1,0) [0|1] ""  IFV
 SG_ CAN_FL_DET_RESERVED_FLAGS_064 : 447|5@0+ (1,0) [0|31] ""  IFV
 SG_ CAN_FL_DET_SNR_064 : 455|8@0+ (0.35156,0) [0|89.6478] "dB"  IFV
 SG_ CAN_FL_DET_MULTI_TARGET_PROB_064 : 459|4@0+ (0.06667,0) [0|1] ""  IFV
 SG_ CAN_FL_DET_CONFID_AZIMUTH_064 : 461|2@0+ (1,0) [0|3] ""  IFV
 SG_ CAN_FL_DET_CONFID_ELEVATION_064 : 463|2@0+ (1,0) [0|3] ""  IFV
 SG_ CAN_FL_DET_EXISTENCE_PROB_064 : 467|4@0+ (1,0) [0|15] ""  IFV
 SG_ CAN_FL_DET_CLASS_064 : 471|4@0+ (1,0) [0|15] ""  IFV

BO_ 784 SODFL_DETECTION_065_068: 64 SODFL
 SG_ CAN_FL_DET_RANGE_065 : 7|14@0+ (0.015625,0) [0|255.984375] "m"  IFV
 SG_ CAN_FL_DET_SD_RANGE_065 : 9|6@0+ (0.025,0) [0|1.5] "m"  IFV
 SG_ CAN_FL_DET_RANGE_RATE_065 : 19|14@0+ (0.015625,-128) [-128|127.984375] "m/s"  IFV
 SG_ CAN_FL_DET_SD_RANGE_RATE_065 : 37|6@0+ (0.02,0) [0|1.2] "m/s"  IFV
 SG_ CAN_FL_DET_AZIMUTH_065 : 47|13@0+ (0.0007668,-3.141593) [-3.141593|3.141593] "rad"  IFV
 SG_ CAN_FL_DET_SD_AZIMUTH_065 : 50|6@0+ (0.001745329,0) [0|0.104719755] "rad"  IFV
 SG_ CAN_FL_DET_ELEVATION_065 : 60|7@0+ (0.157449,-9.99812) [-9.99812|9.997903] "deg"  IFV
 SG_ CAN_FL_DET_SD_ELEVATION_065 : 69|6@0+ (0.003490659,0) [0|0.20943951] "rad"  IFV
 SG_ CAN_FL_DET_AMPLITUDE_065 : 79|7@0+ (1,-64) [-64|63] "dBsm"  IFV
 SG_ CAN_FL_DET_VALID_FLAG_065 : 72|1@0+ (1,0) [0|1] ""  IFV
 SG_ CAN_FL_DET_SUPER_RES_065 : 80|1@0+ (1,0) [0|1] ""  IFV
 SG_ CAN_FL_DET_LOW_SNR_FLAG_065 : 81|1@0+ (1,0) [0|1] ""  IFV
 SG_ CAN_FL_DET_MIXER_BIAS_FLAG_065 : 82|1@0+ (1,0) [0|1] ""  IFV
 SG_ CAN_FL_DET_RESERVED_FLAGS_065 : 87|5@0+ (1,0) [0|31] ""  IFV
 SG_ CAN_FL_DET_SNR_065 : 95|8@0+ (0.35156,0) [0|89.6478] "dB"  IFV
 SG_ CAN_FL_DET_MULTI_TARGET_PROB_065 : 99|4@0+ (0.06667,0) [0|1] ""  IFV
 SG_ CAN_FL_DET_CONFID_AZIMUTH_065 : 101|2@0+ (1,0) [0|3] ""  IFV
 SG_ CAN_FL_DET_CONFID_ELEVATION_065 : 103|2@0+ (1,0) [0|3] ""  IFV
 SG_ CAN_FL_DET_EXISTENCE_PROB_065 : 107|4@0+ (1,0) [0|15] ""  IFV
 SG_ CAN_FL_DET_CLASS_065 : 111|4@0+ (1,0) [0|15] ""  IFV
 SG_ CAN_FL_DET_RANGE_066 : 127|14@0+ (0.015625,0) [0|255.984375] "m"  IFV
 SG_ CAN_FL_DET_SD_RANGE_066 : 129|6@0+ (0.025,0) [0|1.5] "m"  IFV
 SG_ CAN_FL_DET_RANGE_RATE_066 : 139|14@0+ (0.015625,-128) [-128|127.984375] "m/s"  IFV
 SG_ CAN_FL_DET_SD_RANGE_RATE_066 : 157|6@0+ (0.02,0) [0|1.2] "m/s"  IFV
 SG_ CAN_FL_DET_AZIMUTH_066 : 167|13@0+ (0.0007668,-3.141593) [-3.141593|3.141593] "rad"  IFV
 SG_ CAN_FL_DET_SD_AZIMUTH_066 : 170|6@0+ (0.001745329,0) [0|0.104719755] "rad"  IFV
 SG_ CAN_FL_DET_ELEVATION_066 : 180|7@0+ (0.157449,-9.99812) [-9.99812|9.997903] "deg"  IFV
 SG_ CAN_FL_DET_SD_ELEVATION_066 : 189|6@0+ (0.003490659,0) [0|0.20943951] "rad"  IFV
 SG_ CAN_FL_DET_AMPLITUDE_066 : 199|7@0+ (1,-64) [-64|63] "dBsm"  IFV
 SG_ CAN_FL_DET_VALID_FLAG_066 : 192|1@0+ (1,0) [0|1] ""  IFV
 SG_ CAN_FL_DET_SUPER_RES_066 : 200|1@0+ (1,0) [0|1] ""  IFV
 SG_ CAN_FL_DET_LOW_SNR_FLAG_066 : 201|1@0+ (1,0) [0|1] ""  IFV
 SG_ CAN_FL_DET_MIXER_BIAS_FLAG_066 : 202|1@0+ (1,0) [0|1] ""  IFV
 SG_ CAN_FL_DET_RESERVED_FLAGS_066 : 207|5@0+ (1,0) [0|31] ""  IFV
 SG_ CAN_FL_DET_SNR_066 : 215|8@0+ (0.35156,0) [0|89.6478] "dB"  IFV
 SG_ CAN_FL_DET_MULTI_TARGET_PROB_066 : 219|4@0+ (0.06667,0) [0|1] ""  IFV
 SG_ CAN_FL_DET_CONFID_AZIMUTH_066 : 221|2@0+ (1,0) [0|3] ""  IFV
 SG_ CAN_FL_DET_CONFID_ELEVATION_066 : 223|2@0+ (1,0) [0|3] ""  IFV
 SG_ CAN_FL_DET_EXISTENCE_PROB_066 : 227|4@0+ (1,0) [0|15] ""  IFV
 SG_ CAN_FL_DET_CLASS_066 : 231|4@0+ (1,0) [0|15] ""  IFV
 SG_ CAN_FL_DET_RANGE_067 : 247|14@0+ (0.015625,0) [0|255.984375] "m"  IFV
 SG_ CAN_FL_DET_SD_RANGE_067 : 249|6@0+ (0.025,0) [0|1.5] "m"  IFV
 SG_ CAN_FL_DET_RANGE_RATE_067 : 259|14@0+ (0.015625,-128) [-128|127.984375] "m/s"  IFV
 SG_ CAN_FL_DET_SD_RANGE_RATE_067 : 277|6@0+ (0.02,0) [0|1.2] "m/s"  IFV
 SG_ CAN_FL_DET_AZIMUTH_067 : 287|13@0+ (0.0007668,-3.141593) [-3.141593|3.141593] "rad"  IFV
 SG_ CAN_FL_DET_SD_AZIMUTH_067 : 290|6@0+ (0.001745329,0) [0|0.104719755] "rad"  IFV
 SG_ CAN_FL_DET_ELEVATION_067 : 300|7@0+ (0.157449,-9.99812) [-9.99812|9.997903] "deg"  IFV
 SG_ CAN_FL_DET_SD_ELEVATION_067 : 309|6@0+ (0.003490659,0) [0|0.20943951] "rad"  IFV
 SG_ CAN_FL_DET_AMPLITUDE_067 : 319|7@0+ (1,-64) [-64|63] "dBsm"  IFV
 SG_ CAN_FL_DET_VALID_FLAG_067 : 312|1@0+ (1,0) [0|1] ""  IFV
 SG_ CAN_FL_DET_SUPER_RES_067 : 320|1@0+ (1,0) [0|1] ""  IFV
 SG_ CAN_FL_DET_LOW_SNR_FLAG_067 : 321|1@0+ (1,0) [0|1] ""  IFV
 SG_ CAN_FL_DET_MIXER_BIAS_FLAG_067 : 322|1@0+ (1,0) [0|1] ""  IFV
 SG_ CAN_FL_DET_RESERVED_FLAGS_067 : 327|5@0+ (1,0) [0|31] ""  IFV
 SG_ CAN_FL_DET_SNR_067 : 335|8@0+ (0.35156,0) [0|89.6478] "dB"  IFV
 SG_ CAN_FL_DET_MULTI_TARGET_PROB_067 : 339|4@0+ (0.06667,0) [0|1] ""  IFV
 SG_ CAN_FL_DET_CONFID_AZIMUTH_067 : 341|2@0+ (1,0) [0|3] ""  IFV
 SG_ CAN_FL_DET_CONFID_ELEVATION_067 : 343|2@0+ (1,0) [0|3] ""  IFV
 SG_ CAN_FL_DET_EXISTENCE_PROB_067 : 347|4@0+ (1,0) [0|15] ""  IFV
 SG_ CAN_FL_DET_CLASS_067 : 351|4@0+ (1,0) [0|15] ""  IFV
 SG_ CAN_FL_DET_RANGE_068 : 367|14@0+ (0.015625,0) [0|255.984375] "m"  IFV
 SG_ CAN_FL_DET_SD_RANGE_068 : 369|6@0+ (0.025,0) [0|1.5] "m"  IFV
 SG_ CAN_FL_DET_RANGE_RATE_068 : 379|14@0+ (0.015625,-128) [-128|127.984375] "m/s"  IFV
 SG_ CAN_FL_DET_SD_RANGE_RATE_068 : 397|6@0+ (0.02,0) [0|1.2] "m/s"  IFV
 SG_ CAN_FL_DET_AZIMUTH_068 : 407|13@0+ (0.0007668,-3.141593) [-3.141593|3.141593] "rad"  IFV
 SG_ CAN_FL_DET_SD_AZIMUTH_068 : 410|6@0+ (0.001745329,0) [0|0.104719755] "rad"  IFV
 SG_ CAN_FL_DET_ELEVATION_068 : 420|7@0+ (0.157449,-9.99812) [-9.99812|9.997903] "deg"  IFV
 SG_ CAN_FL_DET_SD_ELEVATION_068 : 429|6@0+ (0.003490659,0) [0|0.20943951] "rad"  IFV
 SG_ CAN_FL_DET_AMPLITUDE_068 : 439|7@0+ (1,-64) [-64|63] "dBsm"  IFV
 SG_ CAN_FL_DET_VALID_FLAG_068 : 432|1@0+ (1,0) [0|1] ""  IFV
 SG_ CAN_FL_DET_SUPER_RES_068 : 440|1@0+ (1,0) [0|1] ""  IFV
 SG_ CAN_FL_DET_LOW_SNR_FLAG_068 : 441|1@0+ (1,0) [0|1] ""  IFV
 SG_ CAN_FL_DET_MIXER_BIAS_FLAG_068 : 442|1@0+ (1,0) [0|1] ""  IFV
 SG_ CAN_FL_DET_RESERVED_FLAGS_068 : 447|5@0+ (1,0) [0|31] ""  IFV
 SG_ CAN_FL_DET_SNR_068 : 455|8@0+ (0.35156,0) [0|89.6478] "dB"  IFV
 SG_ CAN_FL_DET_MULTI_TARGET_PROB_068 : 459|4@0+ (0.06667,0) [0|1] ""  IFV
 SG_ CAN_FL_DET_CONFID_AZIMUTH_068 : 461|2@0+ (1,0) [0|3] ""  IFV
 SG_ CAN_FL_DET_CONFID_ELEVATION_068 : 463|2@0+ (1,0) [0|3] ""  IFV
 SG_ CAN_FL_DET_EXISTENCE_PROB_068 : 467|4@0+ (1,0) [0|15] ""  IFV
 SG_ CAN_FL_DET_CLASS_068 : 471|4@0+ (1,0) [0|15] ""  IFV

BO_ 785 SODFL_DETECTION_069_072: 64 SODFL
 SG_ CAN_FL_DET_RANGE_069 : 7|14@0+ (0.015625,0) [0|255.984375] "m"  IFV
 SG_ CAN_FL_DET_SD_RANGE_069 : 9|6@0+ (0.025,0) [0|1.5] "m"  IFV
 SG_ CAN_FL_DET_RANGE_RATE_069 : 19|14@0+ (0.015625,-128) [-128|127.984375] "m/s"  IFV
 SG_ CAN_FL_DET_SD_RANGE_RATE_069 : 37|6@0+ (0.02,0) [0|1.2] "m/s"  IFV
 SG_ CAN_FL_DET_AZIMUTH_069 : 47|13@0+ (0.0007668,-3.141593) [-3.141593|3.141593] "rad"  IFV
 SG_ CAN_FL_DET_SD_AZIMUTH_069 : 50|6@0+ (0.001745329,0) [0|0.104719755] "rad"  IFV
 SG_ CAN_FL_DET_ELEVATION_069 : 60|7@0+ (0.157449,-9.99812) [-9.99812|9.997903] "deg"  IFV
 SG_ CAN_FL_DET_SD_ELEVATION_069 : 69|6@0+ (0.003490659,0) [0|0.20943951] "rad"  IFV
 SG_ CAN_FL_DET_AMPLITUDE_069 : 79|7@0+ (1,-64) [-64|63] "dBsm"  IFV
 SG_ CAN_FL_DET_VALID_FLAG_069 : 72|1@0+ (1,0) [0|1] ""  IFV
 SG_ CAN_FL_DET_SUPER_RES_069 : 80|1@0+ (1,0) [0|1] ""  IFV
 SG_ CAN_FL_DET_LOW_SNR_FLAG_069 : 81|1@0+ (1,0) [0|1] ""  IFV
 SG_ CAN_FL_DET_MIXER_BIAS_FLAG_069 : 82|1@0+ (1,0) [0|1] ""  IFV
 SG_ CAN_FL_DET_RESERVED_FLAGS_069 : 87|5@0+ (1,0) [0|31] ""  IFV
 SG_ CAN_FL_DET_SNR_069 : 95|8@0+ (0.35156,0) [0|89.6478] "dB"  IFV
 SG_ CAN_FL_DET_MULTI_TARGET_PROB_069 : 99|4@0+ (0.06667,0) [0|1] ""  IFV
 SG_ CAN_FL_DET_CONFID_AZIMUTH_069 : 101|2@0+ (1,0) [0|3] ""  IFV
 SG_ CAN_FL_DET_CONFID_ELEVATION_069 : 103|2@0+ (1,0) [0|3] ""  IFV
 SG_ CAN_FL_DET_EXISTENCE_PROB_069 : 107|4@0+ (1,0) [0|15] ""  IFV
 SG_ CAN_FL_DET_CLASS_069 : 111|4@0+ (1,0) [0|15] ""  IFV
 SG_ CAN_FL_DET_RANGE_070 : 127|14@0+ (0.015625,0) [0|255.984375] "m"  IFV
 SG_ CAN_FL_DET_SD_RANGE_070 : 129|6@0+ (0.025,0) [0|1.5] "m"  IFV
 SG_ CAN_FL_DET_RANGE_RATE_070 : 139|14@0+ (0.015625,-128) [-128|127.984375] "m/s"  IFV
 SG_ CAN_FL_DET_SD_RANGE_RATE_070 : 157|6@0+ (0.02,0) [0|1.2] "m/s"  IFV
 SG_ CAN_FL_DET_AZIMUTH_070 : 167|13@0+ (0.0007668,-3.141593) [-3.141593|3.141593] "rad"  IFV
 SG_ CAN_FL_DET_SD_AZIMUTH_070 : 170|6@0+ (0.001745329,0) [0|0.104719755] "rad"  IFV
 SG_ CAN_FL_DET_ELEVATION_070 : 180|7@0+ (0.157449,-9.99812) [-9.99812|9.997903] "deg"  IFV
 SG_ CAN_FL_DET_SD_ELEVATION_070 : 189|6@0+ (0.003490659,0) [0|0.20943951] "rad"  IFV
 SG_ CAN_FL_DET_AMPLITUDE_070 : 199|7@0+ (1,-64) [-64|63] "dBsm"  IFV
 SG_ CAN_FL_DET_VALID_FLAG_070 : 192|1@0+ (1,0) [0|1] ""  IFV
 SG_ CAN_FL_DET_SUPER_RES_070 : 200|1@0+ (1,0) [0|1] ""  IFV
 SG_ CAN_FL_DET_LOW_SNR_FLAG_070 : 201|1@0+ (1,0) [0|1] ""  IFV
 SG_ CAN_FL_DET_MIXER_BIAS_FLAG_070 : 202|1@0+ (1,0) [0|1] ""  IFV
 SG_ CAN_FL_DET_RESERVED_FLAGS_070 : 207|5@0+ (1,0) [0|31] ""  IFV
 SG_ CAN_FL_DET_SNR_070 : 215|8@0+ (0.35156,0) [0|89.6478] "dB"  IFV
 SG_ CAN_FL_DET_MULTI_TARGET_PROB_070 : 219|4@0+ (0.06667,0) [0|1] ""  IFV
 SG_ CAN_FL_DET_CONFID_AZIMUTH_070 : 221|2@0+ (1,0) [0|3] ""  IFV
 SG_ CAN_FL_DET_CONFID_ELEVATION_070 : 223|2@0+ (1,0) [0|3] ""  IFV
 SG_ CAN_FL_DET_EXISTENCE_PROB_070 : 227|4@0+ (1,0) [0|15] ""  IFV
 SG_ CAN_FL_DET_CLASS_070 : 231|4@0+ (1,0) [0|15] ""  IFV
 SG_ CAN_FL_DET_RANGE_071 : 247|14@0+ (0.015625,0) [0|255.984375] "m"  IFV
 SG_ CAN_FL_DET_SD_RANGE_071 : 249|6@0+ (0.025,0) [0|1.5] "m"  IFV
 SG_ CAN_FL_DET_RANGE_RATE_071 : 259|14@0+ (0.015625,-128) [-128|127.984375] "m/s"  IFV
 SG_ CAN_FL_DET_SD_RANGE_RATE_071 : 277|6@0+ (0.02,0) [0|1.2] "m/s"  IFV
 SG_ CAN_FL_DET_AZIMUTH_071 : 287|13@0+ (0.0007668,-3.141593) [-3.141593|3.141593] "rad"  IFV
 SG_ CAN_FL_DET_SD_AZIMUTH_071 : 290|6@0+ (0.001745329,0) [0|0.104719755] "rad"  IFV
 SG_ CAN_FL_DET_ELEVATION_071 : 300|7@0+ (0.157449,-9.99812) [-9.99812|9.997903] "deg"  IFV
 SG_ CAN_FL_DET_SD_ELEVATION_071 : 309|6@0+ (0.003490659,0) [0|0.20943951] "rad"  IFV
 SG_ CAN_FL_DET_AMPLITUDE_071 : 319|7@0+ (1,-64) [-64|63] "dBsm"  IFV
 SG_ CAN_FL_DET_VALID_FLAG_071 : 312|1@0+ (1,0) [0|1] ""  IFV
 SG_ CAN_FL_DET_SUPER_RES_071 : 320|1@0+ (1,0) [0|1] ""  IFV
 SG_ CAN_FL_DET_LOW_SNR_FLAG_071 : 321|1@0+ (1,0) [0|1] ""  IFV
 SG_ CAN_FL_DET_MIXER_BIAS_FLAG_071 : 322|1@0+ (1,0) [0|1] ""  IFV
 SG_ CAN_FL_DET_RESERVED_FLAGS_071 : 327|5@0+ (1,0) [0|31] ""  IFV
 SG_ CAN_FL_DET_SNR_071 : 335|8@0+ (0.35156,0) [0|89.6478] "dB"  IFV
 SG_ CAN_FL_DET_MULTI_TARGET_PROB_071 : 339|4@0+ (0.06667,0) [0|1] ""  IFV
 SG_ CAN_FL_DET_CONFID_AZIMUTH_071 : 341|2@0+ (1,0) [0|3] ""  IFV
 SG_ CAN_FL_DET_CONFID_ELEVATION_071 : 343|2@0+ (1,0) [0|3] ""  IFV
 SG_ CAN_FL_DET_EXISTENCE_PROB_071 : 347|4@0+ (1,0) [0|15] ""  IFV
 SG_ CAN_FL_DET_CLASS_071 : 351|4@0+ (1,0) [0|15] ""  IFV
 SG_ CAN_FL_DET_RANGE_072 : 367|14@0+ (0.015625,0) [0|255.984375] "m"  IFV
 SG_ CAN_FL_DET_SD_RANGE_072 : 369|6@0+ (0.025,0) [0|1.5] "m"  IFV
 SG_ CAN_FL_DET_RANGE_RATE_072 : 379|14@0+ (0.015625,-128) [-128|127.984375] "m/s"  IFV
 SG_ CAN_FL_DET_SD_RANGE_RATE_072 : 397|6@0+ (0.02,0) [0|1.2] "m/s"  IFV
 SG_ CAN_FL_DET_AZIMUTH_072 : 407|13@0+ (0.0007668,-3.141593) [-3.141593|3.141593] "rad"  IFV
 SG_ CAN_FL_DET_SD_AZIMUTH_072 : 410|6@0+ (0.001745329,0) [0|0.104719755] "rad"  IFV
 SG_ CAN_FL_DET_ELEVATION_072 : 420|7@0+ (0.157449,-9.99812) [-9.99812|9.997903] "deg"  IFV
 SG_ CAN_FL_DET_SD_ELEVATION_072 : 429|6@0+ (0.003490659,0) [0|0.20943951] "rad"  IFV
 SG_ CAN_FL_DET_AMPLITUDE_072 : 439|7@0+ (1,-64) [-64|63] "dBsm"  IFV
 SG_ CAN_FL_DET_VALID_FLAG_072 : 432|1@0+ (1,0) [0|1] ""  IFV
 SG_ CAN_FL_DET_SUPER_RES_072 : 440|1@0+ (1,0) [0|1] ""  IFV
 SG_ CAN_FL_DET_LOW_SNR_FLAG_072 : 441|1@0+ (1,0) [0|1] ""  IFV
 SG_ CAN_FL_DET_MIXER_BIAS_FLAG_072 : 442|1@0+ (1,0) [0|1] ""  IFV
 SG_ CAN_FL_DET_RESERVED_FLAGS_072 : 447|5@0+ (1,0) [0|31] ""  IFV
 SG_ CAN_FL_DET_SNR_072 : 455|8@0+ (0.35156,0) [0|89.6478] "dB"  IFV
 SG_ CAN_FL_DET_MULTI_TARGET_PROB_072 : 459|4@0+ (0.06667,0) [0|1] ""  IFV
 SG_ CAN_FL_DET_CONFID_AZIMUTH_072 : 461|2@0+ (1,0) [0|3] ""  IFV
 SG_ CAN_FL_DET_CONFID_ELEVATION_072 : 463|2@0+ (1,0) [0|3] ""  IFV
 SG_ CAN_FL_DET_EXISTENCE_PROB_072 : 467|4@0+ (1,0) [0|15] ""  IFV
 SG_ CAN_FL_DET_CLASS_072 : 471|4@0+ (1,0) [0|15] ""  IFV

BO_ 786 SODFL_DETECTION_073_076: 64 SODFL
 SG_ CAN_FL_DET_RANGE_073 : 7|14@0+ (0.015625,0) [0|255.984375] "m"  IFV
 SG_ CAN_FL_DET_SD_RANGE_073 : 9|6@0+ (0.025,0) [0|1.5] "m"  IFV
 SG_ CAN_FL_DET_RANGE_RATE_073 : 19|14@0+ (0.015625,-128) [-128|127.984375] "m/s"  IFV
 SG_ CAN_FL_DET_SD_RANGE_RATE_073 : 37|6@0+ (0.02,0) [0|1.2] "m/s"  IFV
 SG_ CAN_FL_DET_AZIMUTH_073 : 47|13@0+ (0.0007668,-3.141593) [-3.141593|3.141593] "rad"  IFV
 SG_ CAN_FL_DET_SD_AZIMUTH_073 : 50|6@0+ (0.001745329,0) [0|0.104719755] "rad"  IFV
 SG_ CAN_FL_DET_ELEVATION_073 : 60|7@0+ (0.157449,-9.99812) [-9.99812|9.997903] "deg"  IFV
 SG_ CAN_FL_DET_SD_ELEVATION_073 : 69|6@0+ (0.003490659,0) [0|0.20943951] "rad"  IFV
 SG_ CAN_FL_DET_AMPLITUDE_073 : 79|7@0+ (1,-64) [-64|63] "dBsm"  IFV
 SG_ CAN_FL_DET_VALID_FLAG_073 : 72|1@0+ (1,0) [0|1] ""  IFV
 SG_ CAN_FL_DET_SUPER_RES_073 : 80|1@0+ (1,0) [0|1] ""  IFV
 SG_ CAN_FL_DET_LOW_SNR_FLAG_073 : 81|1@0+ (1,0) [0|1] ""  IFV
 SG_ CAN_FL_DET_MIXER_BIAS_FLAG_073 : 82|1@0+ (1,0) [0|1] ""  IFV
 SG_ CAN_FL_DET_RESERVED_FLAGS_073 : 87|5@0+ (1,0) [0|31] ""  IFV
 SG_ CAN_FL_DET_SNR_073 : 95|8@0+ (0.35156,0) [0|89.6478] "dB"  IFV
 SG_ CAN_FL_DET_MULTI_TARGET_PROB_073 : 99|4@0+ (0.06667,0) [0|1] ""  IFV
 SG_ CAN_FL_DET_CONFID_AZIMUTH_073 : 101|2@0+ (1,0) [0|3] ""  IFV
 SG_ CAN_FL_DET_CONFID_ELEVATION_073 : 103|2@0+ (1,0) [0|3] ""  IFV
 SG_ CAN_FL_DET_EXISTENCE_PROB_073 : 107|4@0+ (1,0) [0|15] ""  IFV
 SG_ CAN_FL_DET_CLASS_073 : 111|4@0+ (1,0) [0|15] ""  IFV
 SG_ CAN_FL_DET_RANGE_074 : 127|14@0+ (0.015625,0) [0|255.984375] "m"  IFV
 SG_ CAN_FL_DET_SD_RANGE_074 : 129|6@0+ (0.025,0) [0|1.5] "m"  IFV
 SG_ CAN_FL_DET_RANGE_RATE_074 : 139|14@0+ (0.015625,-128) [-128|127.984375] "m/s"  IFV
 SG_ CAN_FL_DET_SD_RANGE_RATE_074 : 157|6@0+ (0.02,0) [0|1.2] "m/s"  IFV
 SG_ CAN_FL_DET_AZIMUTH_074 : 167|13@0+ (0.0007668,-3.141593) [-3.141593|3.141593] "rad"  IFV
 SG_ CAN_FL_DET_SD_AZIMUTH_074 : 170|6@0+ (0.001745329,0) [0|0.104719755] "rad"  IFV
 SG_ CAN_FL_DET_ELEVATION_074 : 180|7@0+ (0.157449,-9.99812) [-9.99812|9.997903] "deg"  IFV
 SG_ CAN_FL_DET_SD_ELEVATION_074 : 189|6@0+ (0.003490659,0) [0|0.20943951] "rad"  IFV
 SG_ CAN_FL_DET_AMPLITUDE_074 : 199|7@0+ (1,-64) [-64|63] "dBsm"  IFV
 SG_ CAN_FL_DET_VALID_FLAG_074 : 192|1@0+ (1,0) [0|1] ""  IFV
 SG_ CAN_FL_DET_SUPER_RES_074 : 200|1@0+ (1,0) [0|1] ""  IFV
 SG_ CAN_FL_DET_LOW_SNR_FLAG_074 : 201|1@0+ (1,0) [0|1] ""  IFV
 SG_ CAN_FL_DET_MIXER_BIAS_FLAG_074 : 202|1@0+ (1,0) [0|1] ""  IFV
 SG_ CAN_FL_DET_RESERVED_FLAGS_074 : 207|5@0+ (1,0) [0|31] ""  IFV
 SG_ CAN_FL_DET_SNR_074 : 215|8@0+ (0.35156,0) [0|89.6478] "dB"  IFV
 SG_ CAN_FL_DET_MULTI_TARGET_PROB_074 : 219|4@0+ (0.06667,0) [0|1] ""  IFV
 SG_ CAN_FL_DET_CONFID_AZIMUTH_074 : 221|2@0+ (1,0) [0|3] ""  IFV
 SG_ CAN_FL_DET_CONFID_ELEVATION_074 : 223|2@0+ (1,0) [0|3] ""  IFV
 SG_ CAN_FL_DET_EXISTENCE_PROB_074 : 227|4@0+ (1,0) [0|15] ""  IFV
 SG_ CAN_FL_DET_CLASS_074 : 231|4@0+ (1,0) [0|15] ""  IFV
 SG_ CAN_FL_DET_RANGE_075 : 247|14@0+ (0.015625,0) [0|255.984375] "m"  IFV
 SG_ CAN_FL_DET_SD_RANGE_075 : 249|6@0+ (0.025,0) [0|1.5] "m"  IFV
 SG_ CAN_FL_DET_RANGE_RATE_075 : 259|14@0+ (0.015625,-128) [-128|127.984375] "m/s"  IFV
 SG_ CAN_FL_DET_SD_RANGE_RATE_075 : 277|6@0+ (0.02,0) [0|1.2] "m/s"  IFV
 SG_ CAN_FL_DET_AZIMUTH_075 : 287|13@0+ (0.0007668,-3.141593) [-3.141593|3.141593] "rad"  IFV
 SG_ CAN_FL_DET_SD_AZIMUTH_075 : 290|6@0+ (0.001745329,0) [0|0.104719755] "rad"  IFV
 SG_ CAN_FL_DET_ELEVATION_075 : 300|7@0+ (0.157449,-9.99812) [-9.99812|9.997903] "deg"  IFV
 SG_ CAN_FL_DET_SD_ELEVATION_075 : 309|6@0+ (0.003490659,0) [0|0.20943951] "rad"  IFV
 SG_ CAN_FL_DET_AMPLITUDE_075 : 319|7@0+ (1,-64) [-64|63] "dBsm"  IFV
 SG_ CAN_FL_DET_VALID_FLAG_075 : 312|1@0+ (1,0) [0|1] ""  IFV
 SG_ CAN_FL_DET_SUPER_RES_075 : 320|1@0+ (1,0) [0|1] ""  IFV
 SG_ CAN_FL_DET_LOW_SNR_FLAG_075 : 321|1@0+ (1,0) [0|1] ""  IFV
 SG_ CAN_FL_DET_MIXER_BIAS_FLAG_075 : 322|1@0+ (1,0) [0|1] ""  IFV
 SG_ CAN_FL_DET_RESERVED_FLAGS_075 : 327|5@0+ (1,0) [0|31] ""  IFV
 SG_ CAN_FL_DET_SNR_075 : 335|8@0+ (0.35156,0) [0|89.6478] "dB"  IFV
 SG_ CAN_FL_DET_MULTI_TARGET_PROB_075 : 339|4@0+ (0.06667,0) [0|1] ""  IFV
 SG_ CAN_FL_DET_CONFID_AZIMUTH_075 : 341|2@0+ (1,0) [0|3] ""  IFV
 SG_ CAN_FL_DET_CONFID_ELEVATION_075 : 343|2@0+ (1,0) [0|3] ""  IFV
 SG_ CAN_FL_DET_EXISTENCE_PROB_075 : 347|4@0+ (1,0) [0|15] ""  IFV
 SG_ CAN_FL_DET_CLASS_075 : 351|4@0+ (1,0) [0|15] ""  IFV
 SG_ CAN_FL_DET_RANGE_076 : 367|14@0+ (0.015625,0) [0|255.984375] "m"  IFV
 SG_ CAN_FL_DET_SD_RANGE_076 : 369|6@0+ (0.025,0) [0|1.5] "m"  IFV
 SG_ CAN_FL_DET_RANGE_RATE_076 : 379|14@0+ (0.015625,-128) [-128|127.984375] "m/s"  IFV
 SG_ CAN_FL_DET_SD_RANGE_RATE_076 : 397|6@0+ (0.02,0) [0|1.2] "m/s"  IFV
 SG_ CAN_FL_DET_AZIMUTH_076 : 407|13@0+ (0.0007668,-3.141593) [-3.141593|3.141593] "rad"  IFV
 SG_ CAN_FL_DET_SD_AZIMUTH_076 : 410|6@0+ (0.001745329,0) [0|0.104719755] "rad"  IFV
 SG_ CAN_FL_DET_ELEVATION_076 : 420|7@0+ (0.157449,-9.99812) [-9.99812|9.997903] "deg"  IFV
 SG_ CAN_FL_DET_SD_ELEVATION_076 : 429|6@0+ (0.003490659,0) [0|0.20943951] "rad"  IFV
 SG_ CAN_FL_DET_AMPLITUDE_076 : 439|7@0+ (1,-64) [-64|63] "dBsm"  IFV
 SG_ CAN_FL_DET_VALID_FLAG_076 : 432|1@0+ (1,0) [0|1] ""  IFV
 SG_ CAN_FL_DET_SUPER_RES_076 : 440|1@0+ (1,0) [0|1] ""  IFV
 SG_ CAN_FL_DET_LOW_SNR_FLAG_076 : 441|1@0+ (1,0) [0|1] ""  IFV
 SG_ CAN_FL_DET_MIXER_BIAS_FLAG_076 : 442|1@0+ (1,0) [0|1] ""  IFV
 SG_ CAN_FL_DET_RESERVED_FLAGS_076 : 447|5@0+ (1,0) [0|31] ""  IFV
 SG_ CAN_FL_DET_SNR_076 : 455|8@0+ (0.35156,0) [0|89.6478] "dB"  IFV
 SG_ CAN_FL_DET_MULTI_TARGET_PROB_076 : 459|4@0+ (0.06667,0) [0|1] ""  IFV
 SG_ CAN_FL_DET_CONFID_AZIMUTH_076 : 461|2@0+ (1,0) [0|3] ""  IFV
 SG_ CAN_FL_DET_CONFID_ELEVATION_076 : 463|2@0+ (1,0) [0|3] ""  IFV
 SG_ CAN_FL_DET_EXISTENCE_PROB_076 : 467|4@0+ (1,0) [0|15] ""  IFV
 SG_ CAN_FL_DET_CLASS_076 : 471|4@0+ (1,0) [0|15] ""  IFV

BO_ 787 SODFL_DETECTION_077_080: 64 SODFL
 SG_ CAN_FL_DET_RANGE_077 : 7|14@0+ (0.015625,0) [0|255.984375] "m"  IFV
 SG_ CAN_FL_DET_SD_RANGE_077 : 9|6@0+ (0.025,0) [0|1.5] "m"  IFV
 SG_ CAN_FL_DET_RANGE_RATE_077 : 19|14@0+ (0.015625,-128) [-128|127.984375] "m/s"  IFV
 SG_ CAN_FL_DET_SD_RANGE_RATE_077 : 37|6@0+ (0.02,0) [0|1.2] "m/s"  IFV
 SG_ CAN_FL_DET_AZIMUTH_077 : 47|13@0+ (0.0007668,-3.141593) [-3.141593|3.141593] "rad"  IFV
 SG_ CAN_FL_DET_SD_AZIMUTH_077 : 50|6@0+ (0.001745329,0) [0|0.104719755] "rad"  IFV
 SG_ CAN_FL_DET_ELEVATION_077 : 60|7@0+ (0.157449,-9.99812) [-9.99812|9.997903] "deg"  IFV
 SG_ CAN_FL_DET_SD_ELEVATION_077 : 69|6@0+ (0.003490659,0) [0|0.20943951] "rad"  IFV
 SG_ CAN_FL_DET_AMPLITUDE_077 : 79|7@0+ (1,-64) [-64|63] "dBsm"  IFV
 SG_ CAN_FL_DET_VALID_FLAG_077 : 72|1@0+ (1,0) [0|1] ""  IFV
 SG_ CAN_FL_DET_SUPER_RES_077 : 80|1@0+ (1,0) [0|1] ""  IFV
 SG_ CAN_FL_DET_LOW_SNR_FLAG_077 : 81|1@0+ (1,0) [0|1] ""  IFV
 SG_ CAN_FL_DET_MIXER_BIAS_FLAG_077 : 82|1@0+ (1,0) [0|1] ""  IFV
 SG_ CAN_FL_DET_RESERVED_FLAGS_077 : 87|5@0+ (1,0) [0|31] ""  IFV
 SG_ CAN_FL_DET_SNR_077 : 95|8@0+ (0.35156,0) [0|89.6478] "dB"  IFV
 SG_ CAN_FL_DET_MULTI_TARGET_PROB_077 : 99|4@0+ (0.06667,0) [0|1] ""  IFV
 SG_ CAN_FL_DET_CONFID_AZIMUTH_077 : 101|2@0+ (1,0) [0|3] ""  IFV
 SG_ CAN_FL_DET_CONFID_ELEVATION_077 : 103|2@0+ (1,0) [0|3] ""  IFV
 SG_ CAN_FL_DET_EXISTENCE_PROB_077 : 107|4@0+ (1,0) [0|15] ""  IFV
 SG_ CAN_FL_DET_CLASS_077 : 111|4@0+ (1,0) [0|15] ""  IFV
 SG_ CAN_FL_DET_RANGE_078 : 127|14@0+ (0.015625,0) [0|255.984375] "m"  IFV
 SG_ CAN_FL_DET_SD_RANGE_078 : 129|6@0+ (0.025,0) [0|1.5] "m"  IFV
 SG_ CAN_FL_DET_RANGE_RATE_078 : 139|14@0+ (0.015625,-128) [-128|127.984375] "m/s"  IFV
 SG_ CAN_FL_DET_SD_RANGE_RATE_078 : 157|6@0+ (0.02,0) [0|1.2] "m/s"  IFV
 SG_ CAN_FL_DET_AZIMUTH_078 : 167|13@0+ (0.0007668,-3.141593) [-3.141593|3.141593] "rad"  IFV
 SG_ CAN_FL_DET_SD_AZIMUTH_078 : 170|6@0+ (0.001745329,0) [0|0.104719755] "rad"  IFV
 SG_ CAN_FL_DET_ELEVATION_078 : 180|7@0+ (0.157449,-9.99812) [-9.99812|9.997903] "deg"  IFV
 SG_ CAN_FL_DET_SD_ELEVATION_078 : 189|6@0+ (0.003490659,0) [0|0.20943951] "rad"  IFV
 SG_ CAN_FL_DET_AMPLITUDE_078 : 199|7@0+ (1,-64) [-64|63] "dBsm"  IFV
 SG_ CAN_FL_DET_VALID_FLAG_078 : 192|1@0+ (1,0) [0|1] ""  IFV
 SG_ CAN_FL_DET_SUPER_RES_078 : 200|1@0+ (1,0) [0|1] ""  IFV
 SG_ CAN_FL_DET_LOW_SNR_FLAG_078 : 201|1@0+ (1,0) [0|1] ""  IFV
 SG_ CAN_FL_DET_MIXER_BIAS_FLAG_078 : 202|1@0+ (1,0) [0|1] ""  IFV
 SG_ CAN_FL_DET_RESERVED_FLAGS_078 : 207|5@0+ (1,0) [0|31] ""  IFV
 SG_ CAN_FL_DET_SNR_078 : 215|8@0+ (0.35156,0) [0|89.6478] "dB"  IFV
 SG_ CAN_FL_DET_MULTI_TARGET_PROB_078 : 219|4@0+ (0.06667,0) [0|1] ""  IFV
 SG_ CAN_FL_DET_CONFID_AZIMUTH_078 : 221|2@0+ (1,0) [0|3] ""  IFV
 SG_ CAN_FL_DET_CONFID_ELEVATION_078 : 223|2@0+ (1,0) [0|3] ""  IFV
 SG_ CAN_FL_DET_EXISTENCE_PROB_078 : 227|4@0+ (1,0) [0|15] ""  IFV
 SG_ CAN_FL_DET_CLASS_078 : 231|4@0+ (1,0) [0|15] ""  IFV
 SG_ CAN_FL_DET_RANGE_079 : 247|14@0+ (0.015625,0) [0|255.984375] "m"  IFV
 SG_ CAN_FL_DET_SD_RANGE_079 : 249|6@0+ (0.025,0) [0|1.5] "m"  IFV
 SG_ CAN_FL_DET_RANGE_RATE_079 : 259|14@0+ (0.015625,-128) [-128|127.984375] "m/s"  IFV
 SG_ CAN_FL_DET_SD_RANGE_RATE_079 : 277|6@0+ (0.02,0) [0|1.2] "m/s"  IFV
 SG_ CAN_FL_DET_AZIMUTH_079 : 287|13@0+ (0.0007668,-3.141593) [-3.141593|3.141593] "rad"  IFV
 SG_ CAN_FL_DET_SD_AZIMUTH_079 : 290|6@0+ (0.001745329,0) [0|0.104719755] "rad"  IFV
 SG_ CAN_FL_DET_ELEVATION_079 : 300|7@0+ (0.157449,-9.99812) [-9.99812|9.997903] "deg"  IFV
 SG_ CAN_FL_DET_SD_ELEVATION_079 : 309|6@0+ (0.003490659,0) [0|0.20943951] "rad"  IFV
 SG_ CAN_FL_DET_AMPLITUDE_079 : 319|7@0+ (1,-64) [-64|63] "dBsm"  IFV
 SG_ CAN_FL_DET_VALID_FLAG_079 : 312|1@0+ (1,0) [0|1] ""  IFV
 SG_ CAN_FL_DET_SUPER_RES_079 : 320|1@0+ (1,0) [0|1] ""  IFV
 SG_ CAN_FL_DET_LOW_SNR_FLAG_079 : 321|1@0+ (1,0) [0|1] ""  IFV
 SG_ CAN_FL_DET_MIXER_BIAS_FLAG_079 : 322|1@0+ (1,0) [0|1] ""  IFV
 SG_ CAN_FL_DET_RESERVED_FLAGS_079 : 327|5@0+ (1,0) [0|31] ""  IFV
 SG_ CAN_FL_DET_SNR_079 : 335|8@0+ (0.35156,0) [0|89.6478] "dB"  IFV
 SG_ CAN_FL_DET_MULTI_TARGET_PROB_079 : 339|4@0+ (0.06667,0) [0|1] ""  IFV
 SG_ CAN_FL_DET_CONFID_AZIMUTH_079 : 341|2@0+ (1,0) [0|3] ""  IFV
 SG_ CAN_FL_DET_CONFID_ELEVATION_079 : 343|2@0+ (1,0) [0|3] ""  IFV
 SG_ CAN_FL_DET_EXISTENCE_PROB_079 : 347|4@0+ (1,0) [0|15] ""  IFV
 SG_ CAN_FL_DET_CLASS_079 : 351|4@0+ (1,0) [0|15] ""  IFV
 SG_ CAN_FL_DET_RANGE_080 : 367|14@0+ (0.015625,0) [0|255.984375] "m"  IFV
 SG_ CAN_FL_DET_SD_RANGE_080 : 369|6@0+ (0.025,0) [0|1.5] "m"  IFV
 SG_ CAN_FL_DET_RANGE_RATE_080 : 379|14@0+ (0.015625,-128) [-128|127.984375] "m/s"  IFV
 SG_ CAN_FL_DET_SD_RANGE_RATE_080 : 397|6@0+ (0.02,0) [0|1.2] "m/s"  IFV
 SG_ CAN_FL_DET_AZIMUTH_080 : 407|13@0+ (0.0007668,-3.141593) [-3.141593|3.141593] "rad"  IFV
 SG_ CAN_FL_DET_SD_AZIMUTH_080 : 410|6@0+ (0.001745329,0) [0|0.104719755] "rad"  IFV
 SG_ CAN_FL_DET_ELEVATION_080 : 420|7@0+ (0.157449,-9.99812) [-9.99812|9.997903] "deg"  IFV
 SG_ CAN_FL_DET_SD_ELEVATION_080 : 429|6@0+ (0.003490659,0) [0|0.20943951] "rad"  IFV
 SG_ CAN_FL_DET_AMPLITUDE_080 : 439|7@0+ (1,-64) [-64|63] "dBsm"  IFV
 SG_ CAN_FL_DET_VALID_FLAG_080 : 432|1@0+ (1,0) [0|1] ""  IFV
 SG_ CAN_FL_DET_SUPER_RES_080 : 440|1@0+ (1,0) [0|1] ""  IFV
 SG_ CAN_FL_DET_LOW_SNR_FLAG_080 : 441|1@0+ (1,0) [0|1] ""  IFV
 SG_ CAN_FL_DET_MIXER_BIAS_FLAG_080 : 442|1@0+ (1,0) [0|1] ""  IFV
 SG_ CAN_FL_DET_RESERVED_FLAGS_080 : 447|5@0+ (1,0) [0|31] ""  IFV
 SG_ CAN_FL_DET_SNR_080 : 455|8@0+ (0.35156,0) [0|89.6478] "dB"  IFV
 SG_ CAN_FL_DET_MULTI_TARGET_PROB_080 : 459|4@0+ (0.06667,0) [0|1] ""  IFV
 SG_ CAN_FL_DET_CONFID_AZIMUTH_080 : 461|2@0+ (1,0) [0|3] ""  IFV
 SG_ CAN_FL_DET_CONFID_ELEVATION_080 : 463|2@0+ (1,0) [0|3] ""  IFV
 SG_ CAN_FL_DET_EXISTENCE_PROB_080 : 467|4@0+ (1,0) [0|15] ""  IFV
 SG_ CAN_FL_DET_CLASS_080 : 471|4@0+ (1,0) [0|15] ""  IFV

BO_ 788 SODFL_DETECTION_081_084: 64 SODFL
 SG_ CAN_FL_DET_RANGE_081 : 7|14@0+ (0.015625,0) [0|255.984375] "m"  IFV
 SG_ CAN_FL_DET_SD_RANGE_081 : 9|6@0+ (0.025,0) [0|1.5] "m"  IFV
 SG_ CAN_FL_DET_RANGE_RATE_081 : 19|14@0+ (0.015625,-128) [-128|127.984375] "m/s"  IFV
 SG_ CAN_FL_DET_SD_RANGE_RATE_081 : 37|6@0+ (0.02,0) [0|1.2] "m/s"  IFV
 SG_ CAN_FL_DET_AZIMUTH_081 : 47|13@0+ (0.0007668,-3.141593) [-3.141593|3.141593] "rad"  IFV
 SG_ CAN_FL_DET_SD_AZIMUTH_081 : 50|6@0+ (0.001745329,0) [0|0.104719755] "rad"  IFV
 SG_ CAN_FL_DET_ELEVATION_081 : 60|7@0+ (0.157449,-9.99812) [-9.99812|9.997903] "deg"  IFV
 SG_ CAN_FL_DET_SD_ELEVATION_081 : 69|6@0+ (0.003490659,0) [0|0.20943951] "rad"  IFV
 SG_ CAN_FL_DET_AMPLITUDE_081 : 79|7@0+ (1,-64) [-64|63] "dBsm"  IFV
 SG_ CAN_FL_DET_VALID_FLAG_081 : 72|1@0+ (1,0) [0|1] ""  IFV
 SG_ CAN_FL_DET_SUPER_RES_081 : 80|1@0+ (1,0) [0|1] ""  IFV
 SG_ CAN_FL_DET_LOW_SNR_FLAG_081 : 81|1@0+ (1,0) [0|1] ""  IFV
 SG_ CAN_FL_DET_MIXER_BIAS_FLAG_081 : 82|1@0+ (1,0) [0|1] ""  IFV
 SG_ CAN_FL_DET_RESERVED_FLAGS_081 : 87|5@0+ (1,0) [0|31] ""  IFV
 SG_ CAN_FL_DET_SNR_081 : 95|8@0+ (0.35156,0) [0|89.6478] "dB"  IFV
 SG_ CAN_FL_DET_MULTI_TARGET_PROB_081 : 99|4@0+ (0.06667,0) [0|1] ""  IFV
 SG_ CAN_FL_DET_CONFID_AZIMUTH_081 : 101|2@0+ (1,0) [0|3] ""  IFV
 SG_ CAN_FL_DET_CONFID_ELEVATION_081 : 103|2@0+ (1,0) [0|3] ""  IFV
 SG_ CAN_FL_DET_EXISTENCE_PROB_081 : 107|4@0+ (1,0) [0|15] ""  IFV
 SG_ CAN_FL_DET_CLASS_081 : 111|4@0+ (1,0) [0|15] ""  IFV
 SG_ CAN_FL_DET_RANGE_082 : 127|14@0+ (0.015625,0) [0|255.984375] "m"  IFV
 SG_ CAN_FL_DET_SD_RANGE_082 : 129|6@0+ (0.025,0) [0|1.5] "m"  IFV
 SG_ CAN_FL_DET_RANGE_RATE_082 : 139|14@0+ (0.015625,-128) [-128|127.984375] "m/s"  IFV
 SG_ CAN_FL_DET_SD_RANGE_RATE_082 : 157|6@0+ (0.02,0) [0|1.2] "m/s"  IFV
 SG_ CAN_FL_DET_AZIMUTH_082 : 167|13@0+ (0.0007668,-3.141593) [-3.141593|3.141593] "rad"  IFV
 SG_ CAN_FL_DET_SD_AZIMUTH_082 : 170|6@0+ (0.001745329,0) [0|0.104719755] "rad"  IFV
 SG_ CAN_FL_DET_ELEVATION_082 : 180|7@0+ (0.157449,-9.99812) [-9.99812|9.997903] "deg"  IFV
 SG_ CAN_FL_DET_SD_ELEVATION_082 : 189|6@0+ (0.003490659,0) [0|0.20943951] "rad"  IFV
 SG_ CAN_FL_DET_AMPLITUDE_082 : 199|7@0+ (1,-64) [-64|63] "dBsm"  IFV
 SG_ CAN_FL_DET_VALID_FLAG_082 : 192|1@0+ (1,0) [0|1] ""  IFV
 SG_ CAN_FL_DET_SUPER_RES_082 : 200|1@0+ (1,0) [0|1] ""  IFV
 SG_ CAN_FL_DET_LOW_SNR_FLAG_082 : 201|1@0+ (1,0) [0|1] ""  IFV
 SG_ CAN_FL_DET_MIXER_BIAS_FLAG_082 : 202|1@0+ (1,0) [0|1] ""  IFV
 SG_ CAN_FL_DET_RESERVED_FLAGS_082 : 207|5@0+ (1,0) [0|31] ""  IFV
 SG_ CAN_FL_DET_SNR_082 : 215|8@0+ (0.35156,0) [0|89.6478] "dB"  IFV
 SG_ CAN_FL_DET_MULTI_TARGET_PROB_082 : 219|4@0+ (0.06667,0) [0|1] ""  IFV
 SG_ CAN_FL_DET_CONFID_AZIMUTH_082 : 221|2@0+ (1,0) [0|3] ""  IFV
 SG_ CAN_FL_DET_CONFID_ELEVATION_082 : 223|2@0+ (1,0) [0|3] ""  IFV
 SG_ CAN_FL_DET_EXISTENCE_PROB_082 : 227|4@0+ (1,0) [0|15] ""  IFV
 SG_ CAN_FL_DET_CLASS_082 : 231|4@0+ (1,0) [0|15] ""  IFV
 SG_ CAN_FL_DET_RANGE_083 : 247|14@0+ (0.015625,0) [0|255.984375] "m"  IFV
 SG_ CAN_FL_DET_SD_RANGE_083 : 249|6@0+ (0.025,0) [0|1.5] "m"  IFV
 SG_ CAN_FL_DET_RANGE_RATE_083 : 259|14@0+ (0.015625,-128) [-128|127.984375] "m/s"  IFV
 SG_ CAN_FL_DET_SD_RANGE_RATE_083 : 277|6@0+ (0.02,0) [0|1.2] "m/s"  IFV
 SG_ CAN_FL_DET_AZIMUTH_083 : 287|13@0+ (0.0007668,-3.141593) [-3.141593|3.141593] "rad"  IFV
 SG_ CAN_FL_DET_SD_AZIMUTH_083 : 290|6@0+ (0.001745329,0) [0|0.104719755] "rad"  IFV
 SG_ CAN_FL_DET_ELEVATION_083 : 300|7@0+ (0.157449,-9.99812) [-9.99812|9.997903] "deg"  IFV
 SG_ CAN_FL_DET_SD_ELEVATION_083 : 309|6@0+ (0.003490659,0) [0|0.20943951] "rad"  IFV
 SG_ CAN_FL_DET_AMPLITUDE_083 : 319|7@0+ (1,-64) [-64|63] "dBsm"  IFV
 SG_ CAN_FL_DET_VALID_FLAG_083 : 312|1@0+ (1,0) [0|1] ""  IFV
 SG_ CAN_FL_DET_SUPER_RES_083 : 320|1@0+ (1,0) [0|1] ""  IFV
 SG_ CAN_FL_DET_LOW_SNR_FLAG_083 : 321|1@0+ (1,0) [0|1] ""  IFV
 SG_ CAN_FL_DET_MIXER_BIAS_FLAG_083 : 322|1@0+ (1,0) [0|1] ""  IFV
 SG_ CAN_FL_DET_RESERVED_FLAGS_083 : 327|5@0+ (1,0) [0|31] ""  IFV
 SG_ CAN_FL_DET_SNR_083 : 335|8@0+ (0.35156,0) [0|89.6478] "dB"  IFV
 SG_ CAN_FL_DET_MULTI_TARGET_PROB_083 : 339|4@0+ (0.06667,0) [0|1] ""  IFV
 SG_ CAN_FL_DET_CONFID_AZIMUTH_083 : 341|2@0+ (1,0) [0|3] ""  IFV
 SG_ CAN_FL_DET_CONFID_ELEVATION_083 : 343|2@0+ (1,0) [0|3] ""  IFV
 SG_ CAN_FL_DET_EXISTENCE_PROB_083 : 347|4@0+ (1,0) [0|15] ""  IFV
 SG_ CAN_FL_DET_CLASS_083 : 351|4@0+ (1,0) [0|15] ""  IFV
 SG_ CAN_FL_DET_RANGE_084 : 367|14@0+ (0.015625,0) [0|255.984375] "m"  IFV
 SG_ CAN_FL_DET_SD_RANGE_084 : 369|6@0+ (0.025,0) [0|1.5] "m"  IFV
 SG_ CAN_FL_DET_RANGE_RATE_084 : 379|14@0+ (0.015625,-128) [-128|127.984375] "m/s"  IFV
 SG_ CAN_FL_DET_SD_RANGE_RATE_084 : 397|6@0+ (0.02,0) [0|1.2] "m/s"  IFV
 SG_ CAN_FL_DET_AZIMUTH_084 : 407|13@0+ (0.0007668,-3.141593) [-3.141593|3.141593] "rad"  IFV
 SG_ CAN_FL_DET_SD_AZIMUTH_084 : 410|6@0+ (0.001745329,0) [0|0.104719755] "rad"  IFV
 SG_ CAN_FL_DET_ELEVATION_084 : 420|7@0+ (0.157449,-9.99812) [-9.99812|9.997903] "deg"  IFV
 SG_ CAN_FL_DET_SD_ELEVATION_084 : 429|6@0+ (0.003490659,0) [0|0.20943951] "rad"  IFV
 SG_ CAN_FL_DET_AMPLITUDE_084 : 439|7@0+ (1,-64) [-64|63] "dBsm"  IFV
 SG_ CAN_FL_DET_VALID_FLAG_084 : 432|1@0+ (1,0) [0|1] ""  IFV
 SG_ CAN_FL_DET_SUPER_RES_084 : 440|1@0+ (1,0) [0|1] ""  IFV
 SG_ CAN_FL_DET_LOW_SNR_FLAG_084 : 441|1@0+ (1,0) [0|1] ""  IFV
 SG_ CAN_FL_DET_MIXER_BIAS_FLAG_084 : 442|1@0+ (1,0) [0|1] ""  IFV
 SG_ CAN_FL_DET_RESERVED_FLAGS_084 : 447|5@0+ (1,0) [0|31] ""  IFV
 SG_ CAN_FL_DET_SNR_084 : 455|8@0+ (0.35156,0) [0|89.6478] "dB"  IFV
 SG_ CAN_FL_DET_MULTI_TARGET_PROB_084 : 459|4@0+ (0.06667,0) [0|1] ""  IFV
 SG_ CAN_FL_DET_CONFID_AZIMUTH_084 : 461|2@0+ (1,0) [0|3] ""  IFV
 SG_ CAN_FL_DET_CONFID_ELEVATION_084 : 463|2@0+ (1,0) [0|3] ""  IFV
 SG_ CAN_FL_DET_EXISTENCE_PROB_084 : 467|4@0+ (1,0) [0|15] ""  IFV
 SG_ CAN_FL_DET_CLASS_084 : 471|4@0+ (1,0) [0|15] ""  IFV

BO_ 789 SODFL_DETECTION_085_088: 64 SODFL
 SG_ CAN_FL_DET_RANGE_085 : 7|14@0+ (0.015625,0) [0|255.984375] "m"  IFV
 SG_ CAN_FL_DET_SD_RANGE_085 : 9|6@0+ (0.025,0) [0|1.5] "m"  IFV
 SG_ CAN_FL_DET_RANGE_RATE_085 : 19|14@0+ (0.015625,-128) [-128|127.984375] "m/s"  IFV
 SG_ CAN_FL_DET_SD_RANGE_RATE_085 : 37|6@0+ (0.02,0) [0|1.2] "m/s"  IFV
 SG_ CAN_FL_DET_AZIMUTH_085 : 47|13@0+ (0.0007668,-3.141593) [-3.141593|3.141593] "rad"  IFV
 SG_ CAN_FL_DET_SD_AZIMUTH_085 : 50|6@0+ (0.001745329,0) [0|0.104719755] "rad"  IFV
 SG_ CAN_FL_DET_ELEVATION_085 : 60|7@0+ (0.157449,-9.99812) [-9.99812|9.997903] "deg"  IFV
 SG_ CAN_FL_DET_SD_ELEVATION_085 : 69|6@0+ (0.003490659,0) [0|0.20943951] "rad"  IFV
 SG_ CAN_FL_DET_AMPLITUDE_085 : 79|7@0+ (1,-64) [-64|63] "dBsm"  IFV
 SG_ CAN_FL_DET_VALID_FLAG_085 : 72|1@0+ (1,0) [0|1] ""  IFV
 SG_ CAN_FL_DET_SUPER_RES_085 : 80|1@0+ (1,0) [0|1] ""  IFV
 SG_ CAN_FL_DET_LOW_SNR_FLAG_085 : 81|1@0+ (1,0) [0|1] ""  IFV
 SG_ CAN_FL_DET_MIXER_BIAS_FLAG_085 : 82|1@0+ (1,0) [0|1] ""  IFV
 SG_ CAN_FL_DET_RESERVED_FLAGS_085 : 87|5@0+ (1,0) [0|31] ""  IFV
 SG_ CAN_FL_DET_SNR_085 : 95|8@0+ (0.35156,0) [0|89.6478] "dB"  IFV
 SG_ CAN_FL_DET_MULTI_TARGET_PROB_085 : 99|4@0+ (0.06667,0) [0|1] ""  IFV
 SG_ CAN_FL_DET_CONFID_AZIMUTH_085 : 101|2@0+ (1,0) [0|3] ""  IFV
 SG_ CAN_FL_DET_CONFID_ELEVATION_085 : 103|2@0+ (1,0) [0|3] ""  IFV
 SG_ CAN_FL_DET_EXISTENCE_PROB_085 : 107|4@0+ (1,0) [0|15] ""  IFV
 SG_ CAN_FL_DET_CLASS_085 : 111|4@0+ (1,0) [0|15] ""  IFV
 SG_ CAN_FL_DET_RANGE_086 : 127|14@0+ (0.015625,0) [0|255.984375] "m"  IFV
 SG_ CAN_FL_DET_SD_RANGE_086 : 129|6@0+ (0.025,0) [0|1.5] "m"  IFV
 SG_ CAN_FL_DET_RANGE_RATE_086 : 139|14@0+ (0.015625,-128) [-128|127.984375] "m/s"  IFV
 SG_ CAN_FL_DET_SD_RANGE_RATE_086 : 157|6@0+ (0.02,0) [0|1.2] "m/s"  IFV
 SG_ CAN_FL_DET_AZIMUTH_086 : 167|13@0+ (0.0007668,-3.141593) [-3.141593|3.141593] "rad"  IFV
 SG_ CAN_FL_DET_SD_AZIMUTH_086 : 170|6@0+ (0.001745329,0) [0|0.104719755] "rad"  IFV
 SG_ CAN_FL_DET_ELEVATION_086 : 180|7@0+ (0.157449,-9.99812) [-9.99812|9.997903] "deg"  IFV
 SG_ CAN_FL_DET_SD_ELEVATION_086 : 189|6@0+ (0.003490659,0) [0|0.20943951] "rad"  IFV
 SG_ CAN_FL_DET_AMPLITUDE_086 : 199|7@0+ (1,-64) [-64|63] "dBsm"  IFV
 SG_ CAN_FL_DET_VALID_FLAG_086 : 192|1@0+ (1,0) [0|1] ""  IFV
 SG_ CAN_FL_DET_SUPER_RES_086 : 200|1@0+ (1,0) [0|1] ""  IFV
 SG_ CAN_FL_DET_LOW_SNR_FLAG_086 : 201|1@0+ (1,0) [0|1] ""  IFV
 SG_ CAN_FL_DET_MIXER_BIAS_FLAG_086 : 202|1@0+ (1,0) [0|1] ""  IFV
 SG_ CAN_FL_DET_RESERVED_FLAGS_086 : 207|5@0+ (1,0) [0|31] ""  IFV
 SG_ CAN_FL_DET_SNR_086 : 215|8@0+ (0.35156,0) [0|89.6478] "dB"  IFV
 SG_ CAN_FL_DET_MULTI_TARGET_PROB_086 : 219|4@0+ (0.06667,0) [0|1] ""  IFV
 SG_ CAN_FL_DET_CONFID_AZIMUTH_086 : 221|2@0+ (1,0) [0|3] ""  IFV
 SG_ CAN_FL_DET_CONFID_ELEVATION_086 : 223|2@0+ (1,0) [0|3] ""  IFV
 SG_ CAN_FL_DET_EXISTENCE_PROB_086 : 227|4@0+ (1,0) [0|15] ""  IFV
 SG_ CAN_FL_DET_CLASS_086 : 231|4@0+ (1,0) [0|15] ""  IFV
 SG_ CAN_FL_DET_RANGE_087 : 247|14@0+ (0.015625,0) [0|255.984375] "m"  IFV
 SG_ CAN_FL_DET_SD_RANGE_087 : 249|6@0+ (0.025,0) [0|1.5] "m"  IFV
 SG_ CAN_FL_DET_RANGE_RATE_087 : 259|14@0+ (0.015625,-128) [-128|127.984375] "m/s"  IFV
 SG_ CAN_FL_DET_SD_RANGE_RATE_087 : 277|6@0+ (0.02,0) [0|1.2] "m/s"  IFV
 SG_ CAN_FL_DET_AZIMUTH_087 : 287|13@0+ (0.0007668,-3.141593) [-3.141593|3.141593] "rad"  IFV
 SG_ CAN_FL_DET_SD_AZIMUTH_087 : 290|6@0+ (0.001745329,0) [0|0.104719755] "rad"  IFV
 SG_ CAN_FL_DET_ELEVATION_087 : 300|7@0+ (0.157449,-9.99812) [-9.99812|9.997903] "deg"  IFV
 SG_ CAN_FL_DET_SD_ELEVATION_087 : 309|6@0+ (0.003490659,0) [0|0.20943951] "rad"  IFV
 SG_ CAN_FL_DET_AMPLITUDE_087 : 319|7@0+ (1,-64) [-64|63] "dBsm"  IFV
 SG_ CAN_FL_DET_VALID_FLAG_087 : 312|1@0+ (1,0) [0|1] ""  IFV
 SG_ CAN_FL_DET_SUPER_RES_087 : 320|1@0+ (1,0) [0|1] ""  IFV
 SG_ CAN_FL_DET_LOW_SNR_FLAG_087 : 321|1@0+ (1,0) [0|1] ""  IFV
 SG_ CAN_FL_DET_MIXER_BIAS_FLAG_087 : 322|1@0+ (1,0) [0|1] ""  IFV
 SG_ CAN_FL_DET_RESERVED_FLAGS_087 : 327|5@0+ (1,0) [0|31] ""  IFV
 SG_ CAN_FL_DET_SNR_087 : 335|8@0+ (0.35156,0) [0|89.6478] "dB"  IFV
 SG_ CAN_FL_DET_MULTI_TARGET_PROB_087 : 339|4@0+ (0.06667,0) [0|1] ""  IFV
 SG_ CAN_FL_DET_CONFID_AZIMUTH_087 : 341|2@0+ (1,0) [0|3] ""  IFV
 SG_ CAN_FL_DET_CONFID_ELEVATION_087 : 343|2@0+ (1,0) [0|3] ""  IFV
 SG_ CAN_FL_DET_EXISTENCE_PROB_087 : 347|4@0+ (1,0) [0|15] ""  IFV
 SG_ CAN_FL_DET_CLASS_087 : 351|4@0+ (1,0) [0|15] ""  IFV
 SG_ CAN_FL_DET_RANGE_088 : 367|14@0+ (0.015625,0) [0|255.984375] "m"  IFV
 SG_ CAN_FL_DET_SD_RANGE_088 : 369|6@0+ (0.025,0) [0|1.5] "m"  IFV
 SG_ CAN_FL_DET_RANGE_RATE_088 : 379|14@0+ (0.015625,-128) [-128|127.984375] "m/s"  IFV
 SG_ CAN_FL_DET_SD_RANGE_RATE_088 : 397|6@0+ (0.02,0) [0|1.2] "m/s"  IFV
 SG_ CAN_FL_DET_AZIMUTH_088 : 407|13@0+ (0.0007668,-3.141593) [-3.141593|3.141593] "rad"  IFV
 SG_ CAN_FL_DET_SD_AZIMUTH_088 : 410|6@0+ (0.001745329,0) [0|0.104719755] "rad"  IFV
 SG_ CAN_FL_DET_ELEVATION_088 : 420|7@0+ (0.157449,-9.99812) [-9.99812|9.997903] "deg"  IFV
 SG_ CAN_FL_DET_SD_ELEVATION_088 : 429|6@0+ (0.003490659,0) [0|0.20943951] "rad"  IFV
 SG_ CAN_FL_DET_AMPLITUDE_088 : 439|7@0+ (1,-64) [-64|63] "dBsm"  IFV
 SG_ CAN_FL_DET_VALID_FLAG_088 : 432|1@0+ (1,0) [0|1] ""  IFV
 SG_ CAN_FL_DET_SUPER_RES_088 : 440|1@0+ (1,0) [0|1] ""  IFV
 SG_ CAN_FL_DET_LOW_SNR_FLAG_088 : 441|1@0+ (1,0) [0|1] ""  IFV
 SG_ CAN_FL_DET_MIXER_BIAS_FLAG_088 : 442|1@0+ (1,0) [0|1] ""  IFV
 SG_ CAN_FL_DET_RESERVED_FLAGS_088 : 447|5@0+ (1,0) [0|31] ""  IFV
 SG_ CAN_FL_DET_SNR_088 : 455|8@0+ (0.35156,0) [0|89.6478] "dB"  IFV
 SG_ CAN_FL_DET_MULTI_TARGET_PROB_088 : 459|4@0+ (0.06667,0) [0|1] ""  IFV
 SG_ CAN_FL_DET_CONFID_AZIMUTH_088 : 461|2@0+ (1,0) [0|3] ""  IFV
 SG_ CAN_FL_DET_CONFID_ELEVATION_088 : 463|2@0+ (1,0) [0|3] ""  IFV
 SG_ CAN_FL_DET_EXISTENCE_PROB_088 : 467|4@0+ (1,0) [0|15] ""  IFV
 SG_ CAN_FL_DET_CLASS_088 : 471|4@0+ (1,0) [0|15] ""  IFV

BO_ 790 SODFL_DETECTION_089_092: 64 SODFL
 SG_ CAN_FL_DET_RANGE_089 : 7|14@0+ (0.015625,0) [0|255.984375] "m"  IFV
 SG_ CAN_FL_DET_SD_RANGE_089 : 9|6@0+ (0.025,0) [0|1.5] "m"  IFV
 SG_ CAN_FL_DET_RANGE_RATE_089 : 19|14@0+ (0.015625,-128) [-128|127.984375] "m/s"  IFV
 SG_ CAN_FL_DET_SD_RANGE_RATE_089 : 37|6@0+ (0.02,0) [0|1.2] "m/s"  IFV
 SG_ CAN_FL_DET_AZIMUTH_089 : 47|13@0+ (0.0007668,-3.141593) [-3.141593|3.141593] "rad"  IFV
 SG_ CAN_FL_DET_SD_AZIMUTH_089 : 50|6@0+ (0.001745329,0) [0|0.104719755] "rad"  IFV
 SG_ CAN_FL_DET_ELEVATION_089 : 60|7@0+ (0.157449,-9.99812) [-9.99812|9.997903] "deg"  IFV
 SG_ CAN_FL_DET_SD_ELEVATION_089 : 69|6@0+ (0.003490659,0) [0|0.20943951] "rad"  IFV
 SG_ CAN_FL_DET_AMPLITUDE_089 : 79|7@0+ (1,-64) [-64|63] "dBsm"  IFV
 SG_ CAN_FL_DET_VALID_FLAG_089 : 72|1@0+ (1,0) [0|1] ""  IFV
 SG_ CAN_FL_DET_SUPER_RES_089 : 80|1@0+ (1,0) [0|1] ""  IFV
 SG_ CAN_FL_DET_LOW_SNR_FLAG_089 : 81|1@0+ (1,0) [0|1] ""  IFV
 SG_ CAN_FL_DET_MIXER_BIAS_FLAG_089 : 82|1@0+ (1,0) [0|1] ""  IFV
 SG_ CAN_FL_DET_RESERVED_FLAGS_089 : 87|5@0+ (1,0) [0|31] ""  IFV
 SG_ CAN_FL_DET_SNR_089 : 95|8@0+ (0.35156,0) [0|89.6478] "dB"  IFV
 SG_ CAN_FL_DET_MULTI_TARGET_PROB_089 : 99|4@0+ (0.06667,0) [0|1] ""  IFV
 SG_ CAN_FL_DET_CONFID_AZIMUTH_089 : 101|2@0+ (1,0) [0|3] ""  IFV
 SG_ CAN_FL_DET_CONFID_ELEVATION_089 : 103|2@0+ (1,0) [0|3] ""  IFV
 SG_ CAN_FL_DET_EXISTENCE_PROB_089 : 107|4@0+ (1,0) [0|15] ""  IFV
 SG_ CAN_FL_DET_CLASS_089 : 111|4@0+ (1,0) [0|15] ""  IFV
 SG_ CAN_FL_DET_RANGE_090 : 127|14@0+ (0.015625,0) [0|255.984375] "m"  IFV
 SG_ CAN_FL_DET_SD_RANGE_090 : 129|6@0+ (0.025,0) [0|1.5] "m"  IFV
 SG_ CAN_FL_DET_RANGE_RATE_090 : 139|14@0+ (0.015625,-128) [-128|127.984375] "m/s"  IFV
 SG_ CAN_FL_DET_SD_RANGE_RATE_090 : 157|6@0+ (0.02,0) [0|1.2] "m/s"  IFV
 SG_ CAN_FL_DET_AZIMUTH_090 : 167|13@0+ (0.0007668,-3.141593) [-3.141593|3.141593] "rad"  IFV
 SG_ CAN_FL_DET_SD_AZIMUTH_090 : 170|6@0+ (0.001745329,0) [0|0.104719755] "rad"  IFV
 SG_ CAN_FL_DET_ELEVATION_090 : 180|7@0+ (0.157449,-9.99812) [-9.99812|9.997903] "deg"  IFV
 SG_ CAN_FL_DET_SD_ELEVATION_090 : 189|6@0+ (0.003490659,0) [0|0.20943951] "rad"  IFV
 SG_ CAN_FL_DET_AMPLITUDE_090 : 199|7@0+ (1,-64) [-64|63] "dBsm"  IFV
 SG_ CAN_FL_DET_VALID_FLAG_090 : 192|1@0+ (1,0) [0|1] ""  IFV
 SG_ CAN_FL_DET_SUPER_RES_090 : 200|1@0+ (1,0) [0|1] ""  IFV
 SG_ CAN_FL_DET_LOW_SNR_FLAG_090 : 201|1@0+ (1,0) [0|1] ""  IFV
 SG_ CAN_FL_DET_MIXER_BIAS_FLAG_090 : 202|1@0+ (1,0) [0|1] ""  IFV
 SG_ CAN_FL_DET_RESERVED_FLAGS_090 : 207|5@0+ (1,0) [0|31] ""  IFV
 SG_ CAN_FL_DET_SNR_090 : 215|8@0+ (0.35156,0) [0|89.6478] "dB"  IFV
 SG_ CAN_FL_DET_MULTI_TARGET_PROB_090 : 219|4@0+ (0.06667,0) [0|1] ""  IFV
 SG_ CAN_FL_DET_CONFID_AZIMUTH_090 : 221|2@0+ (1,0) [0|3] ""  IFV
 SG_ CAN_FL_DET_CONFID_ELEVATION_090 : 223|2@0+ (1,0) [0|3] ""  IFV
 SG_ CAN_FL_DET_EXISTENCE_PROB_090 : 227|4@0+ (1,0) [0|15] ""  IFV
 SG_ CAN_FL_DET_CLASS_090 : 231|4@0+ (1,0) [0|15] ""  IFV
 SG_ CAN_FL_DET_RANGE_091 : 247|14@0+ (0.015625,0) [0|255.984375] "m"  IFV
 SG_ CAN_FL_DET_SD_RANGE_091 : 249|6@0+ (0.025,0) [0|1.5] "m"  IFV
 SG_ CAN_FL_DET_RANGE_RATE_091 : 259|14@0+ (0.015625,-128) [-128|127.984375] "m/s"  IFV
 SG_ CAN_FL_DET_SD_RANGE_RATE_091 : 277|6@0+ (0.02,0) [0|1.2] "m/s"  IFV
 SG_ CAN_FL_DET_AZIMUTH_091 : 287|13@0+ (0.0007668,-3.141593) [-3.141593|3.141593] "rad"  IFV
 SG_ CAN_FL_DET_SD_AZIMUTH_091 : 290|6@0+ (0.001745329,0) [0|0.104719755] "rad"  IFV
 SG_ CAN_FL_DET_ELEVATION_091 : 300|7@0+ (0.157449,-9.99812) [-9.99812|9.997903] "deg"  IFV
 SG_ CAN_FL_DET_SD_ELEVATION_091 : 309|6@0+ (0.003490659,0) [0|0.20943951] "rad"  IFV
 SG_ CAN_FL_DET_AMPLITUDE_091 : 319|7@0+ (1,-64) [-64|63] "dBsm"  IFV
 SG_ CAN_FL_DET_VALID_FLAG_091 : 312|1@0+ (1,0) [0|1] ""  IFV
 SG_ CAN_FL_DET_SUPER_RES_091 : 320|1@0+ (1,0) [0|1] ""  IFV
 SG_ CAN_FL_DET_LOW_SNR_FLAG_091 : 321|1@0+ (1,0) [0|1] ""  IFV
 SG_ CAN_FL_DET_MIXER_BIAS_FLAG_091 : 322|1@0+ (1,0) [0|1] ""  IFV
 SG_ CAN_FL_DET_RESERVED_FLAGS_091 : 327|5@0+ (1,0) [0|31] ""  IFV
 SG_ CAN_FL_DET_SNR_091 : 335|8@0+ (0.35156,0) [0|89.6478] "dB"  IFV
 SG_ CAN_FL_DET_MULTI_TARGET_PROB_091 : 339|4@0+ (0.06667,0) [0|1] ""  IFV
 SG_ CAN_FL_DET_CONFID_AZIMUTH_091 : 341|2@0+ (1,0) [0|3] ""  IFV
 SG_ CAN_FL_DET_CONFID_ELEVATION_091 : 343|2@0+ (1,0) [0|3] ""  IFV
 SG_ CAN_FL_DET_EXISTENCE_PROB_091 : 347|4@0+ (1,0) [0|15] ""  IFV
 SG_ CAN_FL_DET_CLASS_091 : 351|4@0+ (1,0) [0|15] ""  IFV
 SG_ CAN_FL_DET_RANGE_092 : 367|14@0+ (0.015625,0) [0|255.984375] "m"  IFV
 SG_ CAN_FL_DET_SD_RANGE_092 : 369|6@0+ (0.025,0) [0|1.5] "m"  IFV
 SG_ CAN_FL_DET_RANGE_RATE_092 : 379|14@0+ (0.015625,-128) [-128|127.984375] "m/s"  IFV
 SG_ CAN_FL_DET_SD_RANGE_RATE_092 : 397|6@0+ (0.02,0) [0|1.2] "m/s"  IFV
 SG_ CAN_FL_DET_AZIMUTH_092 : 407|13@0+ (0.0007668,-3.141593) [-3.141593|3.141593] "rad"  IFV
 SG_ CAN_FL_DET_SD_AZIMUTH_092 : 410|6@0+ (0.001745329,0) [0|0.104719755] "rad"  IFV
 SG_ CAN_FL_DET_ELEVATION_092 : 420|7@0+ (0.157449,-9.99812) [-9.99812|9.997903] "deg"  IFV
 SG_ CAN_FL_DET_SD_ELEVATION_092 : 429|6@0+ (0.003490659,0) [0|0.20943951] "rad"  IFV
 SG_ CAN_FL_DET_AMPLITUDE_092 : 439|7@0+ (1,-64) [-64|63] "dBsm"  IFV
 SG_ CAN_FL_DET_VALID_FLAG_092 : 432|1@0+ (1,0) [0|1] ""  IFV
 SG_ CAN_FL_DET_SUPER_RES_092 : 440|1@0+ (1,0) [0|1] ""  IFV
 SG_ CAN_FL_DET_LOW_SNR_FLAG_092 : 441|1@0+ (1,0) [0|1] ""  IFV
 SG_ CAN_FL_DET_MIXER_BIAS_FLAG_092 : 442|1@0+ (1,0) [0|1] ""  IFV
 SG_ CAN_FL_DET_RESERVED_FLAGS_092 : 447|5@0+ (1,0) [0|31] ""  IFV
 SG_ CAN_FL_DET_SNR_092 : 455|8@0+ (0.35156,0) [0|89.6478] "dB"  IFV
 SG_ CAN_FL_DET_MULTI_TARGET_PROB_092 : 459|4@0+ (0.06667,0) [0|1] ""  IFV
 SG_ CAN_FL_DET_CONFID_AZIMUTH_092 : 461|2@0+ (1,0) [0|3] ""  IFV
 SG_ CAN_FL_DET_CONFID_ELEVATION_092 : 463|2@0+ (1,0) [0|3] ""  IFV
 SG_ CAN_FL_DET_EXISTENCE_PROB_092 : 467|4@0+ (1,0) [0|15] ""  IFV
 SG_ CAN_FL_DET_CLASS_092 : 471|4@0+ (1,0) [0|15] ""  IFV

BO_ 791 SODFL_DETECTION_093_096: 64 SODFL
 SG_ CAN_FL_DET_RANGE_093 : 7|14@0+ (0.015625,0) [0|255.984375] "m"  IFV
 SG_ CAN_FL_DET_SD_RANGE_093 : 9|6@0+ (0.025,0) [0|1.5] "m"  IFV
 SG_ CAN_FL_DET_RANGE_RATE_093 : 19|14@0+ (0.015625,-128) [-128|127.984375] "m/s"  IFV
 SG_ CAN_FL_DET_SD_RANGE_RATE_093 : 37|6@0+ (0.02,0) [0|1.2] "m/s"  IFV
 SG_ CAN_FL_DET_AZIMUTH_093 : 47|13@0+ (0.0007668,-3.141593) [-3.141593|3.141593] "rad"  IFV
 SG_ CAN_FL_DET_SD_AZIMUTH_093 : 50|6@0+ (0.001745329,0) [0|0.104719755] "rad"  IFV
 SG_ CAN_FL_DET_ELEVATION_093 : 60|7@0+ (0.157449,-9.99812) [-9.99812|9.997903] "deg"  IFV
 SG_ CAN_FL_DET_SD_ELEVATION_093 : 69|6@0+ (0.003490659,0) [0|0.20943951] "rad"  IFV
 SG_ CAN_FL_DET_AMPLITUDE_093 : 79|7@0+ (1,-64) [-64|63] "dBsm"  IFV
 SG_ CAN_FL_DET_VALID_FLAG_093 : 72|1@0+ (1,0) [0|1] ""  IFV
 SG_ CAN_FL_DET_SUPER_RES_093 : 80|1@0+ (1,0) [0|1] ""  IFV
 SG_ CAN_FL_DET_LOW_SNR_FLAG_093 : 81|1@0+ (1,0) [0|1] ""  IFV
 SG_ CAN_FL_DET_MIXER_BIAS_FLAG_093 : 82|1@0+ (1,0) [0|1] ""  IFV
 SG_ CAN_FL_DET_RESERVED_FLAGS_093 : 87|5@0+ (1,0) [0|31] ""  IFV
 SG_ CAN_FL_DET_SNR_093 : 95|8@0+ (0.35156,0) [0|89.6478] "dB"  IFV
 SG_ CAN_FL_DET_MULTI_TARGET_PROB_093 : 99|4@0+ (0.06667,0) [0|1] ""  IFV
 SG_ CAN_FL_DET_CONFID_AZIMUTH_093 : 101|2@0+ (1,0) [0|3] ""  IFV
 SG_ CAN_FL_DET_CONFID_ELEVATION_093 : 103|2@0+ (1,0) [0|3] ""  IFV
 SG_ CAN_FL_DET_EXISTENCE_PROB_093 : 107|4@0+ (1,0) [0|15] ""  IFV
 SG_ CAN_FL_DET_CLASS_093 : 111|4@0+ (1,0) [0|15] ""  IFV
 SG_ CAN_FL_DET_RANGE_094 : 127|14@0+ (0.015625,0) [0|255.984375] "m"  IFV
 SG_ CAN_FL_DET_SD_RANGE_094 : 129|6@0+ (0.025,0) [0|1.5] "m"  IFV
 SG_ CAN_FL_DET_RANGE_RATE_094 : 139|14@0+ (0.015625,-128) [-128|127.984375] "m/s"  IFV
 SG_ CAN_FL_DET_SD_RANGE_RATE_094 : 157|6@0+ (0.02,0) [0|1.2] "m/s"  IFV
 SG_ CAN_FL_DET_AZIMUTH_094 : 167|13@0+ (0.0007668,-3.141593) [-3.141593|3.141593] "rad"  IFV
 SG_ CAN_FL_DET_SD_AZIMUTH_094 : 170|6@0+ (0.001745329,0) [0|0.104719755] "rad"  IFV
 SG_ CAN_FL_DET_ELEVATION_094 : 180|7@0+ (0.157449,-9.99812) [-9.99812|9.997903] "deg"  IFV
 SG_ CAN_FL_DET_SD_ELEVATION_094 : 189|6@0+ (0.003490659,0) [0|0.20943951] "rad"  IFV
 SG_ CAN_FL_DET_AMPLITUDE_094 : 199|7@0+ (1,-64) [-64|63] "dBsm"  IFV
 SG_ CAN_FL_DET_VALID_FLAG_094 : 192|1@0+ (1,0) [0|1] ""  IFV
 SG_ CAN_FL_DET_SUPER_RES_094 : 200|1@0+ (1,0) [0|1] ""  IFV
 SG_ CAN_FL_DET_LOW_SNR_FLAG_094 : 201|1@0+ (1,0) [0|1] ""  IFV
 SG_ CAN_FL_DET_MIXER_BIAS_FLAG_094 : 202|1@0+ (1,0) [0|1] ""  IFV
 SG_ CAN_FL_DET_RESERVED_FLAGS_094 : 207|5@0+ (1,0) [0|31] ""  IFV
 SG_ CAN_FL_DET_SNR_094 : 215|8@0+ (0.35156,0) [0|89.6478] "dB"  IFV
 SG_ CAN_FL_DET_MULTI_TARGET_PROB_094 : 219|4@0+ (0.06667,0) [0|1] ""  IFV
 SG_ CAN_FL_DET_CONFID_AZIMUTH_094 : 221|2@0+ (1,0) [0|3] ""  IFV
 SG_ CAN_FL_DET_CONFID_ELEVATION_094 : 223|2@0+ (1,0) [0|3] ""  IFV
 SG_ CAN_FL_DET_EXISTENCE_PROB_094 : 227|4@0+ (1,0) [0|15] ""  IFV
 SG_ CAN_FL_DET_CLASS_094 : 231|4@0+ (1,0) [0|15] ""  IFV
 SG_ CAN_FL_DET_RANGE_095 : 247|14@0+ (0.015625,0) [0|255.984375] "m"  IFV
 SG_ CAN_FL_DET_SD_RANGE_095 : 249|6@0+ (0.025,0) [0|1.5] "m"  IFV
 SG_ CAN_FL_DET_RANGE_RATE_095 : 259|14@0+ (0.015625,-128) [-128|127.984375] "m/s"  IFV
 SG_ CAN_FL_DET_SD_RANGE_RATE_095 : 277|6@0+ (0.02,0) [0|1.2] "m/s"  IFV
 SG_ CAN_FL_DET_AZIMUTH_095 : 287|13@0+ (0.0007668,-3.141593) [-3.141593|3.141593] "rad"  IFV
 SG_ CAN_FL_DET_SD_AZIMUTH_095 : 290|6@0+ (0.001745329,0) [0|0.104719755] "rad"  IFV
 SG_ CAN_FL_DET_ELEVATION_095 : 300|7@0+ (0.157449,-9.99812) [-9.99812|9.997903] "deg"  IFV
 SG_ CAN_FL_DET_SD_ELEVATION_095 : 309|6@0+ (0.003490659,0) [0|0.20943951] "rad"  IFV
 SG_ CAN_FL_DET_AMPLITUDE_095 : 319|7@0+ (1,-64) [-64|63] "dBsm"  IFV
 SG_ CAN_FL_DET_VALID_FLAG_095 : 312|1@0+ (1,0) [0|1] ""  IFV
 SG_ CAN_FL_DET_SUPER_RES_095 : 320|1@0+ (1,0) [0|1] ""  IFV
 SG_ CAN_FL_DET_LOW_SNR_FLAG_095 : 321|1@0+ (1,0) [0|1] ""  IFV
 SG_ CAN_FL_DET_MIXER_BIAS_FLAG_095 : 322|1@0+ (1,0) [0|1] ""  IFV
 SG_ CAN_FL_DET_RESERVED_FLAGS_095 : 327|5@0+ (1,0) [0|31] ""  IFV
 SG_ CAN_FL_DET_SNR_095 : 335|8@0+ (0.35156,0) [0|89.6478] "dB"  IFV
 SG_ CAN_FL_DET_MULTI_TARGET_PROB_095 : 339|4@0+ (0.06667,0) [0|1] ""  IFV
 SG_ CAN_FL_DET_CONFID_AZIMUTH_095 : 341|2@0+ (1,0) [0|3] ""  IFV
 SG_ CAN_FL_DET_CONFID_ELEVATION_095 : 343|2@0+ (1,0) [0|3] ""  IFV
 SG_ CAN_FL_DET_EXISTENCE_PROB_095 : 347|4@0+ (1,0) [0|15] ""  IFV
 SG_ CAN_FL_DET_CLASS_095 : 351|4@0+ (1,0) [0|15] ""  IFV
 SG_ CAN_FL_DET_RANGE_096 : 367|14@0+ (0.015625,0) [0|255.984375] "m"  IFV
 SG_ CAN_FL_DET_SD_RANGE_096 : 369|6@0+ (0.025,0) [0|1.5] "m"  IFV
 SG_ CAN_FL_DET_RANGE_RATE_096 : 379|14@0+ (0.015625,-128) [-128|127.984375] "m/s"  IFV
 SG_ CAN_FL_DET_SD_RANGE_RATE_096 : 397|6@0+ (0.02,0) [0|1.2] "m/s"  IFV
 SG_ CAN_FL_DET_AZIMUTH_096 : 407|13@0+ (0.0007668,-3.141593) [-3.141593|3.141593] "rad"  IFV
 SG_ CAN_FL_DET_SD_AZIMUTH_096 : 410|6@0+ (0.001745329,0) [0|0.104719755] "rad"  IFV
 SG_ CAN_FL_DET_ELEVATION_096 : 420|7@0+ (0.157449,-9.99812) [-9.99812|9.997903] "deg"  IFV
 SG_ CAN_FL_DET_SD_ELEVATION_096 : 429|6@0+ (0.003490659,0) [0|0.20943951] "rad"  IFV
 SG_ CAN_FL_DET_AMPLITUDE_096 : 439|7@0+ (1,-64) [-64|63] "dBsm"  IFV
 SG_ CAN_FL_DET_VALID_FLAG_096 : 432|1@0+ (1,0) [0|1] ""  IFV
 SG_ CAN_FL_DET_SUPER_RES_096 : 440|1@0+ (1,0) [0|1] ""  IFV
 SG_ CAN_FL_DET_LOW_SNR_FLAG_096 : 441|1@0+ (1,0) [0|1] ""  IFV
 SG_ CAN_FL_DET_MIXER_BIAS_FLAG_096 : 442|1@0+ (1,0) [0|1] ""  IFV
 SG_ CAN_FL_DET_RESERVED_FLAGS_096 : 447|5@0+ (1,0) [0|31] ""  IFV
 SG_ CAN_FL_DET_SNR_096 : 455|8@0+ (0.35156,0) [0|89.6478] "dB"  IFV
 SG_ CAN_FL_DET_MULTI_TARGET_PROB_096 : 459|4@0+ (0.06667,0) [0|1] ""  IFV
 SG_ CAN_FL_DET_CONFID_AZIMUTH_096 : 461|2@0+ (1,0) [0|3] ""  IFV
 SG_ CAN_FL_DET_CONFID_ELEVATION_096 : 463|2@0+ (1,0) [0|3] ""  IFV
 SG_ CAN_FL_DET_EXISTENCE_PROB_096 : 467|4@0+ (1,0) [0|15] ""  IFV
 SG_ CAN_FL_DET_CLASS_096 : 471|4@0+ (1,0) [0|15] ""  IFV

BO_ 792 SODFL_DETECTION_097_100: 64 SODFL
 SG_ CAN_FL_DET_RANGE_097 : 7|14@0+ (0.015625,0) [0|255.984375] "m"  IFV
 SG_ CAN_FL_DET_SD_RANGE_097 : 9|6@0+ (0.025,0) [0|1.5] "m"  IFV
 SG_ CAN_FL_DET_RANGE_RATE_097 : 19|14@0+ (0.015625,-128) [-128|127.984375] "m/s"  IFV
 SG_ CAN_FL_DET_SD_RANGE_RATE_097 : 37|6@0+ (0.02,0) [0|1.2] "m/s"  IFV
 SG_ CAN_FL_DET_AZIMUTH_097 : 47|13@0+ (0.0007668,-3.141593) [-3.141593|3.141593] "rad"  IFV
 SG_ CAN_FL_DET_SD_AZIMUTH_097 : 50|6@0+ (0.001745329,0) [0|0.104719755] "rad"  IFV
 SG_ CAN_FL_DET_ELEVATION_097 : 60|7@0+ (0.157449,-9.99812) [-9.99812|9.997903] "deg"  IFV
 SG_ CAN_FL_DET_SD_ELEVATION_097 : 69|6@0+ (0.003490659,0) [0|0.20943951] "rad"  IFV
 SG_ CAN_FL_DET_AMPLITUDE_097 : 79|7@0+ (1,-64) [-64|63] "dBsm"  IFV
 SG_ CAN_FL_DET_VALID_FLAG_097 : 72|1@0+ (1,0) [0|1] ""  IFV
 SG_ CAN_FL_DET_SUPER_RES_097 : 80|1@0+ (1,0) [0|1] ""  IFV
 SG_ CAN_FL_DET_LOW_SNR_FLAG_097 : 81|1@0+ (1,0) [0|1] ""  IFV
 SG_ CAN_FL_DET_MIXER_BIAS_FLAG_097 : 82|1@0+ (1,0) [0|1] ""  IFV
 SG_ CAN_FL_DET_RESERVED_FLAGS_097 : 87|5@0+ (1,0) [0|31] ""  IFV
 SG_ CAN_FL_DET_SNR_097 : 95|8@0+ (0.35156,0) [0|89.6478] "dB"  IFV
 SG_ CAN_FL_DET_MULTI_TARGET_PROB_097 : 99|4@0+ (0.06667,0) [0|1] ""  IFV
 SG_ CAN_FL_DET_CONFID_AZIMUTH_097 : 101|2@0+ (1,0) [0|3] ""  IFV
 SG_ CAN_FL_DET_CONFID_ELEVATION_097 : 103|2@0+ (1,0) [0|3] ""  IFV
 SG_ CAN_FL_DET_EXISTENCE_PROB_097 : 107|4@0+ (1,0) [0|15] ""  IFV
 SG_ CAN_FL_DET_CLASS_097 : 111|4@0+ (1,0) [0|15] ""  IFV
 SG_ CAN_FL_DET_RANGE_098 : 127|14@0+ (0.015625,0) [0|255.984375] "m"  IFV
 SG_ CAN_FL_DET_SD_RANGE_098 : 129|6@0+ (0.025,0) [0|1.5] "m"  IFV
 SG_ CAN_FL_DET_RANGE_RATE_098 : 139|14@0+ (0.015625,-128) [-128|127.984375] "m/s"  IFV
 SG_ CAN_FL_DET_SD_RANGE_RATE_098 : 157|6@0+ (0.02,0) [0|1.2] "m/s"  IFV
 SG_ CAN_FL_DET_AZIMUTH_098 : 167|13@0+ (0.0007668,-3.141593) [-3.141593|3.141593] "rad"  IFV
 SG_ CAN_FL_DET_SD_AZIMUTH_098 : 170|6@0+ (0.001745329,0) [0|0.104719755] "rad"  IFV
 SG_ CAN_FL_DET_ELEVATION_098 : 180|7@0+ (0.157449,-9.99812) [-9.99812|9.997903] "deg"  IFV
 SG_ CAN_FL_DET_SD_ELEVATION_098 : 189|6@0+ (0.003490659,0) [0|0.20943951] "rad"  IFV
 SG_ CAN_FL_DET_AMPLITUDE_098 : 199|7@0+ (1,-64) [-64|63] "dBsm"  IFV
 SG_ CAN_FL_DET_VALID_FLAG_098 : 192|1@0+ (1,0) [0|1] ""  IFV
 SG_ CAN_FL_DET_SUPER_RES_098 : 200|1@0+ (1,0) [0|1] ""  IFV
 SG_ CAN_FL_DET_LOW_SNR_FLAG_098 : 201|1@0+ (1,0) [0|1] ""  IFV
 SG_ CAN_FL_DET_MIXER_BIAS_FLAG_098 : 202|1@0+ (1,0) [0|1] ""  IFV
 SG_ CAN_FL_DET_RESERVED_FLAGS_098 : 207|5@0+ (1,0) [0|31] ""  IFV
 SG_ CAN_FL_DET_SNR_098 : 215|8@0+ (0.35156,0) [0|89.6478] "dB"  IFV
 SG_ CAN_FL_DET_MULTI_TARGET_PROB_098 : 219|4@0+ (0.06667,0) [0|1] ""  IFV
 SG_ CAN_FL_DET_CONFID_AZIMUTH_098 : 221|2@0+ (1,0) [0|3] ""  IFV
 SG_ CAN_FL_DET_CONFID_ELEVATION_098 : 223|2@0+ (1,0) [0|3] ""  IFV
 SG_ CAN_FL_DET_EXISTENCE_PROB_098 : 227|4@0+ (1,0) [0|15] ""  IFV
 SG_ CAN_FL_DET_CLASS_098 : 231|4@0+ (1,0) [0|15] ""  IFV
 SG_ CAN_FL_DET_RANGE_099 : 247|14@0+ (0.015625,0) [0|255.984375] "m"  IFV
 SG_ CAN_FL_DET_SD_RANGE_099 : 249|6@0+ (0.025,0) [0|1.5] "m"  IFV
 SG_ CAN_FL_DET_RANGE_RATE_099 : 259|14@0+ (0.015625,-128) [-128|127.984375] "m/s"  IFV
 SG_ CAN_FL_DET_SD_RANGE_RATE_099 : 277|6@0+ (0.02,0) [0|1.2] "m/s"  IFV
 SG_ CAN_FL_DET_AZIMUTH_099 : 287|13@0+ (0.0007668,-3.141593) [-3.141593|3.141593] "rad"  IFV
 SG_ CAN_FL_DET_SD_AZIMUTH_099 : 290|6@0+ (0.001745329,0) [0|0.104719755] "rad"  IFV
 SG_ CAN_FL_DET_ELEVATION_099 : 300|7@0+ (0.157449,-9.99812) [-9.99812|9.997903] "deg"  IFV
 SG_ CAN_FL_DET_SD_ELEVATION_099 : 309|6@0+ (0.003490659,0) [0|0.20943951] "rad"  IFV
 SG_ CAN_FL_DET_AMPLITUDE_099 : 319|7@0+ (1,-64) [-64|63] "dBsm"  IFV
 SG_ CAN_FL_DET_VALID_FLAG_099 : 312|1@0+ (1,0) [0|1] ""  IFV
 SG_ CAN_FL_DET_SUPER_RES_099 : 320|1@0+ (1,0) [0|1] ""  IFV
 SG_ CAN_FL_DET_LOW_SNR_FLAG_099 : 321|1@0+ (1,0) [0|1] ""  IFV
 SG_ CAN_FL_DET_MIXER_BIAS_FLAG_099 : 322|1@0+ (1,0) [0|1] ""  IFV
 SG_ CAN_FL_DET_RESERVED_FLAGS_099 : 327|5@0+ (1,0) [0|31] ""  IFV
 SG_ CAN_FL_DET_SNR_099 : 335|8@0+ (0.35156,0) [0|89.6478] "dB"  IFV
 SG_ CAN_FL_DET_MULTI_TARGET_PROB_099 : 339|4@0+ (0.06667,0) [0|1] ""  IFV
 SG_ CAN_FL_DET_CONFID_AZIMUTH_099 : 341|2@0+ (1,0) [0|3] ""  IFV
 SG_ CAN_FL_DET_CONFID_ELEVATION_099 : 343|2@0+ (1,0) [0|3] ""  IFV
 SG_ CAN_FL_DET_EXISTENCE_PROB_099 : 347|4@0+ (1,0) [0|15] ""  IFV
 SG_ CAN_FL_DET_CLASS_099 : 351|4@0+ (1,0) [0|15] ""  IFV
 SG_ CAN_FL_DET_RANGE_100 : 367|14@0+ (0.015625,0) [0|255.984375] "m"  IFV
 SG_ CAN_FL_DET_SD_RANGE_100 : 369|6@0+ (0.025,0) [0|1.5] "m"  IFV
 SG_ CAN_FL_DET_RANGE_RATE_100 : 379|14@0+ (0.015625,-128) [-128|127.984375] "m/s"  IFV
 SG_ CAN_FL_DET_SD_RANGE_RATE_100 : 397|6@0+ (0.02,0) [0|1.2] "m/s"  IFV
 SG_ CAN_FL_DET_AZIMUTH_100 : 407|13@0+ (0.0007668,-3.141593) [-3.141593|3.141593] "rad"  IFV
 SG_ CAN_FL_DET_SD_AZIMUTH_100 : 410|6@0+ (0.001745329,0) [0|0.104719755] "rad"  IFV
 SG_ CAN_FL_DET_ELEVATION_100 : 420|7@0+ (0.157449,-9.99812) [-9.99812|9.997903] "deg"  IFV
 SG_ CAN_FL_DET_SD_ELEVATION_100 : 429|6@0+ (0.003490659,0) [0|0.20943951] "rad"  IFV
 SG_ CAN_FL_DET_AMPLITUDE_100 : 439|7@0+ (1,-64) [-64|63] "dBsm"  IFV
 SG_ CAN_FL_DET_VALID_FLAG_100 : 432|1@0+ (1,0) [0|1] ""  IFV
 SG_ CAN_FL_DET_SUPER_RES_100 : 440|1@0+ (1,0) [0|1] ""  IFV
 SG_ CAN_FL_DET_LOW_SNR_FLAG_100 : 441|1@0+ (1,0) [0|1] ""  IFV
 SG_ CAN_FL_DET_MIXER_BIAS_FLAG_100 : 442|1@0+ (1,0) [0|1] ""  IFV
 SG_ CAN_FL_DET_RESERVED_FLAGS_100 : 447|5@0+ (1,0) [0|31] ""  IFV
 SG_ CAN_FL_DET_SNR_100 : 455|8@0+ (0.35156,0) [0|89.6478] "dB"  IFV
 SG_ CAN_FL_DET_MULTI_TARGET_PROB_100 : 459|4@0+ (0.06667,0) [0|1] ""  IFV
 SG_ CAN_FL_DET_CONFID_AZIMUTH_100 : 461|2@0+ (1,0) [0|3] ""  IFV
 SG_ CAN_FL_DET_CONFID_ELEVATION_100 : 463|2@0+ (1,0) [0|3] ""  IFV
 SG_ CAN_FL_DET_EXISTENCE_PROB_100 : 467|4@0+ (1,0) [0|15] ""  IFV
 SG_ CAN_FL_DET_CLASS_100 : 471|4@0+ (1,0) [0|15] ""  IFV

BO_ 793 SODFL_DETECTION_101_104: 64 SODFL
 SG_ CAN_FL_DET_RANGE_101 : 7|14@0+ (0.015625,0) [0|255.984375] "m"  IFV
 SG_ CAN_FL_DET_SD_RANGE_101 : 9|6@0+ (0.025,0) [0|1.5] "m"  IFV
 SG_ CAN_FL_DET_RANGE_RATE_101 : 19|14@0+ (0.015625,-128) [-128|127.984375] "m/s"  IFV
 SG_ CAN_FL_DET_SD_RANGE_RATE_101 : 37|6@0+ (0.02,0) [0|1.2] "m/s"  IFV
 SG_ CAN_FL_DET_AZIMUTH_101 : 47|13@0+ (0.0007668,-3.141593) [-3.141593|3.141593] "rad"  IFV
 SG_ CAN_FL_DET_SD_AZIMUTH_101 : 50|6@0+ (0.001745329,0) [0|0.104719755] "rad"  IFV
 SG_ CAN_FL_DET_ELEVATION_101 : 60|7@0+ (0.157449,-9.99812) [-9.99812|9.997903] "deg"  IFV
 SG_ CAN_FL_DET_SD_ELEVATION_101 : 69|6@0+ (0.003490659,0) [0|0.20943951] "rad"  IFV
 SG_ CAN_FL_DET_AMPLITUDE_101 : 79|7@0+ (1,-64) [-64|63] "dBsm"  IFV
 SG_ CAN_FL_DET_VALID_FLAG_101 : 72|1@0+ (1,0) [0|1] ""  IFV
 SG_ CAN_FL_DET_SUPER_RES_101 : 80|1@0+ (1,0) [0|1] ""  IFV
 SG_ CAN_FL_DET_LOW_SNR_FLAG_101 : 81|1@0+ (1,0) [0|1] ""  IFV
 SG_ CAN_FL_DET_MIXER_BIAS_FLAG_101 : 82|1@0+ (1,0) [0|1] ""  IFV
 SG_ CAN_FL_DET_RESERVED_FLAGS_101 : 87|5@0+ (1,0) [0|31] ""  IFV
 SG_ CAN_FL_DET_SNR_101 : 95|8@0+ (0.35156,0) [0|89.6478] "dB"  IFV
 SG_ CAN_FL_DET_MULTI_TARGET_PROB_101 : 99|4@0+ (0.06667,0) [0|1] ""  IFV
 SG_ CAN_FL_DET_CONFID_AZIMUTH_101 : 101|2@0+ (1,0) [0|3] ""  IFV
 SG_ CAN_FL_DET_CONFID_ELEVATION_101 : 103|2@0+ (1,0) [0|3] ""  IFV
 SG_ CAN_FL_DET_EXISTENCE_PROB_101 : 107|4@0+ (1,0) [0|15] ""  IFV
 SG_ CAN_FL_DET_CLASS_101 : 111|4@0+ (1,0) [0|15] ""  IFV
 SG_ CAN_FL_DET_RANGE_102 : 127|14@0+ (0.015625,0) [0|255.984375] "m"  IFV
 SG_ CAN_FL_DET_SD_RANGE_102 : 129|6@0+ (0.025,0) [0|1.5] "m"  IFV
 SG_ CAN_FL_DET_RANGE_RATE_102 : 139|14@0+ (0.015625,-128) [-128|127.984375] "m/s"  IFV
 SG_ CAN_FL_DET_SD_RANGE_RATE_102 : 157|6@0+ (0.02,0) [0|1.2] "m/s"  IFV
 SG_ CAN_FL_DET_AZIMUTH_102 : 167|13@0+ (0.0007668,-3.141593) [-3.141593|3.141593] "rad"  IFV
 SG_ CAN_FL_DET_SD_AZIMUTH_102 : 170|6@0+ (0.001745329,0) [0|0.104719755] "rad"  IFV
 SG_ CAN_FL_DET_ELEVATION_102 : 180|7@0+ (0.157449,-9.99812) [-9.99812|9.997903] "deg"  IFV
 SG_ CAN_FL_DET_SD_ELEVATION_102 : 189|6@0+ (0.003490659,0) [0|0.20943951] "rad"  IFV
 SG_ CAN_FL_DET_AMPLITUDE_102 : 199|7@0+ (1,-64) [-64|63] "dBsm"  IFV
 SG_ CAN_FL_DET_VALID_FLAG_102 : 192|1@0+ (1,0) [0|1] ""  IFV
 SG_ CAN_FL_DET_SUPER_RES_102 : 200|1@0+ (1,0) [0|1] ""  IFV
 SG_ CAN_FL_DET_LOW_SNR_FLAG_102 : 201|1@0+ (1,0) [0|1] ""  IFV
 SG_ CAN_FL_DET_MIXER_BIAS_FLAG_102 : 202|1@0+ (1,0) [0|1] ""  IFV
 SG_ CAN_FL_DET_RESERVED_FLAGS_102 : 207|5@0+ (1,0) [0|31] ""  IFV
 SG_ CAN_FL_DET_SNR_102 : 215|8@0+ (0.35156,0) [0|89.6478] "dB"  IFV
 SG_ CAN_FL_DET_MULTI_TARGET_PROB_102 : 219|4@0+ (0.06667,0) [0|1] ""  IFV
 SG_ CAN_FL_DET_CONFID_AZIMUTH_102 : 221|2@0+ (1,0) [0|3] ""  IFV
 SG_ CAN_FL_DET_CONFID_ELEVATION_102 : 223|2@0+ (1,0) [0|3] ""  IFV
 SG_ CAN_FL_DET_EXISTENCE_PROB_102 : 227|4@0+ (1,0) [0|15] ""  IFV
 SG_ CAN_FL_DET_CLASS_102 : 231|4@0+ (1,0) [0|15] ""  IFV
 SG_ CAN_FL_DET_RANGE_103 : 247|14@0+ (0.015625,0) [0|255.984375] "m"  IFV
 SG_ CAN_FL_DET_SD_RANGE_103 : 249|6@0+ (0.025,0) [0|1.5] "m"  IFV
 SG_ CAN_FL_DET_RANGE_RATE_103 : 259|14@0+ (0.015625,-128) [-128|127.984375] "m/s"  IFV
 SG_ CAN_FL_DET_SD_RANGE_RATE_103 : 277|6@0+ (0.02,0) [0|1.2] "m/s"  IFV
 SG_ CAN_FL_DET_AZIMUTH_103 : 287|13@0+ (0.0007668,-3.141593) [-3.141593|3.141593] "rad"  IFV
 SG_ CAN_FL_DET_SD_AZIMUTH_103 : 290|6@0+ (0.001745329,0) [0|0.104719755] "rad"  IFV
 SG_ CAN_FL_DET_ELEVATION_103 : 300|7@0+ (0.157449,-9.99812) [-9.99812|9.997903] "deg"  IFV
 SG_ CAN_FL_DET_SD_ELEVATION_103 : 309|6@0+ (0.003490659,0) [0|0.20943951] "rad"  IFV
 SG_ CAN_FL_DET_AMPLITUDE_103 : 319|7@0+ (1,-64) [-64|63] "dBsm"  IFV
 SG_ CAN_FL_DET_VALID_FLAG_103 : 312|1@0+ (1,0) [0|1] ""  IFV
 SG_ CAN_FL_DET_SUPER_RES_103 : 320|1@0+ (1,0) [0|1] ""  IFV
 SG_ CAN_FL_DET_LOW_SNR_FLAG_103 : 321|1@0+ (1,0) [0|1] ""  IFV
 SG_ CAN_FL_DET_MIXER_BIAS_FLAG_103 : 322|1@0+ (1,0) [0|1] ""  IFV
 SG_ CAN_FL_DET_RESERVED_FLAGS_103 : 327|5@0+ (1,0) [0|31] ""  IFV
 SG_ CAN_FL_DET_SNR_103 : 335|8@0+ (0.35156,0) [0|89.6478] "dB"  IFV
 SG_ CAN_FL_DET_MULTI_TARGET_PROB_103 : 339|4@0+ (0.06667,0) [0|1] ""  IFV
 SG_ CAN_FL_DET_CONFID_AZIMUTH_103 : 341|2@0+ (1,0) [0|3] ""  IFV
 SG_ CAN_FL_DET_CONFID_ELEVATION_103 : 343|2@0+ (1,0) [0|3] ""  IFV
 SG_ CAN_FL_DET_EXISTENCE_PROB_103 : 347|4@0+ (1,0) [0|15] ""  IFV
 SG_ CAN_FL_DET_CLASS_103 : 351|4@0+ (1,0) [0|15] ""  IFV
 SG_ CAN_FL_DET_RANGE_104 : 367|14@0+ (0.015625,0) [0|255.984375] "m"  IFV
 SG_ CAN_FL_DET_SD_RANGE_104 : 369|6@0+ (0.025,0) [0|1.5] "m"  IFV
 SG_ CAN_FL_DET_RANGE_RATE_104 : 379|14@0+ (0.015625,-128) [-128|127.984375] "m/s"  IFV
 SG_ CAN_FL_DET_SD_RANGE_RATE_104 : 397|6@0+ (0.02,0) [0|1.2] "m/s"  IFV
 SG_ CAN_FL_DET_AZIMUTH_104 : 407|13@0+ (0.0007668,-3.141593) [-3.141593|3.141593] "rad"  IFV
 SG_ CAN_FL_DET_SD_AZIMUTH_104 : 410|6@0+ (0.001745329,0) [0|0.104719755] "rad"  IFV
 SG_ CAN_FL_DET_ELEVATION_104 : 420|7@0+ (0.157449,-9.99812) [-9.99812|9.997903] "deg"  IFV
 SG_ CAN_FL_DET_SD_ELEVATION_104 : 429|6@0+ (0.003490659,0) [0|0.20943951] "rad"  IFV
 SG_ CAN_FL_DET_AMPLITUDE_104 : 439|7@0+ (1,-64) [-64|63] "dBsm"  IFV
 SG_ CAN_FL_DET_VALID_FLAG_104 : 432|1@0+ (1,0) [0|1] ""  IFV
 SG_ CAN_FL_DET_SUPER_RES_104 : 440|1@0+ (1,0) [0|1] ""  IFV
 SG_ CAN_FL_DET_LOW_SNR_FLAG_104 : 441|1@0+ (1,0) [0|1] ""  IFV
 SG_ CAN_FL_DET_MIXER_BIAS_FLAG_104 : 442|1@0+ (1,0) [0|1] ""  IFV
 SG_ CAN_FL_DET_RESERVED_FLAGS_104 : 447|5@0+ (1,0) [0|31] ""  IFV
 SG_ CAN_FL_DET_SNR_104 : 455|8@0+ (0.35156,0) [0|89.6478] "dB"  IFV
 SG_ CAN_FL_DET_MULTI_TARGET_PROB_104 : 459|4@0+ (0.06667,0) [0|1] ""  IFV
 SG_ CAN_FL_DET_CONFID_AZIMUTH_104 : 461|2@0+ (1,0) [0|3] ""  IFV
 SG_ CAN_FL_DET_CONFID_ELEVATION_104 : 463|2@0+ (1,0) [0|3] ""  IFV
 SG_ CAN_FL_DET_EXISTENCE_PROB_104 : 467|4@0+ (1,0) [0|15] ""  IFV
 SG_ CAN_FL_DET_CLASS_104 : 471|4@0+ (1,0) [0|15] ""  IFV

BO_ 794 SODFL_DETECTION_105_108: 64 SODFL
 SG_ CAN_FL_DET_RANGE_105 : 7|14@0+ (0.015625,0) [0|255.984375] "m"  IFV
 SG_ CAN_FL_DET_SD_RANGE_105 : 9|6@0+ (0.025,0) [0|1.5] "m"  IFV
 SG_ CAN_FL_DET_RANGE_RATE_105 : 19|14@0+ (0.015625,-128) [-128|127.984375] "m/s"  IFV
 SG_ CAN_FL_DET_SD_RANGE_RATE_105 : 37|6@0+ (0.02,0) [0|1.2] "m/s"  IFV
 SG_ CAN_FL_DET_AZIMUTH_105 : 47|13@0+ (0.0007668,-3.141593) [-3.141593|3.141593] "rad"  IFV
 SG_ CAN_FL_DET_SD_AZIMUTH_105 : 50|6@0+ (0.001745329,0) [0|0.104719755] "rad"  IFV
 SG_ CAN_FL_DET_ELEVATION_105 : 60|7@0+ (0.157449,-9.99812) [-9.99812|9.997903] "deg"  IFV
 SG_ CAN_FL_DET_SD_ELEVATION_105 : 69|6@0+ (0.003490659,0) [0|0.20943951] "rad"  IFV
 SG_ CAN_FL_DET_AMPLITUDE_105 : 79|7@0+ (1,-64) [-64|63] "dBsm"  IFV
 SG_ CAN_FL_DET_VALID_FLAG_105 : 72|1@0+ (1,0) [0|1] ""  IFV
 SG_ CAN_FL_DET_SUPER_RES_105 : 80|1@0+ (1,0) [0|1] ""  IFV
 SG_ CAN_FL_DET_LOW_SNR_FLAG_105 : 81|1@0+ (1,0) [0|1] ""  IFV
 SG_ CAN_FL_DET_MIXER_BIAS_FLAG_105 : 82|1@0+ (1,0) [0|1] ""  IFV
 SG_ CAN_FL_DET_RESERVED_FLAGS_105 : 87|5@0+ (1,0) [0|31] ""  IFV
 SG_ CAN_FL_DET_SNR_105 : 95|8@0+ (0.35156,0) [0|89.6478] "dB"  IFV
 SG_ CAN_FL_DET_MULTI_TARGET_PROB_105 : 99|4@0+ (0.06667,0) [0|1] ""  IFV
 SG_ CAN_FL_DET_CONFID_AZIMUTH_105 : 101|2@0+ (1,0) [0|3] ""  IFV
 SG_ CAN_FL_DET_CONFID_ELEVATION_105 : 103|2@0+ (1,0) [0|3] ""  IFV
 SG_ CAN_FL_DET_EXISTENCE_PROB_105 : 107|4@0+ (1,0) [0|15] ""  IFV
 SG_ CAN_FL_DET_CLASS_105 : 111|4@0+ (1,0) [0|15] ""  IFV
 SG_ CAN_FL_DET_RANGE_106 : 127|14@0+ (0.015625,0) [0|255.984375] "m"  IFV
 SG_ CAN_FL_DET_SD_RANGE_106 : 129|6@0+ (0.025,0) [0|1.5] "m"  IFV
 SG_ CAN_FL_DET_RANGE_RATE_106 : 139|14@0+ (0.015625,-128) [-128|127.984375] "m/s"  IFV
 SG_ CAN_FL_DET_SD_RANGE_RATE_106 : 157|6@0+ (0.02,0) [0|1.2] "m/s"  IFV
 SG_ CAN_FL_DET_AZIMUTH_106 : 167|13@0+ (0.0007668,-3.141593) [-3.141593|3.141593] "rad"  IFV
 SG_ CAN_FL_DET_SD_AZIMUTH_106 : 170|6@0+ (0.001745329,0) [0|0.104719755] "rad"  IFV
 SG_ CAN_FL_DET_ELEVATION_106 : 180|7@0+ (0.157449,-9.99812) [-9.99812|9.997903] "deg"  IFV
 SG_ CAN_FL_DET_SD_ELEVATION_106 : 189|6@0+ (0.003490659,0) [0|0.20943951] "rad"  IFV
 SG_ CAN_FL_DET_AMPLITUDE_106 : 199|7@0+ (1,-64) [-64|63] "dBsm"  IFV
 SG_ CAN_FL_DET_VALID_FLAG_106 : 192|1@0+ (1,0) [0|1] ""  IFV
 SG_ CAN_FL_DET_SUPER_RES_106 : 200|1@0+ (1,0) [0|1] ""  IFV
 SG_ CAN_FL_DET_LOW_SNR_FLAG_106 : 201|1@0+ (1,0) [0|1] ""  IFV
 SG_ CAN_FL_DET_MIXER_BIAS_FLAG_106 : 202|1@0+ (1,0) [0|1] ""  IFV
 SG_ CAN_FL_DET_RESERVED_FLAGS_106 : 207|5@0+ (1,0) [0|31] ""  IFV
 SG_ CAN_FL_DET_SNR_106 : 215|8@0+ (0.35156,0) [0|89.6478] "dB"  IFV
 SG_ CAN_FL_DET_MULTI_TARGET_PROB_106 : 219|4@0+ (0.06667,0) [0|1] ""  IFV
 SG_ CAN_FL_DET_CONFID_AZIMUTH_106 : 221|2@0+ (1,0) [0|3] ""  IFV
 SG_ CAN_FL_DET_CONFID_ELEVATION_106 : 223|2@0+ (1,0) [0|3] ""  IFV
 SG_ CAN_FL_DET_EXISTENCE_PROB_106 : 227|4@0+ (1,0) [0|15] ""  IFV
 SG_ CAN_FL_DET_CLASS_106 : 231|4@0+ (1,0) [0|15] ""  IFV
 SG_ CAN_FL_DET_RANGE_107 : 247|14@0+ (0.015625,0) [0|255.984375] "m"  IFV
 SG_ CAN_FL_DET_SD_RANGE_107 : 249|6@0+ (0.025,0) [0|1.5] "m"  IFV
 SG_ CAN_FL_DET_RANGE_RATE_107 : 259|14@0+ (0.015625,-128) [-128|127.984375] "m/s"  IFV
 SG_ CAN_FL_DET_SD_RANGE_RATE_107 : 277|6@0+ (0.02,0) [0|1.2] "m/s"  IFV
 SG_ CAN_FL_DET_AZIMUTH_107 : 287|13@0+ (0.0007668,-3.141593) [-3.141593|3.141593] "rad"  IFV
 SG_ CAN_FL_DET_SD_AZIMUTH_107 : 290|6@0+ (0.001745329,0) [0|0.104719755] "rad"  IFV
 SG_ CAN_FL_DET_ELEVATION_107 : 300|7@0+ (0.157449,-9.99812) [-9.99812|9.997903] "deg"  IFV
 SG_ CAN_FL_DET_SD_ELEVATION_107 : 309|6@0+ (0.003490659,0) [0|0.20943951] "rad"  IFV
 SG_ CAN_FL_DET_AMPLITUDE_107 : 319|7@0+ (1,-64) [-64|63] "dBsm"  IFV
 SG_ CAN_FL_DET_VALID_FLAG_107 : 312|1@0+ (1,0) [0|1] ""  IFV
 SG_ CAN_FL_DET_SUPER_RES_107 : 320|1@0+ (1,0) [0|1] ""  IFV
 SG_ CAN_FL_DET_LOW_SNR_FLAG_107 : 321|1@0+ (1,0) [0|1] ""  IFV
 SG_ CAN_FL_DET_MIXER_BIAS_FLAG_107 : 322|1@0+ (1,0) [0|1] ""  IFV
 SG_ CAN_FL_DET_RESERVED_FLAGS_107 : 327|5@0+ (1,0) [0|31] ""  IFV
 SG_ CAN_FL_DET_SNR_107 : 335|8@0+ (0.35156,0) [0|89.6478] "dB"  IFV
 SG_ CAN_FL_DET_MULTI_TARGET_PROB_107 : 339|4@0+ (0.06667,0) [0|1] ""  IFV
 SG_ CAN_FL_DET_CONFID_AZIMUTH_107 : 341|2@0+ (1,0) [0|3] ""  IFV
 SG_ CAN_FL_DET_CONFID_ELEVATION_107 : 343|2@0+ (1,0) [0|3] ""  IFV
 SG_ CAN_FL_DET_EXISTENCE_PROB_107 : 347|4@0+ (1,0) [0|15] ""  IFV
 SG_ CAN_FL_DET_CLASS_107 : 351|4@0+ (1,0) [0|15] ""  IFV
 SG_ CAN_FL_DET_RANGE_108 : 367|14@0+ (0.015625,0) [0|255.984375] "m"  IFV
 SG_ CAN_FL_DET_SD_RANGE_108 : 369|6@0+ (0.025,0) [0|1.5] "m"  IFV
 SG_ CAN_FL_DET_RANGE_RATE_108 : 379|14@0+ (0.015625,-128) [-128|127.984375] "m/s"  IFV
 SG_ CAN_FL_DET_SD_RANGE_RATE_108 : 397|6@0+ (0.02,0) [0|1.2] "m/s"  IFV
 SG_ CAN_FL_DET_AZIMUTH_108 : 407|13@0+ (0.0007668,-3.141593) [-3.141593|3.141593] "rad"  IFV
 SG_ CAN_FL_DET_SD_AZIMUTH_108 : 410|6@0+ (0.001745329,0) [0|0.104719755] "rad"  IFV
 SG_ CAN_FL_DET_ELEVATION_108 : 420|7@0+ (0.157449,-9.99812) [-9.99812|9.997903] "deg"  IFV
 SG_ CAN_FL_DET_SD_ELEVATION_108 : 429|6@0+ (0.003490659,0) [0|0.20943951] "rad"  IFV
 SG_ CAN_FL_DET_AMPLITUDE_108 : 439|7@0+ (1,-64) [-64|63] "dBsm"  IFV
 SG_ CAN_FL_DET_VALID_FLAG_108 : 432|1@0+ (1,0) [0|1] ""  IFV
 SG_ CAN_FL_DET_SUPER_RES_108 : 440|1@0+ (1,0) [0|1] ""  IFV
 SG_ CAN_FL_DET_LOW_SNR_FLAG_108 : 441|1@0+ (1,0) [0|1] ""  IFV
 SG_ CAN_FL_DET_MIXER_BIAS_FLAG_108 : 442|1@0+ (1,0) [0|1] ""  IFV
 SG_ CAN_FL_DET_RESERVED_FLAGS_108 : 447|5@0+ (1,0) [0|31] ""  IFV
 SG_ CAN_FL_DET_SNR_108 : 455|8@0+ (0.35156,0) [0|89.6478] "dB"  IFV
 SG_ CAN_FL_DET_MULTI_TARGET_PROB_108 : 459|4@0+ (0.06667,0) [0|1] ""  IFV
 SG_ CAN_FL_DET_CONFID_AZIMUTH_108 : 461|2@0+ (1,0) [0|3] ""  IFV
 SG_ CAN_FL_DET_CONFID_ELEVATION_108 : 463|2@0+ (1,0) [0|3] ""  IFV
 SG_ CAN_FL_DET_EXISTENCE_PROB_108 : 467|4@0+ (1,0) [0|15] ""  IFV
 SG_ CAN_FL_DET_CLASS_108 : 471|4@0+ (1,0) [0|15] ""  IFV

BO_ 795 SODFL_DETECTION_109_112: 64 SODFL
 SG_ CAN_FL_DET_RANGE_109 : 7|14@0+ (0.015625,0) [0|255.984375] "m"  IFV
 SG_ CAN_FL_DET_SD_RANGE_109 : 9|6@0+ (0.025,0) [0|1.5] "m"  IFV
 SG_ CAN_FL_DET_RANGE_RATE_109 : 19|14@0+ (0.015625,-128) [-128|127.984375] "m/s"  IFV
 SG_ CAN_FL_DET_SD_RANGE_RATE_109 : 37|6@0+ (0.02,0) [0|1.2] "m/s"  IFV
 SG_ CAN_FL_DET_AZIMUTH_109 : 47|13@0+ (0.0007668,-3.141593) [-3.141593|3.141593] "rad"  IFV
 SG_ CAN_FL_DET_SD_AZIMUTH_109 : 50|6@0+ (0.001745329,0) [0|0.104719755] "rad"  IFV
 SG_ CAN_FL_DET_ELEVATION_109 : 60|7@0+ (0.157449,-9.99812) [-9.99812|9.997903] "deg"  IFV
 SG_ CAN_FL_DET_SD_ELEVATION_109 : 69|6@0+ (0.003490659,0) [0|0.20943951] "rad"  IFV
 SG_ CAN_FL_DET_AMPLITUDE_109 : 79|7@0+ (1,-64) [-64|63] "dBsm"  IFV
 SG_ CAN_FL_DET_VALID_FLAG_109 : 72|1@0+ (1,0) [0|1] ""  IFV
 SG_ CAN_FL_DET_SUPER_RES_109 : 80|1@0+ (1,0) [0|1] ""  IFV
 SG_ CAN_FL_DET_LOW_SNR_FLAG_109 : 81|1@0+ (1,0) [0|1] ""  IFV
 SG_ CAN_FL_DET_MIXER_BIAS_FLAG_109 : 82|1@0+ (1,0) [0|1] ""  IFV
 SG_ CAN_FL_DET_RESERVED_FLAGS_109 : 87|5@0+ (1,0) [0|31] ""  IFV
 SG_ CAN_FL_DET_SNR_109 : 95|8@0+ (0.35156,0) [0|89.6478] "dB"  IFV
 SG_ CAN_FL_DET_MULTI_TARGET_PROB_109 : 99|4@0+ (0.06667,0) [0|1] ""  IFV
 SG_ CAN_FL_DET_CONFID_AZIMUTH_109 : 101|2@0+ (1,0) [0|3] ""  IFV
 SG_ CAN_FL_DET_CONFID_ELEVATION_109 : 103|2@0+ (1,0) [0|3] ""  IFV
 SG_ CAN_FL_DET_EXISTENCE_PROB_109 : 107|4@0+ (1,0) [0|15] ""  IFV
 SG_ CAN_FL_DET_CLASS_109 : 111|4@0+ (1,0) [0|15] ""  IFV
 SG_ CAN_FL_DET_RANGE_110 : 127|14@0+ (0.015625,0) [0|255.984375] "m"  IFV
 SG_ CAN_FL_DET_SD_RANGE_110 : 129|6@0+ (0.025,0) [0|1.5] "m"  IFV
 SG_ CAN_FL_DET_RANGE_RATE_110 : 139|14@0+ (0.015625,-128) [-128|127.984375] "m/s"  IFV
 SG_ CAN_FL_DET_SD_RANGE_RATE_110 : 157|6@0+ (0.02,0) [0|1.2] "m/s"  IFV
 SG_ CAN_FL_DET_AZIMUTH_110 : 167|13@0+ (0.0007668,-3.141593) [-3.141593|3.141593] "rad"  IFV
 SG_ CAN_FL_DET_SD_AZIMUTH_110 : 170|6@0+ (0.001745329,0) [0|0.104719755] "rad"  IFV
 SG_ CAN_FL_DET_ELEVATION_110 : 180|7@0+ (0.157449,-9.99812) [-9.99812|9.997903] "deg"  IFV
 SG_ CAN_FL_DET_SD_ELEVATION_110 : 189|6@0+ (0.003490659,0) [0|0.20943951] "rad"  IFV
 SG_ CAN_FL_DET_AMPLITUDE_110 : 199|7@0+ (1,-64) [-64|63] "dBsm"  IFV
 SG_ CAN_FL_DET_VALID_FLAG_110 : 192|1@0+ (1,0) [0|1] ""  IFV
 SG_ CAN_FL_DET_SUPER_RES_110 : 200|1@0+ (1,0) [0|1] ""  IFV
 SG_ CAN_FL_DET_LOW_SNR_FLAG_110 : 201|1@0+ (1,0) [0|1] ""  IFV
 SG_ CAN_FL_DET_MIXER_BIAS_FLAG_110 : 202|1@0+ (1,0) [0|1] ""  IFV
 SG_ CAN_FL_DET_RESERVED_FLAGS_110 : 207|5@0+ (1,0) [0|31] ""  IFV
 SG_ CAN_FL_DET_SNR_110 : 215|8@0+ (0.35156,0) [0|89.6478] "dB"  IFV
 SG_ CAN_FL_DET_MULTI_TARGET_PROB_110 : 219|4@0+ (0.06667,0) [0|1] ""  IFV
 SG_ CAN_FL_DET_CONFID_AZIMUTH_110 : 221|2@0+ (1,0) [0|3] ""  IFV
 SG_ CAN_FL_DET_CONFID_ELEVATION_110 : 223|2@0+ (1,0) [0|3] ""  IFV
 SG_ CAN_FL_DET_EXISTENCE_PROB_110 : 227|4@0+ (1,0) [0|15] ""  IFV
 SG_ CAN_FL_DET_CLASS_110 : 231|4@0+ (1,0) [0|15] ""  IFV
 SG_ CAN_FL_DET_RANGE_111 : 247|14@0+ (0.015625,0) [0|255.984375] "m"  IFV
 SG_ CAN_FL_DET_SD_RANGE_111 : 249|6@0+ (0.025,0) [0|1.5] "m"  IFV
 SG_ CAN_FL_DET_RANGE_RATE_111 : 259|14@0+ (0.015625,-128) [-128|127.984375] "m/s"  IFV
 SG_ CAN_FL_DET_SD_RANGE_RATE_111 : 277|6@0+ (0.02,0) [0|1.2] "m/s"  IFV
 SG_ CAN_FL_DET_AZIMUTH_111 : 287|13@0+ (0.0007668,-3.141593) [-3.141593|3.141593] "rad"  IFV
 SG_ CAN_FL_DET_SD_AZIMUTH_111 : 290|6@0+ (0.001745329,0) [0|0.104719755] "rad"  IFV
 SG_ CAN_FL_DET_ELEVATION_111 : 300|7@0+ (0.157449,-9.99812) [-9.99812|9.997903] "deg"  IFV
 SG_ CAN_FL_DET_SD_ELEVATION_111 : 309|6@0+ (0.003490659,0) [0|0.20943951] "rad"  IFV
 SG_ CAN_FL_DET_AMPLITUDE_111 : 319|7@0+ (1,-64) [-64|63] "dBsm"  IFV
 SG_ CAN_FL_DET_VALID_FLAG_111 : 312|1@0+ (1,0) [0|1] ""  IFV
 SG_ CAN_FL_DET_SUPER_RES_111 : 320|1@0+ (1,0) [0|1] ""  IFV
 SG_ CAN_FL_DET_LOW_SNR_FLAG_111 : 321|1@0+ (1,0) [0|1] ""  IFV
 SG_ CAN_FL_DET_MIXER_BIAS_FLAG_111 : 322|1@0+ (1,0) [0|1] ""  IFV
 SG_ CAN_FL_DET_RESERVED_FLAGS_111 : 327|5@0+ (1,0) [0|31] ""  IFV
 SG_ CAN_FL_DET_SNR_111 : 335|8@0+ (0.35156,0) [0|89.6478] "dB"  IFV
 SG_ CAN_FL_DET_MULTI_TARGET_PROB_111 : 339|4@0+ (0.06667,0) [0|1] ""  IFV
 SG_ CAN_FL_DET_CONFID_AZIMUTH_111 : 341|2@0+ (1,0) [0|3] ""  IFV
 SG_ CAN_FL_DET_CONFID_ELEVATION_111 : 343|2@0+ (1,0) [0|3] ""  IFV
 SG_ CAN_FL_DET_EXISTENCE_PROB_111 : 347|4@0+ (1,0) [0|15] ""  IFV
 SG_ CAN_FL_DET_CLASS_111 : 351|4@0+ (1,0) [0|15] ""  IFV
 SG_ CAN_FL_DET_RANGE_112 : 367|14@0+ (0.015625,0) [0|255.984375] "m"  IFV
 SG_ CAN_FL_DET_SD_RANGE_112 : 369|6@0+ (0.025,0) [0|1.5] "m"  IFV
 SG_ CAN_FL_DET_RANGE_RATE_112 : 379|14@0+ (0.015625,-128) [-128|127.984375] "m/s"  IFV
 SG_ CAN_FL_DET_SD_RANGE_RATE_112 : 397|6@0+ (0.02,0) [0|1.2] "m/s"  IFV
 SG_ CAN_FL_DET_AZIMUTH_112 : 407|13@0+ (0.0007668,-3.141593) [-3.141593|3.141593] "rad"  IFV
 SG_ CAN_FL_DET_SD_AZIMUTH_112 : 410|6@0+ (0.001745329,0) [0|0.104719755] "rad"  IFV
 SG_ CAN_FL_DET_ELEVATION_112 : 420|7@0+ (0.157449,-9.99812) [-9.99812|9.997903] "deg"  IFV
 SG_ CAN_FL_DET_SD_ELEVATION_112 : 429|6@0+ (0.003490659,0) [0|0.20943951] "rad"  IFV
 SG_ CAN_FL_DET_AMPLITUDE_112 : 439|7@0+ (1,-64) [-64|63] "dBsm"  IFV
 SG_ CAN_FL_DET_VALID_FLAG_112 : 432|1@0+ (1,0) [0|1] ""  IFV
 SG_ CAN_FL_DET_SUPER_RES_112 : 440|1@0+ (1,0) [0|1] ""  IFV
 SG_ CAN_FL_DET_LOW_SNR_FLAG_112 : 441|1@0+ (1,0) [0|1] ""  IFV
 SG_ CAN_FL_DET_MIXER_BIAS_FLAG_112 : 442|1@0+ (1,0) [0|1] ""  IFV
 SG_ CAN_FL_DET_RESERVED_FLAGS_112 : 447|5@0+ (1,0) [0|31] ""  IFV
 SG_ CAN_FL_DET_SNR_112 : 455|8@0+ (0.35156,0) [0|89.6478] "dB"  IFV
 SG_ CAN_FL_DET_MULTI_TARGET_PROB_112 : 459|4@0+ (0.06667,0) [0|1] ""  IFV
 SG_ CAN_FL_DET_CONFID_AZIMUTH_112 : 461|2@0+ (1,0) [0|3] ""  IFV
 SG_ CAN_FL_DET_CONFID_ELEVATION_112 : 463|2@0+ (1,0) [0|3] ""  IFV
 SG_ CAN_FL_DET_EXISTENCE_PROB_112 : 467|4@0+ (1,0) [0|15] ""  IFV
 SG_ CAN_FL_DET_CLASS_112 : 471|4@0+ (1,0) [0|15] ""  IFV

BO_ 796 SODFL_DETECTION_113_116: 64 SODFL
 SG_ CAN_FL_DET_RANGE_113 : 7|14@0+ (0.015625,0) [0|255.984375] "m"  IFV
 SG_ CAN_FL_DET_SD_RANGE_113 : 9|6@0+ (0.025,0) [0|1.5] "m"  IFV
 SG_ CAN_FL_DET_RANGE_RATE_113 : 19|14@0+ (0.015625,-128) [-128|127.984375] "m/s"  IFV
 SG_ CAN_FL_DET_SD_RANGE_RATE_113 : 37|6@0+ (0.02,0) [0|1.2] "m/s"  IFV
 SG_ CAN_FL_DET_AZIMUTH_113 : 47|13@0+ (0.0007668,-3.141593) [-3.141593|3.141593] "rad"  IFV
 SG_ CAN_FL_DET_SD_AZIMUTH_113 : 50|6@0+ (0.001745329,0) [0|0.104719755] "rad"  IFV
 SG_ CAN_FL_DET_ELEVATION_113 : 60|7@0+ (0.157449,-9.99812) [-9.99812|9.997903] "deg"  IFV
 SG_ CAN_FL_DET_SD_ELEVATION_113 : 69|6@0+ (0.003490659,0) [0|0.20943951] "rad"  IFV
 SG_ CAN_FL_DET_AMPLITUDE_113 : 79|7@0+ (1,-64) [-64|63] "dBsm"  IFV
 SG_ CAN_FL_DET_VALID_FLAG_113 : 72|1@0+ (1,0) [0|1] ""  IFV
 SG_ CAN_FL_DET_SUPER_RES_113 : 80|1@0+ (1,0) [0|1] ""  IFV
 SG_ CAN_FL_DET_LOW_SNR_FLAG_113 : 81|1@0+ (1,0) [0|1] ""  IFV
 SG_ CAN_FL_DET_MIXER_BIAS_FLAG_113 : 82|1@0+ (1,0) [0|1] ""  IFV
 SG_ CAN_FL_DET_RESERVED_FLAGS_113 : 87|5@0+ (1,0) [0|31] ""  IFV
 SG_ CAN_FL_DET_SNR_113 : 95|8@0+ (0.35156,0) [0|89.6478] "dB"  IFV
 SG_ CAN_FL_DET_MULTI_TARGET_PROB_113 : 99|4@0+ (0.06667,0) [0|1] ""  IFV
 SG_ CAN_FL_DET_CONFID_AZIMUTH_113 : 101|2@0+ (1,0) [0|3] ""  IFV
 SG_ CAN_FL_DET_CONFID_ELEVATION_113 : 103|2@0+ (1,0) [0|3] ""  IFV
 SG_ CAN_FL_DET_EXISTENCE_PROB_113 : 107|4@0+ (1,0) [0|15] ""  IFV
 SG_ CAN_FL_DET_CLASS_113 : 111|4@0+ (1,0) [0|15] ""  IFV
 SG_ CAN_FL_DET_RANGE_114 : 127|14@0+ (0.015625,0) [0|255.984375] "m"  IFV
 SG_ CAN_FL_DET_SD_RANGE_114 : 129|6@0+ (0.025,0) [0|1.5] "m"  IFV
 SG_ CAN_FL_DET_RANGE_RATE_114 : 139|14@0+ (0.015625,-128) [-128|127.984375] "m/s"  IFV
 SG_ CAN_FL_DET_SD_RANGE_RATE_114 : 157|6@0+ (0.02,0) [0|1.2] "m/s"  IFV
 SG_ CAN_FL_DET_AZIMUTH_114 : 167|13@0+ (0.0007668,-3.141593) [-3.141593|3.141593] "rad"  IFV
 SG_ CAN_FL_DET_SD_AZIMUTH_114 : 170|6@0+ (0.001745329,0) [0|0.104719755] "rad"  IFV
 SG_ CAN_FL_DET_ELEVATION_114 : 180|7@0+ (0.157449,-9.99812) [-9.99812|9.997903] "deg"  IFV
 SG_ CAN_FL_DET_SD_ELEVATION_114 : 189|6@0+ (0.003490659,0) [0|0.20943951] "rad"  IFV
 SG_ CAN_FL_DET_AMPLITUDE_114 : 199|7@0+ (1,-64) [-64|63] "dBsm"  IFV
 SG_ CAN_FL_DET_VALID_FLAG_114 : 192|1@0+ (1,0) [0|1] ""  IFV
 SG_ CAN_FL_DET_SUPER_RES_114 : 200|1@0+ (1,0) [0|1] ""  IFV
 SG_ CAN_FL_DET_LOW_SNR_FLAG_114 : 201|1@0+ (1,0) [0|1] ""  IFV
 SG_ CAN_FL_DET_MIXER_BIAS_FLAG_114 : 202|1@0+ (1,0) [0|1] ""  IFV
 SG_ CAN_FL_DET_RESERVED_FLAGS_114 : 207|5@0+ (1,0) [0|31] ""  IFV
 SG_ CAN_FL_DET_SNR_114 : 215|8@0+ (0.35156,0) [0|89.6478] "dB"  IFV
 SG_ CAN_FL_DET_MULTI_TARGET_PROB_114 : 219|4@0+ (0.06667,0) [0|1] ""  IFV
 SG_ CAN_FL_DET_CONFID_AZIMUTH_114 : 221|2@0+ (1,0) [0|3] ""  IFV
 SG_ CAN_FL_DET_CONFID_ELEVATION_114 : 223|2@0+ (1,0) [0|3] ""  IFV
 SG_ CAN_FL_DET_EXISTENCE_PROB_114 : 227|4@0+ (1,0) [0|15] ""  IFV
 SG_ CAN_FL_DET_CLASS_114 : 231|4@0+ (1,0) [0|15] ""  IFV
 SG_ CAN_FL_DET_RANGE_115 : 247|14@0+ (0.015625,0) [0|255.984375] "m"  IFV
 SG_ CAN_FL_DET_SD_RANGE_115 : 249|6@0+ (0.025,0) [0|1.5] "m"  IFV
 SG_ CAN_FL_DET_RANGE_RATE_115 : 259|14@0+ (0.015625,-128) [-128|127.984375] "m/s"  IFV
 SG_ CAN_FL_DET_SD_RANGE_RATE_115 : 277|6@0+ (0.02,0) [0|1.2] "m/s"  IFV
 SG_ CAN_FL_DET_AZIMUTH_115 : 287|13@0+ (0.0007668,-3.141593) [-3.141593|3.141593] "rad"  IFV
 SG_ CAN_FL_DET_SD_AZIMUTH_115 : 290|6@0+ (0.001745329,0) [0|0.104719755] "rad"  IFV
 SG_ CAN_FL_DET_ELEVATION_115 : 300|7@0+ (0.157449,-9.99812) [-9.99812|9.997903] "deg"  IFV
 SG_ CAN_FL_DET_SD_ELEVATION_115 : 309|6@0+ (0.003490659,0) [0|0.20943951] "rad"  IFV
 SG_ CAN_FL_DET_AMPLITUDE_115 : 319|7@0+ (1,-64) [-64|63] "dBsm"  IFV
 SG_ CAN_FL_DET_VALID_FLAG_115 : 312|1@0+ (1,0) [0|1] ""  IFV
 SG_ CAN_FL_DET_SUPER_RES_115 : 320|1@0+ (1,0) [0|1] ""  IFV
 SG_ CAN_FL_DET_LOW_SNR_FLAG_115 : 321|1@0+ (1,0) [0|1] ""  IFV
 SG_ CAN_FL_DET_MIXER_BIAS_FLAG_115 : 322|1@0+ (1,0) [0|1] ""  IFV
 SG_ CAN_FL_DET_RESERVED_FLAGS_115 : 327|5@0+ (1,0) [0|31] ""  IFV
 SG_ CAN_FL_DET_SNR_115 : 335|8@0+ (0.35156,0) [0|89.6478] "dB"  IFV
 SG_ CAN_FL_DET_MULTI_TARGET_PROB_115 : 339|4@0+ (0.06667,0) [0|1] ""  IFV
 SG_ CAN_FL_DET_CONFID_AZIMUTH_115 : 341|2@0+ (1,0) [0|3] ""  IFV
 SG_ CAN_FL_DET_CONFID_ELEVATION_115 : 343|2@0+ (1,0) [0|3] ""  IFV
 SG_ CAN_FL_DET_EXISTENCE_PROB_115 : 347|4@0+ (1,0) [0|15] ""  IFV
 SG_ CAN_FL_DET_CLASS_115 : 351|4@0+ (1,0) [0|15] ""  IFV
 SG_ CAN_FL_DET_RANGE_116 : 367|14@0+ (0.015625,0) [0|255.984375] "m"  IFV
 SG_ CAN_FL_DET_SD_RANGE_116 : 369|6@0+ (0.025,0) [0|1.5] "m"  IFV
 SG_ CAN_FL_DET_RANGE_RATE_116 : 379|14@0+ (0.015625,-128) [-128|127.984375] "m/s"  IFV
 SG_ CAN_FL_DET_SD_RANGE_RATE_116 : 397|6@0+ (0.02,0) [0|1.2] "m/s"  IFV
 SG_ CAN_FL_DET_AZIMUTH_116 : 407|13@0+ (0.0007668,-3.141593) [-3.141593|3.141593] "rad"  IFV
 SG_ CAN_FL_DET_SD_AZIMUTH_116 : 410|6@0+ (0.001745329,0) [0|0.104719755] "rad"  IFV
 SG_ CAN_FL_DET_ELEVATION_116 : 420|7@0+ (0.157449,-9.99812) [-9.99812|9.997903] "deg"  IFV
 SG_ CAN_FL_DET_SD_ELEVATION_116 : 429|6@0+ (0.003490659,0) [0|0.20943951] "rad"  IFV
 SG_ CAN_FL_DET_AMPLITUDE_116 : 439|7@0+ (1,-64) [-64|63] "dBsm"  IFV
 SG_ CAN_FL_DET_VALID_FLAG_116 : 432|1@0+ (1,0) [0|1] ""  IFV
 SG_ CAN_FL_DET_SUPER_RES_116 : 440|1@0+ (1,0) [0|1] ""  IFV
 SG_ CAN_FL_DET_LOW_SNR_FLAG_116 : 441|1@0+ (1,0) [0|1] ""  IFV
 SG_ CAN_FL_DET_MIXER_BIAS_FLAG_116 : 442|1@0+ (1,0) [0|1] ""  IFV
 SG_ CAN_FL_DET_RESERVED_FLAGS_116 : 447|5@0+ (1,0) [0|31] ""  IFV
 SG_ CAN_FL_DET_SNR_116 : 455|8@0+ (0.35156,0) [0|89.6478] "dB"  IFV
 SG_ CAN_FL_DET_MULTI_TARGET_PROB_116 : 459|4@0+ (0.06667,0) [0|1] ""  IFV
 SG_ CAN_FL_DET_CONFID_AZIMUTH_116 : 461|2@0+ (1,0) [0|3] ""  IFV
 SG_ CAN_FL_DET_CONFID_ELEVATION_116 : 463|2@0+ (1,0) [0|3] ""  IFV
 SG_ CAN_FL_DET_EXISTENCE_PROB_116 : 467|4@0+ (1,0) [0|15] ""  IFV
 SG_ CAN_FL_DET_CLASS_116 : 471|4@0+ (1,0) [0|15] ""  IFV

BO_ 797 SODFL_DETECTION_117_120: 64 SODFL
 SG_ CAN_FL_DET_RANGE_117 : 7|14@0+ (0.015625,0) [0|255.984375] "m"  IFV
 SG_ CAN_FL_DET_SD_RANGE_117 : 9|6@0+ (0.025,0) [0|1.5] "m"  IFV
 SG_ CAN_FL_DET_RANGE_RATE_117 : 19|14@0+ (0.015625,-128) [-128|127.984375] "m/s"  IFV
 SG_ CAN_FL_DET_SD_RANGE_RATE_117 : 37|6@0+ (0.02,0) [0|1.2] "m/s"  IFV
 SG_ CAN_FL_DET_AZIMUTH_117 : 47|13@0+ (0.0007668,-3.141593) [-3.141593|3.141593] "rad"  IFV
 SG_ CAN_FL_DET_SD_AZIMUTH_117 : 50|6@0+ (0.001745329,0) [0|0.104719755] "rad"  IFV
 SG_ CAN_FL_DET_ELEVATION_117 : 60|7@0+ (0.157449,-9.99812) [-9.99812|9.997903] "deg"  IFV
 SG_ CAN_FL_DET_SD_ELEVATION_117 : 69|6@0+ (0.003490659,0) [0|0.20943951] "rad"  IFV
 SG_ CAN_FL_DET_AMPLITUDE_117 : 79|7@0+ (1,-64) [-64|63] "dBsm"  IFV
 SG_ CAN_FL_DET_VALID_FLAG_117 : 72|1@0+ (1,0) [0|1] ""  IFV
 SG_ CAN_FL_DET_SUPER_RES_117 : 80|1@0+ (1,0) [0|1] ""  IFV
 SG_ CAN_FL_DET_LOW_SNR_FLAG_117 : 81|1@0+ (1,0) [0|1] ""  IFV
 SG_ CAN_FL_DET_MIXER_BIAS_FLAG_117 : 82|1@0+ (1,0) [0|1] ""  IFV
 SG_ CAN_FL_DET_RESERVED_FLAGS_117 : 87|5@0+ (1,0) [0|31] ""  IFV
 SG_ CAN_FL_DET_SNR_117 : 95|8@0+ (0.35156,0) [0|89.6478] "dB"  IFV
 SG_ CAN_FL_DET_MULTI_TARGET_PROB_117 : 99|4@0+ (0.06667,0) [0|1] ""  IFV
 SG_ CAN_FL_DET_CONFID_AZIMUTH_117 : 101|2@0+ (1,0) [0|3] ""  IFV
 SG_ CAN_FL_DET_CONFID_ELEVATION_117 : 103|2@0+ (1,0) [0|3] ""  IFV
 SG_ CAN_FL_DET_EXISTENCE_PROB_117 : 107|4@0+ (1,0) [0|15] ""  IFV
 SG_ CAN_FL_DET_CLASS_117 : 111|4@0+ (1,0) [0|15] ""  IFV
 SG_ CAN_FL_DET_RANGE_118 : 127|14@0+ (0.015625,0) [0|255.984375] "m"  IFV
 SG_ CAN_FL_DET_SD_RANGE_118 : 129|6@0+ (0.025,0) [0|1.5] "m"  IFV
 SG_ CAN_FL_DET_RANGE_RATE_118 : 139|14@0+ (0.015625,-128) [-128|127.984375] "m/s"  IFV
 SG_ CAN_FL_DET_SD_RANGE_RATE_118 : 157|6@0+ (0.02,0) [0|1.2] "m/s"  IFV
 SG_ CAN_FL_DET_AZIMUTH_118 : 167|13@0+ (0.0007668,-3.141593) [-3.141593|3.141593] "rad"  IFV
 SG_ CAN_FL_DET_SD_AZIMUTH_118 : 170|6@0+ (0.001745329,0) [0|0.104719755] "rad"  IFV
 SG_ CAN_FL_DET_ELEVATION_118 : 180|7@0+ (0.157449,-9.99812) [-9.99812|9.997903] "deg"  IFV
 SG_ CAN_FL_DET_SD_ELEVATION_118 : 189|6@0+ (0.003490659,0) [0|0.20943951] "rad"  IFV
 SG_ CAN_FL_DET_AMPLITUDE_118 : 199|7@0+ (1,-64) [-64|63] "dBsm"  IFV
 SG_ CAN_FL_DET_VALID_FLAG_118 : 192|1@0+ (1,0) [0|1] ""  IFV
 SG_ CAN_FL_DET_SUPER_RES_118 : 200|1@0+ (1,0) [0|1] ""  IFV
 SG_ CAN_FL_DET_LOW_SNR_FLAG_118 : 201|1@0+ (1,0) [0|1] ""  IFV
 SG_ CAN_FL_DET_MIXER_BIAS_FLAG_118 : 202|1@0+ (1,0) [0|1] ""  IFV
 SG_ CAN_FL_DET_RESERVED_FLAGS_118 : 207|5@0+ (1,0) [0|31] ""  IFV
 SG_ CAN_FL_DET_SNR_118 : 215|8@0+ (0.35156,0) [0|89.6478] "dB"  IFV
 SG_ CAN_FL_DET_MULTI_TARGET_PROB_118 : 219|4@0+ (0.06667,0) [0|1] ""  IFV
 SG_ CAN_FL_DET_CONFID_AZIMUTH_118 : 221|2@0+ (1,0) [0|3] ""  IFV
 SG_ CAN_FL_DET_CONFID_ELEVATION_118 : 223|2@0+ (1,0) [0|3] ""  IFV
 SG_ CAN_FL_DET_EXISTENCE_PROB_118 : 227|4@0+ (1,0) [0|15] ""  IFV
 SG_ CAN_FL_DET_CLASS_118 : 231|4@0+ (1,0) [0|15] ""  IFV
 SG_ CAN_FL_DET_RANGE_119 : 247|14@0+ (0.015625,0) [0|255.984375] "m"  IFV
 SG_ CAN_FL_DET_SD_RANGE_119 : 249|6@0+ (0.025,0) [0|1.5] "m"  IFV
 SG_ CAN_FL_DET_RANGE_RATE_119 : 259|14@0+ (0.015625,-128) [-128|127.984375] "m/s"  IFV
 SG_ CAN_FL_DET_SD_RANGE_RATE_119 : 277|6@0+ (0.02,0) [0|1.2] "m/s"  IFV
 SG_ CAN_FL_DET_AZIMUTH_119 : 287|13@0+ (0.0007668,-3.141593) [-3.141593|3.141593] "rad"  IFV
 SG_ CAN_FL_DET_SD_AZIMUTH_119 : 290|6@0+ (0.001745329,0) [0|0.104719755] "rad"  IFV
 SG_ CAN_FL_DET_ELEVATION_119 : 300|7@0+ (0.157449,-9.99812) [-9.99812|9.997903] "deg"  IFV
 SG_ CAN_FL_DET_SD_ELEVATION_119 : 309|6@0+ (0.003490659,0) [0|0.20943951] "rad"  IFV
 SG_ CAN_FL_DET_AMPLITUDE_119 : 319|7@0+ (1,-64) [-64|63] "dBsm"  IFV
 SG_ CAN_FL_DET_VALID_FLAG_119 : 312|1@0+ (1,0) [0|1] ""  IFV
 SG_ CAN_FL_DET_SUPER_RES_119 : 320|1@0+ (1,0) [0|1] ""  IFV
 SG_ CAN_FL_DET_LOW_SNR_FLAG_119 : 321|1@0+ (1,0) [0|1] ""  IFV
 SG_ CAN_FL_DET_MIXER_BIAS_FLAG_119 : 322|1@0+ (1,0) [0|1] ""  IFV
 SG_ CAN_FL_DET_RESERVED_FLAGS_119 : 327|5@0+ (1,0) [0|31] ""  IFV
 SG_ CAN_FL_DET_SNR_119 : 335|8@0+ (0.35156,0) [0|89.6478] "dB"  IFV
 SG_ CAN_FL_DET_MULTI_TARGET_PROB_119 : 339|4@0+ (0.06667,0) [0|1] ""  IFV
 SG_ CAN_FL_DET_CONFID_AZIMUTH_119 : 341|2@0+ (1,0) [0|3] ""  IFV
 SG_ CAN_FL_DET_CONFID_ELEVATION_119 : 343|2@0+ (1,0) [0|3] ""  IFV
 SG_ CAN_FL_DET_EXISTENCE_PROB_119 : 347|4@0+ (1,0) [0|15] ""  IFV
 SG_ CAN_FL_DET_CLASS_119 : 351|4@0+ (1,0) [0|15] ""  IFV
 SG_ CAN_FL_DET_RANGE_120 : 367|14@0+ (0.015625,0) [0|255.984375] "m"  IFV
 SG_ CAN_FL_DET_SD_RANGE_120 : 369|6@0+ (0.025,0) [0|1.5] "m"  IFV
 SG_ CAN_FL_DET_RANGE_RATE_120 : 379|14@0+ (0.015625,-128) [-128|127.984375] "m/s"  IFV
 SG_ CAN_FL_DET_SD_RANGE_RATE_120 : 397|6@0+ (0.02,0) [0|1.2] "m/s"  IFV
 SG_ CAN_FL_DET_AZIMUTH_120 : 407|13@0+ (0.0007668,-3.141593) [-3.141593|3.141593] "rad"  IFV
 SG_ CAN_FL_DET_SD_AZIMUTH_120 : 410|6@0+ (0.001745329,0) [0|0.104719755] "rad"  IFV
 SG_ CAN_FL_DET_ELEVATION_120 : 420|7@0+ (0.157449,-9.99812) [-9.99812|9.997903] "deg"  IFV
 SG_ CAN_FL_DET_SD_ELEVATION_120 : 429|6@0+ (0.003490659,0) [0|0.20943951] "rad"  IFV
 SG_ CAN_FL_DET_AMPLITUDE_120 : 439|7@0+ (1,-64) [-64|63] "dBsm"  IFV
 SG_ CAN_FL_DET_VALID_FLAG_120 : 432|1@0+ (1,0) [0|1] ""  IFV
 SG_ CAN_FL_DET_SUPER_RES_120 : 440|1@0+ (1,0) [0|1] ""  IFV
 SG_ CAN_FL_DET_LOW_SNR_FLAG_120 : 441|1@0+ (1,0) [0|1] ""  IFV
 SG_ CAN_FL_DET_MIXER_BIAS_FLAG_120 : 442|1@0+ (1,0) [0|1] ""  IFV
 SG_ CAN_FL_DET_RESERVED_FLAGS_120 : 447|5@0+ (1,0) [0|31] ""  IFV
 SG_ CAN_FL_DET_SNR_120 : 455|8@0+ (0.35156,0) [0|89.6478] "dB"  IFV
 SG_ CAN_FL_DET_MULTI_TARGET_PROB_120 : 459|4@0+ (0.06667,0) [0|1] ""  IFV
 SG_ CAN_FL_DET_CONFID_AZIMUTH_120 : 461|2@0+ (1,0) [0|3] ""  IFV
 SG_ CAN_FL_DET_CONFID_ELEVATION_120 : 463|2@0+ (1,0) [0|3] ""  IFV
 SG_ CAN_FL_DET_EXISTENCE_PROB_120 : 467|4@0+ (1,0) [0|15] ""  IFV
 SG_ CAN_FL_DET_CLASS_120 : 471|4@0+ (1,0) [0|15] ""  IFV

CM_ "CAN bus that communicates the Short Range Front Radars";
BA_DEF_ BU_  "NodeLayerModules" STRING ;
BA_DEF_ BO_  "VFrameFormat" ENUM  "StandardCAN","ExtendedCAN","reserved","reserved","reserved","reserved","reserved","reserved","reserved","reserved","reserved","reserved","reserved","reserved","StandardCAN_FD","ExtendedCAN_FD";
BA_DEF_ BO_  "CanTpBs" INT 0 255;
BA_DEF_ BO_  "EventRateOfChange" INT 10 10000;
BA_DEF_ BU_  "NmAsrNodeIdentifier" HEX 128 255;
BA_DEF_ BU_  "TpOwnSystemEcuNumber" HEX 0 255;
BA_DEF_  "NmType" STRING ;
BA_DEF_  "NetworkSpeed" ENUM  "500kBits/s","125kBit/s","2MBits/s";
BA_DEF_  "NmAsrMessageCount" INT 64 128;
BA_DEF_  "NmAsrBaseAddress" HEX 1408 1408;
BA_DEF_  "VersionDay" INT 1 31;
BA_DEF_  "Manufacturer" STRING ;
BA_DEF_  "VersionMonth" INT 1 12;
BA_DEF_  "VersionYear" INT 2000 3000;
BA_DEF_  "NmBaseAddress" HEX 1280 1280;
BA_DEF_  "NmMessageCount" INT 0 128;
BA_DEF_ SG_  "GenSigTimeoutTime_SRR01RR" INT 0 0;
BA_DEF_ SG_  "GenSigCycleTime" INT 0 0;
BA_DEF_ SG_  "GenSigVtName" STRING ;
BA_DEF_ SG_  "GenSigVtEn" STRING ;
BA_DEF_  "GenNetworkMuxEn" STRING ;
BA_DEF_  "GenNetworkBaudrate" STRING ;
BA_DEF_  "GenNetworkName" STRING ;
BA_DEF_ SG_  "GenSigCmt" STRING ;
BA_DEF_  "GenRevisionDate" STRING ;
BA_DEF_  "GenRevision" STRING ;
BA_DEF_  "GenDescription" STRING ;
BA_DEF_  "GenCompany" STRING ;
BA_DEF_  "GenAuthor" STRING ;
BA_DEF_ BU_  "NmStationAddress" HEX 0 0;
BA_DEF_ SG_  "GenSigSendType" ENUM  "Cyclic","OnWrite","vector_leerstring","OnChange","vector_leerstring","IfActive","vector_leerstring","NoSigSendType";
BA_DEF_ SG_  "GenSigStartValue" INT 0 1000000000;
BA_DEF_ BO_  "GenMsgILSupport" ENUM  "No","Yes";
BA_DEF_ BO_  "GenMsgSendType" ENUM  "FixedPeriodic","Event","EnabledPeriodic","NotUsed","NotUsed","EventPeriodic","NotUsed","NotUsed","NoMsgSendType";
BA_DEF_ BO_  "GenMsgCycleTime" INT 0 100000;
BA_DEF_ BO_  "GenMsgNrOfRepetition" INT 0 100;
BA_DEF_ BO_  "NetworkInitialization" ENUM  "No","Yes";
BA_DEF_ BU_  "PowerType" ENUM  "Switched","Latched","Sleep","vector_leerstring","vector_leerstring";
BA_DEF_ BU_  "NodeStartUpTime" INT 0 10000;
BA_DEF_ BU_  "NodeWakeUpTime" INT 0 10000;
BA_DEF_  "DBName" STRING ;
BA_DEF_  "BusType" STRING ;
BA_DEF_DEF_  "NodeLayerModules" "CANoeILNLFord.dll";
BA_DEF_DEF_  "VFrameFormat" "StandardCAN_FD";
BA_DEF_DEF_  "CanTpBs" 255;
BA_DEF_DEF_  "EventRateOfChange" 10000;
BA_DEF_DEF_  "NmAsrNodeIdentifier" 128;
BA_DEF_DEF_  "TpOwnSystemEcuNumber" 0;
BA_DEF_DEF_  "NmType" "NmAsr";
BA_DEF_DEF_  "NetworkSpeed" "2MBits/s";
BA_DEF_DEF_  "NmAsrMessageCount" 64;
BA_DEF_DEF_  "NmAsrBaseAddress" 1408;
BA_DEF_DEF_  "VersionDay" 25;
BA_DEF_DEF_  "Manufacturer" "Ford";
BA_DEF_DEF_  "VersionMonth" 1;
BA_DEF_DEF_  "VersionYear" 2018;
BA_DEF_DEF_  "NmBaseAddress" 1280;
BA_DEF_DEF_  "NmMessageCount" 128;
BA_DEF_DEF_  "GenSigTimeoutTime_SRR01RR" 0;
BA_DEF_DEF_  "GenSigCycleTime" 0;
BA_DEF_DEF_  "GenSigVtName" "";
BA_DEF_DEF_  "GenSigVtEn" "";
BA_DEF_DEF_  "GenNetworkMuxEn" "FALSE";
BA_DEF_DEF_  "GenNetworkBaudrate" "500 kbps";
BA_DEF_DEF_  "GenNetworkName" "PCAN";
BA_DEF_DEF_  "GenSigCmt" "";
BA_DEF_DEF_  "GenRevisionDate" "Jan 25, 2018";
BA_DEF_DEF_  "GenRevision" "v1.00";
BA_DEF_DEF_  "GenDescription" "CAN bus that communicates the radars";
BA_DEF_DEF_  "GenCompany" "Delphi";
BA_DEF_DEF_  "GenAuthor" "xx";
BA_DEF_DEF_  "NmStationAddress" 0;
BA_DEF_DEF_  "GenSigSendType" "NoSigSendType";
BA_DEF_DEF_  "GenSigStartValue" 0;
BA_DEF_DEF_  "GenMsgILSupport" "Yes";
BA_DEF_DEF_  "GenMsgSendType" "NoMsgSendType";
BA_DEF_DEF_  "GenMsgCycleTime" 0;
BA_DEF_DEF_  "GenMsgNrOfRepetition" 0;
BA_DEF_DEF_  "NetworkInitialization" "Yes";
BA_DEF_DEF_  "PowerType" "Switched";
BA_DEF_DEF_  "NodeStartUpTime" 250;
BA_DEF_DEF_  "NodeWakeUpTime" 10;
BA_DEF_DEF_  "DBName" "";
BA_DEF_DEF_  "BusType" "CAN";
BA_ "GenCompany" "private";
BA_ "GenDescription" "private";
BA_ "VersionMonth" 8;
BA_ "BusType" "CAN FD";
BA_ "GenNetworkBaudrate" "500000";
BA_ "Manufacturer" "MRR360";
BA_ "GenRevisionDate" "Dec 13, 2019";
BA_ "GenRevision" "V01.00";
BA_ "GenAuthor" "private";
BA_ "VersionDay" 6;
BA_ "DBName" "PCAN_SRR5_FRONT";
BA_ "GenMsgCycleTime" BO_ 768 50;
BA_ "GenMsgCycleTime" BO_ 769 50;
BA_ "GenMsgCycleTime" BO_ 770 50;
BA_ "GenMsgCycleTime" BO_ 771 50;
BA_ "GenMsgCycleTime" BO_ 772 50;
BA_ "GenMsgCycleTime" BO_ 773 50;
BA_ "GenMsgCycleTime" BO_ 774 50;
BA_ "GenMsgCycleTime" BO_ 775 50;
BA_ "GenMsgCycleTime" BO_ 776 50;
BA_ "GenMsgCycleTime" BO_ 777 50;
BA_ "GenMsgCycleTime" BO_ 778 50;
BA_ "GenMsgCycleTime" BO_ 779 50;
BA_ "GenMsgCycleTime" BO_ 780 50;
BA_ "GenMsgCycleTime" BO_ 781 50;
BA_ "GenMsgCycleTime" BO_ 782 50;
BA_ "GenMsgCycleTime" BO_ 783 50;
BA_ "GenMsgCycleTime" BO_ 784 50;
BA_ "GenMsgCycleTime" BO_ 785 50;
BA_ "GenMsgCycleTime" BO_ 786 50;
BA_ "GenMsgCycleTime" BO_ 787 50;
BA_ "GenMsgCycleTime" BO_ 788 50;
BA_ "GenMsgCycleTime" BO_ 789 50;
BA_ "GenMsgCycleTime" BO_ 790 50;
BA_ "GenMsgCycleTime" BO_ 791 50;
BA_ "GenMsgCycleTime" BO_ 792 50;
BA_ "GenMsgCycleTime" BO_ 793 50;
BA_ "GenMsgCycleTime" BO_ 794 50;
BA_ "GenMsgCycleTime" BO_ 795 50;
BA_ "GenMsgCycleTime" BO_ 796 50;
BA_ "GenMsgCycleTime" BO_ 797 50;
BA_ "GenSigStartValue" SG_ 768 CAN_FL_DET_AZIMUTH_001 4226.39995007757;
BA_ "GenSigStartValue" SG_ 768 CAN_FL_DET_ELEVATION_001 63.8646288209607;
