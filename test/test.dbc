VERSION "created by canmatrix"

NS_ :

BS_:

BU_: testBU recBU

BO_ 291 testFrame1: 8 testBU
 SG_ someTestSignal : 3|11@0+ (5.0,1.0) [0|500] "specialCharUnit°$" recBU
 SG_ Signal : 20|3@1+ (1.0,0.0) [0|6] "someUnit" recBU

BO_ 2147483666 extendedFrame: 8 testBU

BO_ 291 newFrameMotorola: 8 Vector__XXX
 SG_ signal2 : 39|32@0- (1,0) [0|0] "" Vector__XXX
 SG_ signal1 : 7|32@0- (1,0) [0|0] "" Vector__XXX

CM_ BO_ 291  "Multi 
 Line 
 Frame comment";

CM_ SG_ 291 someTestSignal "Multi 
 Line 
 Signal comment with a-umlaut: ä";

CM_ BU_ testBU "sender ECU";
CM_ BU_ recBU "reciever ECU";

BA_DEF_ BO_ "GenMsgCycleTime" INT 0 65535;
BA_DEF_ BU_ "NetworkNode" INT 0 65535;
BA_ "NetworkNode" BU_ testBU 273;

BA_ "GenMsgCycleTime" BO_ 291 100;

VAL_ 291 Signal 1 "one" 2 "two" 3 "three";
