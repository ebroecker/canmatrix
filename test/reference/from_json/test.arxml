AUTOSAR XML (schema 323)
package /Cluster
  can cluster CAN
    physical channel CAN
      frame FRAME_testFrame1: id 0x123, frame-length=8, can-addressing-mode=STANDARD
        pdu PDU_testFrame1: length=64
          signal someTestSignal: start 3, 11 bit, big-endian, data-type=someTestSignal
          signal Signal: start 20, 3 bit, little-endian, data-type=Signal
      frame FRAME_extendedFrame: id 0x12, frame-length=8, can-addressing-mode=EXTENDED
        pdu PDU_extendedFrame: length=64
package /DataType
  integer type someTestSignal: compu {phys=raw*5+1}
  integer type Signal: compu {phys=raw}
package /DataType/Unit
  unit someTestSignal: display-name=specialCharUnit°$
  unit Signal: display-name=someUnit
