AUTOSAR XML
package /Cluster
  can cluster CAN: speed=50000
    physical channels CAN
      physical-channel:
        frame testFrame1: id 0x123, from ECU, to ECU, frame-length=8, can-addressing-mode=STANDARD
          pdu testFrame1: length=64
            signal someTestSignal: start 9, 11 bit, big-endian, data-type=someTestSignal
            signal Signal: start 20, 3 bit, little-endian, data-type=Signal
        frame extendedFrame: id 0x12, from ECU, frame-length=8, can-addressing-mode=EXTENDED
          pdu extendedFrame: length=64
package /DataType
  integer type someTestSignal: compu {phys=raw*5+1}
  integer type Signal: compu {1=one, 2=two, 3=three, phys=raw}
package /ECU
  ecu instance testBU: communication-connector, associated-i-pdu-group=testBU_Tx
  ecu instance recBU: communication-connector, associated-i-pdu-group=recBU_Rx
package /IPDUGroup
  i pdu group testBU_Tx: communication-direction=OUT, i-pdu=[testFrame1, extendedFrame]
  i pdu group recBU_Rx: communication-direction=IN, i-pdu=testFrame1
