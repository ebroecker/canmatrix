VERSION "created by canmatrix"

NS_ :

BS_:

BU_: testBU recBU

BO_ 291 testFrame1: 8 testBU
 SG_ someTestSignal : 3|11@0+ (5,1) [0.0|500.0] "specialCharUnit°$" recBU
 SG_ Signal : 20|3@1+ (1,0) [0.0|6.0] "someUnit" recBU

BO_ 2147483666 extendedFrame: 8 testBU

CM_ BO_ 291  " Multi  Line  Frame comment";

CM_ SG_ 291 someTestSignal "Multi  Line  Signal comment with a-umlaut: ä";

CM_ BU_ testBU "sender ECU";
CM_ BU_ recBU "receiver ECU";

BA_DEF_ BO_ "GenMsgCycleTime" INT 0 0;
BA_DEF_ BU_ "NetworkNode" INT 0 0;
BA_DEF_DEF_ "GenMsgCycleTime" 65535;
BA_DEF_DEF_ "NetworkNode" 65535;
BA_ "NetworkNode" BU_ testBU 7;

BA_ "GenMsgCycleTime" BO_ 291 100;

VAL_ 291 Signal 1 "one" 2 "two" 3 "three";
