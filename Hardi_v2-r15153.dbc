VERSION "created by canmatrix"

NS_ :

BS_:

BU_:

BO_ 1217 Diag_Reqest: 8 Vector__XXX
 SG_ service_22_muxer M : 8|24@1+ (1,0) [-8388608|8388607] "" Vector__XXX

BO_ 1729 Diag_Response: 8 Vector__XXX
 SG_ tp_length : 0|8@1- (1,0) [-128|127] "" Vector__XXX
 SG_ service_62_muxer M : 8|24@1+ (1,0) [-8388608|8388607] "" Vector__XXX
 SG_ SupplyVoltage0 m256 : 32|8@1+ (0.104,0) [0|0] "Volt" Vector__XXX
 SG_ SigVoltageOrCurrent0 m256 : 40|16@1+ (0.001221001221001,0) [0|0] "Volt" Vector__XXX
 SG_ AuxIn0 m256 : 56|8@1+ (1,0) [0|0] "" Vector__XXX
 SG_ PrimeFlowActiveError m362 : 32|8@1+ (1,0) [0|0] "" Vector__XXX
 SG_ PfMainState m362 : 40|4@1+ (1,0) [0|0] "" Vector__XXX
 SG_ reserved_BF_0 m362 : 44|1@1+ (1,0) [0|0] "" Vector__XXX
 SG_ reserved_BF_1 m362 : 45|1@1+ (1,0) [0|0] "" Vector__XXX
 SG_ reserved_BF_2 m362 : 46|1@1+ (1,0) [0|0] "" Vector__XXX
 SG_ reserved_BF_3 m362 : 47|1@1+ (1,0) [0|0] "" Vector__XXX
 SG_ PfOppStates m362 : 48|4@1+ (1,0) [0|0] "" Vector__XXX
 SG_ PfConnection m362 : 52|4@1+ (1,0) [0|0] "" Vector__XXX
 SG_ PfSplyVoltgRght0 m874 : 32|8@1+ (0.1198039215686274509803921569,0) [0|0] "Volt" Vector__XXX
 SG_ PfSplyVoltgLft0 m874 : 40|8@1+ (0.1198039215686274509803921569,0) [0|0] "Volt" Vector__XXX
 SG_ PfRs485Voltg1A0 m874 : 48|8@1+ (0.01953125,0) [0|0] "V" Vector__XXX
 SG_ PfRs485Voltg1B0 m874 : 56|8@1+ (0.01953125,0) [0|0] "V" Vector__XXX
 SG_ Sens_TaRinseTankFlow m405 : 32|8@1+ (2,0) [0|0] "Liter/min" Vector__XXX
 SG_ ISO_TaAwRinseTankCntnt m405 : 40|16@1+ (0.015625,0) [0|0] "l" Vector__XXX
 SG_ Sens_TaRinseFullSwt m405 : 56|1@1+ (1,0) [0|0] "" Vector__XXX
 SG_ TaRinseTankEmptyFlg m405 : 57|1@1+ (1,0) [0|0] "" Vector__XXX
 SG_ Flt_TaObsRinseFullSwtFlt m405 : 58|1@1+ (1,0) [0|0] "" Vector__XXX
 SG_ Flt_TaObsRinseTankNotFull m405 : 59|1@1+ (1,0) [0|0] "" Vector__XXX
 SG_ TaObsRinseTaState m405 : 60|4@1+ (1,0) [0|0] "Counts" Vector__XXX
 SG_ ParTaAwActlStep m401 : 32|8@1+ (1,0) [0|0] "Counts" Vector__XXX
 SG_ Flt_TaAWashFcPmpSetToStartAlrt m401 : 48|1@1+ (1,0) [0|0] "" Vector__XXX
 SG_ Flt_TaAWashFcPmpSetToStopAlrt m401 : 49|1@1+ (1,0) [0|0] "" Vector__XXX
 SG_ Flt_TaAWashFillHoseTiOutAlrt m401 : 50|1@1+ (1,0) [0|0] "" Vector__XXX
 SG_ Flt_TaAWashFlushBoomAlrt m401 : 51|1@1+ (1,0) [0|0] "" Vector__XXX
 SG_ Flt_TaAWashInvldPausePosn m401 : 52|1@1+ (1,0) [0|0] "" Vector__XXX
 SG_ Flt_TaAWashMainPmpRPMTooHigh m401 : 53|1@1+ (1,0) [0|0] "" Vector__XXX
 SG_ Flt_TaAWashMainPmpRPMTooLow m401 : 54|1@1+ (1,0) [0|0] "" Vector__XXX
 SG_ Flt_TaAWashMainTaNotEmptyAlrt m401 : 55|1@1+ (1,0) [0|0] "" Vector__XXX
 SG_ Flt_TaAWashNotEnghRinseWtrAlrt m401 : 40|1@1+ (1,0) [0|0] "" Vector__XXX
 SG_ Flt_TaAWashPrimingAlrt m401 : 41|1@1+ (1,0) [0|0] "" Vector__XXX
 SG_ Flt_TaAWashPushChemBackAlrt m401 : 42|1@1+ (1,0) [0|0] "" Vector__XXX
 SG_ Flt_TaAWashSnsrFailrAlrt m401 : 43|1@1+ (1,0) [0|0] "" Vector__XXX
 SG_ Flt_TaAWashTankEmptyTiOutAlrt m401 : 44|1@1+ (1,0) [0|0] "" Vector__XXX
 SG_ Flt_TaAWashVlvMovmtTiOutAlrt m401 : 45|1@1+ (1,0) [0|0] "" Vector__XXX
 SG_ Reserved_14 m401 : 46|1@1+ (1,0) [0|0] "" Vector__XXX
 SG_ Reserved_15 m401 : 47|1@1+ (1,0) [0|0] "" Vector__XXX
 SG_ Reserved_30 m401 : 56|8@1+ (1,0) [0|0] "" Vector__XXX
 SG_ TrSprayerTurnRd m43008 : 32|8@1+ (0.25,0) [0|0] "" Vector__XXX
 SG_ ISO_TrRollOverRisk m43008 : 40|8@1+ (0.392156863,0) [0|0] "%" Vector__XXX
 SG_ Reserved_20 m43008 : 48|8@1+ (1,0) [0|0] "" Vector__XXX
 SG_ Reserved_31 m43008 : 56|8@1+ (1,0) [0|0] "" Vector__XXX
 SG_ TrRearLinkgAgCtrl m42497 : 32|8@1+ (1,0) [0|0] "" Vector__XXX
 SG_ TrRearLinkgAgKpActl m42497 : 40|8@1+ (1,0) [0|0] "" Vector__XXX
 SG_ TrSigSteerVlv m42497 : 48|8@1+ (0.392156863,0) [0|0] "%" Vector__XXX
 SG_ Reserved_32 m42497 : 56|8@1+ (1,0) [0|0] "" Vector__XXX
 SG_ TrRearLinkAgSpt m42496 : 32|8@1+ (1,0) [0|0] "°" Vector__XXX
 SG_ TrRearLinkgAgCtrlDiff m42496 : 40|8@1+ (1,0) [0|0] "°" Vector__XXX
 SG_ Sens_TrRearLinkgAg m42496 : 48|8@1+ (1,0) [0|0] "°" Vector__XXX
 SG_ Sens_TrRearLinkAgDerivate m42496 : 56|8@1+ (1,0) [0|0] "°/s" Vector__XXX
 SG_ Sens_TrFrontHitchAg m40961 : 32|8@1+ (1,0) [0|0] "°" Vector__XXX
 SG_ Sens_TrFrontHitchAgDerivate m40961 : 40|8@1+ (1,0) [0|0] "°/s" Vector__XXX
 SG_ Reserved_21 m40961 : 48|8@1+ (1,0) [0|0] "" Vector__XXX
 SG_ Reserved_33 m40961 : 56|8@1+ (1,0) [0|0] "" Vector__XXX
 SG_ TrHydrBypassEnadInCurve m40960 : 32|1@1+ (1,0) [0|0] "" Vector__XXX
 SG_ Flt_TrRearLinkgAgSnsrMeclDfct m40960 : 33|1@1+ (1,0) [0|0] "" Vector__XXX
 SG_ Flt_TrRearLinkgAgWrgDir m40960 : 34|1@1+ (1,0) [0|0] "" Vector__XXX
 SG_ Flt_TrAgOutOfLimitsForAuto m40960 : 35|1@1+ (1,0) [0|0] "" Vector__XXX
 SG_ Flt_TrFrontHitchAgChgTooHigh m40960 : 36|1@1+ (1,0) [0|0] "" Vector__XXX
 SG_ TrInitPhaseFinished m40960 : 37|1@1+ (1,0) [0|0] "" Vector__XXX
 SG_ RollOverRiskOverLimit m40960 : 38|1@1+ (1,0) [0|0] "" Vector__XXX
 SG_ Unused m40960 : 39|1@1+ (1,0) [0|0] "" Vector__XXX
 SG_ TrStatemachineModeSts m40960 : 40|8@1+ (1,0) [0|0] "" Vector__XXX
 SG_ Sens_TrSpeedSnsrPulse m40960 : 48|8@1+ (1,0) [0|0] "" Vector__XXX
 SG_ Reserved_34 m40960 : 56|8@1+ (1,0) [0|0] "" Vector__XXX
 SG_ Aux_3 m915 : 32|1@1+ (1,0) [0|0] "" Vector__XXX
 SG_ Aux_2 m915 : 33|1@1+ (1,0) [0|0] "" Vector__XXX
 SG_ Aux_1 m915 : 34|1@1+ (1,0) [0|0] "" Vector__XXX
 SG_ Flt_TaObsPmpMainPmpSigImpy m915 : 35|1@1+ (1,0) [0|0] "" Vector__XXX
 SG_ Flt_TaObsPmpFlexCapSigImpy m915 : 36|1@1+ (1,0) [0|0] "" Vector__XXX
 SG_ Flt_TaObsMainTaSnsrFlt m915 : 37|1@1+ (1,0) [0|0] "" Vector__XXX
 SG_ AwMainTankEmptyFlg m915 : 38|1@1+ (1,0) [0|0] "" Vector__XXX
 SG_ Sens_TaMainTaFullSwt m915 : 39|1@1+ (1,0) [0|0] "" Vector__XXX
 SG_ Aux10 m915 : 40|8@1+ (1,0) [0|0] "" Vector__XXX
 SG_ Aux20 m915 : 48|8@1+ (1,0) [0|0] "" Vector__XXX
 SG_ Aux3 m915 : 56|8@1+ (1,0) [0|0] "" Vector__XXX
 SG_ ISO_SpRegulatorPressureSP m3168 : 32|8@1+ (0.0625,0) [0|0] "Bar" Vector__XXX
 SG_ Sens_SpraySectionsPressure m3168 : 40|8@1+ (0.0625,0) [0|0] "Bar" Vector__XXX
 SG_ AuxSp1 m3168 : 48|8@1+ (1,0) [0|0] "" Vector__XXX
 SG_ AuxSp2 m3168 : 56|8@1+ (1,0) [0|0] "" Vector__XXX
 SG_ Status m45063 : 32|8@1+ (1,0) [0|0] "" Vector__XXX
 SG_ SprayerIdentificationNumber m45063 : 40|136@1+ (1,0) [0|0] "" Vector__XXX
 SG_ ConfigurationTime m45063 : 176|32@1+ (1,0) [0|0] "" Vector__XXX
 SG_ ConfigVersionMajor m45063 : 208|24@1+ (1,0) [0|0] "" Vector__XXX
 SG_ ConfigVersionMinor m45063 : 232|24@1+ (1,0) [0|0] "" Vector__XXX
 SG_ reserved m45063 : 256|128@1+ (1,0) [0|0] "" Vector__XXX
 SG_ SupplyVoltage1 m257 : 32|8@1+ (0.104,0) [0|0] "Volt" Vector__XXX
 SG_ SigVoltageOrCurrent1 m257 : 40|16@1+ (0.001221001221001,0) [0|0] "Volt" Vector__XXX
 SG_ AuxIn1 m257 : 56|8@1+ (1,0) [0|0] "" Vector__XXX
 SG_ SupplyVoltage2 m258 : 32|8@1+ (0.104,0) [0|0] "Volt" Vector__XXX
 SG_ SigVoltageOrCurrent2 m258 : 40|16@1+ (0.001221001221001,0) [0|0] "Volt" Vector__XXX
 SG_ AuxIn2 m258 : 56|8@1+ (1,0) [0|0] "" Vector__XXX
 SG_ SupplyVoltage3 m259 : 32|8@1+ (0.104,0) [0|0] "Volt" Vector__XXX
 SG_ SigVoltageOrCurrent3 m259 : 40|16@1+ (0.001221001221001,0) [0|0] "Volt" Vector__XXX
 SG_ AuxIn3 m259 : 56|8@1+ (1,0) [0|0] "" Vector__XXX
 SG_ SupplyVoltage4 m260 : 32|8@1+ (0.104,0) [0|0] "Volt" Vector__XXX
 SG_ SigVoltageOrCurrent4 m260 : 40|16@1+ (0.001221001221001,0) [0|0] "Volt" Vector__XXX
 SG_ AuxIn4 m260 : 56|8@1+ (1,0) [0|0] "" Vector__XXX
 SG_ SupplyVoltage5 m261 : 32|8@1+ (0.104,0) [0|0] "Volt" Vector__XXX
 SG_ SigVoltageOrCurrent5 m261 : 40|16@1+ (0.001221001221001,0) [0|0] "Volt" Vector__XXX
 SG_ AuxIn5 m261 : 56|8@1+ (1,0) [0|0] "" Vector__XXX
 SG_ SupplyVoltage6 m262 : 32|8@1+ (0.104,0) [0|0] "Volt" Vector__XXX
 SG_ SigVoltageOrCurrent6 m262 : 40|16@1+ (0.001221001221001,0) [0|0] "Volt" Vector__XXX
 SG_ AuxIn6 m262 : 56|8@1+ (1,0) [0|0] "" Vector__XXX
 SG_ SupplyVoltage7 m263 : 32|8@1+ (0.104,0) [0|0] "Volt" Vector__XXX
 SG_ SigVoltageOrCurrent7 m263 : 40|16@1+ (0.001221001221001,0) [0|0] "Volt" Vector__XXX
 SG_ AuxIn7 m263 : 56|8@1+ (1,0) [0|0] "" Vector__XXX
 SG_ OutputVoltageHigh0 m288 : 32|8@1+ (0.104,0) [0|0] "Volt" Vector__XXX
 SG_ OutputVoltageCommon0 m288 : 40|8@1+ (0.104,0) [0|0] "Volt" Vector__XXX
 SG_ OutputCurrent0 m288 : 48|16@1+ (1,0) [0|0] "Milliampere" Vector__XXX
 SG_ OutputVoltageHigh1 m289 : 32|8@1+ (0.104,0) [0|0] "Volt" Vector__XXX
 SG_ OutputVoltageCommon1 m289 : 40|8@1+ (0.104,0) [0|0] "Volt" Vector__XXX
 SG_ OutputCurrent1 m289 : 48|16@1+ (1,0) [0|0] "Milliampere" Vector__XXX
 SG_ OutputVoltageHigh2 m290 : 32|8@1+ (0.104,0) [0|0] "Volt" Vector__XXX
 SG_ OutputVoltageCommon2 m290 : 40|8@1+ (0.104,0) [0|0] "Volt" Vector__XXX
 SG_ OutputCurrent2 m290 : 48|16@1+ (1,0) [0|0] "Milliampere" Vector__XXX
 SG_ OutputVoltageHigh3 m291 : 32|8@1+ (0.104,0) [0|0] "Volt" Vector__XXX
 SG_ OutputVoltageCommon3 m291 : 40|8@1+ (0.104,0) [0|0] "Volt" Vector__XXX
 SG_ OutputCurrent3 m291 : 48|16@1+ (1,0) [0|0] "Milliampere" Vector__XXX
 SG_ OutputVoltageHigh4 m292 : 32|8@1+ (0.104,0) [0|0] "Volt" Vector__XXX
 SG_ OutputVoltageCommon4 m292 : 40|8@1+ (0.104,0) [0|0] "Volt" Vector__XXX
 SG_ OutputCurrent4 m292 : 48|16@1+ (1,0) [0|0] "Milliampere" Vector__XXX
 SG_ OutputVoltageHigh5 m293 : 32|8@1+ (0.104,0) [0|0] "Volt" Vector__XXX
 SG_ OutputVoltageCommon5 m293 : 40|8@1+ (0.104,0) [0|0] "Volt" Vector__XXX
 SG_ OutputCurrent5 m293 : 48|16@1+ (1,0) [0|0] "Milliampere" Vector__XXX
 SG_ OutputVoltageHigh6 m294 : 32|8@1+ (0.104,0) [0|0] "Volt" Vector__XXX
 SG_ OutputVoltageCommon6 m294 : 40|8@1+ (0.104,0) [0|0] "Volt" Vector__XXX
 SG_ OutputCurrent6 m294 : 48|16@1+ (1,0) [0|0] "Milliampere" Vector__XXX
 SG_ OutputVoltageHigh7 m295 : 32|8@1+ (0.104,0) [0|0] "Volt" Vector__XXX
 SG_ OutputVoltageCommon7 m295 : 40|8@1+ (0.104,0) [0|0] "Volt" Vector__XXX
 SG_ OutputCurrent7 m295 : 48|16@1+ (1,0) [0|0] "Milliampere" Vector__XXX
 SG_ OutputVoltageHigh8 m296 : 32|8@1+ (0.104,0) [0|0] "Volt" Vector__XXX
 SG_ OutputVoltageCommon8 m296 : 40|8@1+ (0.104,0) [0|0] "Volt" Vector__XXX
 SG_ OutputCurrent8 m296 : 48|16@1+ (1,0) [0|0] "Milliampere" Vector__XXX
 SG_ OutputVoltageHigh9 m297 : 32|8@1+ (0.104,0) [0|0] "Volt" Vector__XXX
 SG_ OutputVoltageCommon9 m297 : 40|8@1+ (0.104,0) [0|0] "Volt" Vector__XXX
 SG_ OutputCurrent9 m297 : 48|16@1+ (1,0) [0|0] "Milliampere" Vector__XXX
 SG_ Sens_SprayPump1Speed0 m2912 : 32|8@1+ (4,0) [0|0] "Rpm" Vector__XXX
 SG_ Sens_SprayPump2FlexCapSpeed m2912 : 40|8@1+ (4,0) [0|0] "Rpm" Vector__XXX
 SG_ Aux11 m2912 : 48|8@1+ (1,0) [0|0] "" Vector__XXX
 SG_ Aux21 m2912 : 56|8@1+ (1,0) [0|0] "" Vector__XXX
 SG_ OutputVoltageHigh10 m298 : 32|8@1+ (0.104,0) [0|0] "Volt" Vector__XXX
 SG_ OutputVoltageCommon10 m298 : 40|8@1+ (0.104,0) [0|0] "Volt" Vector__XXX
 SG_ OutputCurrent10 m298 : 48|16@1+ (1,0) [0|0] "Milliampere" Vector__XXX
 SG_ OutputVoltageHigh11 m299 : 32|8@1+ (0.104,0) [0|0] "Volt" Vector__XXX
 SG_ OutputVoltageCommon11 m299 : 40|8@1+ (0.104,0) [0|0] "Volt" Vector__XXX
 SG_ OutputCurrent11 m299 : 48|16@1+ (1,0) [0|0] "Milliampere" Vector__XXX
 SG_ OutputVoltageHigh12 m300 : 32|8@1+ (0.104,0) [0|0] "Volt" Vector__XXX
 SG_ OutputVoltageCommon12 m300 : 40|8@1+ (0.104,0) [0|0] "Volt" Vector__XXX
 SG_ OutputCurrent12 m300 : 48|16@1+ (1,0) [0|0] "Milliampere" Vector__XXX
 SG_ OutputVoltageHigh13 m301 : 32|8@1+ (0.104,0) [0|0] "Volt" Vector__XXX
 SG_ OutputVoltageCommon13 m301 : 40|8@1+ (0.104,0) [0|0] "Volt" Vector__XXX
 SG_ OutputCurrent13 m301 : 48|16@1+ (1,0) [0|0] "Milliampere" Vector__XXX
 SG_ OutputVoltageHigh14 m302 : 32|8@1+ (0.104,0) [0|0] "Volt" Vector__XXX
 SG_ OutputVoltageCommon14 m302 : 40|8@1+ (0.104,0) [0|0] "Volt" Vector__XXX
 SG_ OutputCurrent14 m302 : 48|16@1+ (1,0) [0|0] "Milliampere" Vector__XXX
 SG_ OutputVoltageHigh15 m303 : 32|8@1+ (0.104,0) [0|0] "Volt" Vector__XXX
 SG_ OutputVoltageCommon15 m303 : 40|8@1+ (0.104,0) [0|0] "Volt" Vector__XXX
 SG_ OutputCurrent15 m303 : 48|16@1+ (1,0) [0|0] "Milliampere" Vector__XXX
 SG_ VoltageCanHigh0 m320 : 32|8@1+ (0.104,0) [0|0] "Volt" Vector__XXX
 SG_ VoltageCanLow0 m320 : 40|8@1+ (0.104,0) [0|0] "Volt" Vector__XXX
 SG_ StatusFlag0 m320 : 48|8@1+ (1,0) [0|0] "Counts" Vector__XXX
 SG_ Aux0 m320 : 56|8@1+ (1,0) [0|0] "" Vector__XXX
 SG_ VoltageCanHigh1 m321 : 32|8@1+ (0.104,0) [0|0] "Volt" Vector__XXX
 SG_ VoltageCanLow1 m321 : 40|8@1+ (0.104,0) [0|0] "Volt" Vector__XXX
 SG_ StatusFlag1 m321 : 48|8@1+ (1,0) [0|0] "Counts" Vector__XXX
 SG_ Aux1 m321 : 56|8@1+ (1,0) [0|0] "" Vector__XXX
 SG_ VoltageCanHigh2 m322 : 32|8@1+ (0.104,0) [0|0] "Volt" Vector__XXX
 SG_ VoltageCanLow2 m322 : 40|8@1+ (0.104,0) [0|0] "Volt" Vector__XXX
 SG_ StatusFlag2 m322 : 48|8@1+ (1,0) [0|0] "Counts" Vector__XXX
 SG_ Aux2 m322 : 56|8@1+ (1,0) [0|0] "" Vector__XXX
 SG_ VoltageCanHigh3 m323 : 32|8@1+ (0.104,0) [0|0] "Volt" Vector__XXX
 SG_ VoltageCanLow3 m323 : 40|8@1+ (0.104,0) [0|0] "Volt" Vector__XXX
 SG_ StatusFlag3 m323 : 48|8@1+ (1,0) [0|0] "Counts" Vector__XXX
 SG_ Aux3 m323 : 56|8@1+ (1,0) [0|0] "" Vector__XXX
 SG_ VoltageRx m324 : 32|8@1+ (0.104,0) [0|0] "Volt" Vector__XXX
 SG_ VoltageTx m324 : 40|8@1+ (0.104,0) [0|0] "Volt" Vector__XXX
 SG_ StatusFlag4 m324 : 48|8@1+ (1,0) [0|0] "Counts" Vector__XXX
 SG_ Aux4 m324 : 56|8@1+ (1,0) [0|0] "" Vector__XXX
 SG_ Temperature01 m325 : 32|8@1+ (-0.6944444444444444444444444444,95.83) [0|0] "°C" Vector__XXX
 SG_ Temperature02 m325 : 40|8@1+ (-0.6944444444444444444444444444,95.83) [0|0] "°C" Vector__XXX
 SG_ Temperature03 m325 : 48|8@1+ (-0.6944444444444444444444444444,95.83) [0|0] "°C" Vector__XXX
 SG_ AuxTemptr m325 : 56|8@1+ (-0.6944444444444444444444444444,95.83) [0|0] "°C" Vector__XXX
 SG_ State0 m326 : 32|8@1+ (1,0) [0|0] "" Vector__XXX
 SG_ AuxIso1 m326 : 40|8@1+ (1,0) [0|0] "" Vector__XXX
 SG_ AuxIso2 m326 : 48|8@1+ (1,0) [0|0] "" Vector__XXX
 SG_ AuxIso3 m326 : 56|8@1+ (1,0) [0|0] "" Vector__XXX
 SG_ ParSprayARDesired m352 : 32|16@1+ (0.0625,0) [0|0] "l/ha" Vector__XXX
 SG_ ParNumberOfOpenNozzles m352 : 48|8@1+ (1,0) [0|0] "Counts" Vector__XXX
 SG_ ISO_SprayRegState m352 : 56|8@1+ (1,0) [0|0] "Counts" Vector__XXX
 SG_ ParSpraySection01 m361 : 32|1@1+ (1,0) [0|0] "" Vector__XXX
 SG_ ParSpraySection02 m361 : 33|1@1+ (1,0) [0|0] "" Vector__XXX
 SG_ ParSpraySection03 m361 : 34|1@1+ (1,0) [0|0] "" Vector__XXX
 SG_ ParSpraySection04 m361 : 35|1@1+ (1,0) [0|0] "" Vector__XXX
 SG_ ParSpraySection05 m361 : 36|1@1+ (1,0) [0|0] "" Vector__XXX
 SG_ ParSpraySection06 m361 : 37|1@1+ (1,0) [0|0] "" Vector__XXX
 SG_ ParSpraySection07 m361 : 38|1@1+ (1,0) [0|0] "" Vector__XXX
 SG_ ParSpraySection08 m361 : 39|1@1+ (1,0) [0|0] "" Vector__XXX
 SG_ ParSpraySection09 m361 : 40|1@1+ (1,0) [0|0] "" Vector__XXX
 SG_ ParSpraySection10 m361 : 41|1@1+ (1,0) [0|0] "" Vector__XXX
 SG_ ParSpraySection11 m361 : 42|1@1+ (1,0) [0|0] "" Vector__XXX
 SG_ ParSpraySection12 m361 : 43|1@1+ (1,0) [0|0] "" Vector__XXX
 SG_ ParSpraySection13 m361 : 44|1@1+ (1,0) [0|0] "" Vector__XXX
 SG_ Act_SpraySectionBypass1 m361 : 45|1@1+ (1,0) [0|0] "" Vector__XXX
 SG_ ParSprayLine1 m361 : 46|1@1+ (1,0) [0|0] "" Vector__XXX
 SG_ ParSprayLine2 m361 : 47|1@1+ (1,0) [0|0] "" Vector__XXX
 SG_ ParSprayLine3 m361 : 48|1@1+ (1,0) [0|0] "" Vector__XXX
 SG_ ParSprayLine4 m361 : 49|1@1+ (1,0) [0|0] "" Vector__XXX
 SG_ ParSprayAdd50NozzleLeft m361 : 50|1@1+ (1,0) [0|0] "" Vector__XXX
 SG_ ParSprayAdd50NozzleRight m361 : 51|1@1+ (1,0) [0|0] "" Vector__XXX
 SG_ ParSprayFenceNozzleLeft m361 : 52|1@1+ (1,0) [0|0] "" Vector__XXX
 SG_ ParSprayFenceNozzleRight m361 : 53|1@1+ (1,0) [0|0] "" Vector__XXX
 SG_ ParSprayEdgeNozzleLeft m361 : 54|1@1+ (1,0) [0|0] "" Vector__XXX
 SG_ ParSprayEdgeNozzleRight m361 : 55|1@1+ (1,0) [0|0] "" Vector__XXX
 SG_ AuxSp0 m361 : 56|8@1+ (1,0) [0|0] "" Vector__XXX
 SG_ Sens_BoomSlantAngle m368 : 32|8@1+ (0.5,0) [0|0] "Degrees" Vector__XXX
 SG_ ParBmSlantVlvCtrlSt m368 : 40|4@1+ (1,0) [0|0] "Counts" Vector__XXX
 SG_ ParBmSlantFltCtrlSt m368 : 44|4@1+ (1,0) [0|0] "Counts" Vector__XXX
 SG_ Flt_BmSlantAgSnsrMeclDfct m368 : 48|1@1+ (1,0) [0|0] "" Vector__XXX
 SG_ Flt_BmSlantAgSnsrWrgDir m368 : 49|1@1+ (1,0) [0|0] "" Vector__XXX
 SG_ AuxBit1 m368 : 56|1@1+ (1,0) [0|0] "" Vector__XXX
 SG_ AuxBit2 m368 : 57|1@1+ (1,0) [0|0] "" Vector__XXX
 SG_ AuxBit3 m368 : 58|1@1+ (1,0) [0|0] "" Vector__XXX
 SG_ AuxBit4 m368 : 59|1@1+ (1,0) [0|0] "" Vector__XXX
 SG_ AuxBit5 m368 : 60|1@1+ (1,0) [0|0] "" Vector__XXX
 SG_ AuxBit6 m368 : 61|1@1+ (1,0) [0|0] "" Vector__XXX
 SG_ AuxBit7 m368 : 62|1@1+ (1,0) [0|0] "" Vector__XXX
 SG_ AuxBit8 m368 : 63|1@1+ (1,0) [0|0] "" Vector__XXX
 SG_ Sens_BoomLiftAngle m375 : 32|8@1+ (0.5,0) [0|0] "Degrees" Vector__XXX
 SG_ ParBmLiftVlvCtrlSt m375 : 40|4@1+ (1,0) [0|0] "Counts" Vector__XXX
 SG_ ParBmLiftFltCtrlSt m375 : 44|4@1+ (1,0) [0|0] "Counts" Vector__XXX
 SG_ Flt_BmLiftAgSnsrMeclDfct m375 : 48|1@1+ (1,0) [0|0] "" Vector__XXX
 SG_ AuxBit_6 m375 : 49|1@1+ (1,0) [0|0] "" Vector__XXX
 SG_ AuxBit_5 m375 : 50|1@1+ (1,0) [0|0] "" Vector__XXX
 SG_ AuxBit_4 m375 : 51|1@1+ (1,0) [0|0] "" Vector__XXX
 SG_ AuxBit_3 m375 : 52|1@1+ (1,0) [0|0] "" Vector__XXX
 SG_ AuxBit_2 m375 : 53|1@1+ (1,0) [0|0] "" Vector__XXX
 SG_ AuxBit_1 m375 : 54|1@1+ (1,0) [0|0] "" Vector__XXX
 SG_ AuxBit m375 : 55|1@1+ (1,0) [0|0] "" Vector__XXX
 SG_ AuxBm1 m375 : 56|8@1+ (1,0) [0|0] "" Vector__XXX
 SG_ ParTaMainTaCntnt m403 : 32|16@1+ (1,0) [0|0] "l" Vector__XXX
 SG_ Sens_TaMainTaLvlFrq m403 : 48|16@1+ (0.0625,0) [0|0] "Hz" Vector__XXX
 SG_ TaSuctSrcActlPosn m411 : 32|4@1+ (1,0) [0|0] "Counts" Vector__XXX
 SG_ TaPresDestActlPosn m411 : 36|4@1+ (1,0) [0|0] "Counts" Vector__XXX
 SG_ TaFillVlvActlPosn m411 : 40|4@1+ (1,0) [0|0] "Counts" Vector__XXX
 SG_ TaAgitVlvActlPosn m411 : 44|4@1+ (1,0) [0|0] "Counts" Vector__XXX
 SG_ _Act_TaAgitVlvMot m411 : 48|8@1+ (0.5,0) [0|0] "Degrees" Vector__XXX
 SG_ FTB_SuctSrcVlvAct m411 : 56|1@1+ (1,0) [0|0] "" Vector__XXX
 SG_ FTB_SuctSrcVlvSnsr m411 : 57|1@1+ (1,0) [0|0] "" Vector__XXX
 SG_ FTB_PresDestVlvAct m411 : 58|1@1+ (1,0) [0|0] "" Vector__XXX
 SG_ FTB_PresDestVlvSnsr m411 : 59|1@1+ (1,0) [0|0] "" Vector__XXX
 SG_ FTB_FillVlvAct m411 : 60|1@1+ (1,0) [0|0] "" Vector__XXX
 SG_ FTB_FillVlvSnsr_tbd m411 : 61|1@1+ (1,0) [0|0] "" Vector__XXX
 SG_ FTB_AgitVlvAct m411 : 62|1@1+ (1,0) [0|0] "" Vector__XXX
 SG_ FTB_AgitVlvAgSnsr m411 : 63|1@1+ (1,0) [0|0] "" Vector__XXX
 SG_ SigFrequency0 m512 : 32|16@1+ (0.0625,0) [0|0] "Hz" Vector__XXX
 SG_ SigDutyCycle0 m512 : 48|8@1+ (0.392156863,0) [0|0] "%" Vector__XXX
 SG_ State1 m512 : 56|8@1+ (1,0) [0|0] "Counts" Vector__XXX
 SG_ SigFrequency1 m513 : 32|16@1+ (0.0625,0) [0|0] "Hz" Vector__XXX
 SG_ SigDutyCycle1 m513 : 48|8@1+ (0.392156863,0) [0|0] "%" Vector__XXX
 SG_ State2 m513 : 56|8@1+ (1,0) [0|0] "Counts" Vector__XXX
 SG_ SigFrequency2 m514 : 32|16@1+ (0.0625,0) [0|0] "Hz" Vector__XXX
 SG_ SigDutyCycle2 m514 : 48|8@1+ (0.392156863,0) [0|0] "%" Vector__XXX
 SG_ State3 m514 : 56|8@1+ (1,0) [0|0] "Counts" Vector__XXX
 SG_ SigFrequency3 m515 : 32|16@1+ (0.0625,0) [0|0] "Hz" Vector__XXX
 SG_ SigDutyCycle3 m515 : 48|8@1+ (0.392156863,0) [0|0] "%" Vector__XXX
 SG_ State4 m515 : 56|8@1+ (1,0) [0|0] "Counts" Vector__XXX
 SG_ SigFrequency4 m516 : 32|16@1+ (0.0625,0) [0|0] "Hz" Vector__XXX
 SG_ SigDutyCycle4 m516 : 48|8@1+ (0.392156863,0) [0|0] "%" Vector__XXX
 SG_ State5 m516 : 56|8@1+ (1,0) [0|0] "Counts" Vector__XXX
 SG_ SigFrequency5 m517 : 32|16@1+ (0.0625,0) [0|0] "Hz" Vector__XXX
 SG_ SigDutyCycle5 m517 : 48|8@1+ (0.392156863,0) [0|0] "%" Vector__XXX
 SG_ State6 m517 : 56|8@1+ (1,0) [0|0] "Counts" Vector__XXX
 SG_ SigFrequency6 m518 : 32|16@1+ (0.0625,0) [0|0] "Hz" Vector__XXX
 SG_ SigDutyCycle6 m518 : 48|8@1+ (0.392156863,0) [0|0] "%" Vector__XXX
 SG_ State7 m518 : 56|8@1+ (1,0) [0|0] "Counts" Vector__XXX
 SG_ SigFrequency7 m519 : 32|16@1+ (0.0625,0) [0|0] "Hz" Vector__XXX
 SG_ SigDutyCycle7 m519 : 48|8@1+ (0.392156863,0) [0|0] "%" Vector__XXX
 SG_ State8 m519 : 56|8@1+ (1,0) [0|0] "Counts" Vector__XXX
 SG_ BswClosedLoopErr0 m544 : 32|8@1+ (1,0) [0|0] "" Vector__XXX
 SG_ BswControllerStateStatusFlg0 m544 : 40|8@1+ (1,0) [0|0] "" Vector__XXX
 SG_ FilteredResistance0 m544 : 48|8@1+ (50,0) [0|0] "" Vector__XXX
 SG_ DutyCycle0 m544 : 56|8@1+ (0.787401575,0) [0|0] "%" Vector__XXX
 SG_ BswClosedLoopErr1 m545 : 32|8@1+ (1,0) [0|0] "" Vector__XXX
 SG_ BswControllerStateStatusFlg1 m545 : 40|8@1+ (1,0) [0|0] "" Vector__XXX
 SG_ FilteredResistance1 m545 : 48|8@1+ (50,0) [0|0] "" Vector__XXX
 SG_ DutyCycle1 m545 : 56|8@1+ (0.787401575,0) [0|0] "%" Vector__XXX
 SG_ BswClosedLoopErr2 m546 : 32|8@1+ (1,0) [0|0] "" Vector__XXX
 SG_ BswControllerStateStatusFlg2 m546 : 40|8@1+ (1,0) [0|0] "" Vector__XXX
 SG_ FilteredResistance2 m546 : 48|8@1+ (50,0) [0|0] "" Vector__XXX
 SG_ DutyCycle2 m546 : 56|8@1+ (0.787401575,0) [0|0] "%" Vector__XXX
 SG_ BswClosedLoopErr3 m547 : 32|8@1+ (1,0) [0|0] "" Vector__XXX
 SG_ BswControllerStateStatusFlg3 m547 : 40|8@1+ (1,0) [0|0] "" Vector__XXX
 SG_ FilteredResistance3 m547 : 48|8@1+ (50,0) [0|0] "" Vector__XXX
 SG_ DutyCycle3 m547 : 56|8@1+ (0.787401575,0) [0|0] "%" Vector__XXX
 SG_ BswClosedLoopErr4 m548 : 32|8@1+ (1,0) [0|0] "" Vector__XXX
 SG_ BswControllerStateStatusFlg4 m548 : 40|8@1+ (1,0) [0|0] "" Vector__XXX
 SG_ FilteredResistance4 m548 : 48|8@1+ (50,0) [0|0] "" Vector__XXX
 SG_ DutyCycle4 m548 : 56|8@1+ (0.787401575,0) [0|0] "%" Vector__XXX
 SG_ BswClosedLoopErr5 m549 : 32|8@1+ (1,0) [0|0] "" Vector__XXX
 SG_ BswControllerStateStatusFlg5 m549 : 40|8@1+ (1,0) [0|0] "" Vector__XXX
 SG_ FilteredResistance5 m549 : 48|8@1+ (50,0) [0|0] "" Vector__XXX
 SG_ DutyCycle5 m549 : 56|8@1+ (0.787401575,0) [0|0] "%" Vector__XXX
 SG_ BswClosedLoopErr6 m550 : 32|8@1+ (1,0) [0|0] "" Vector__XXX
 SG_ BswControllerStateStatusFlg6 m550 : 40|8@1+ (1,0) [0|0] "" Vector__XXX
 SG_ FilteredResistance6 m550 : 48|8@1+ (50,0) [0|0] "" Vector__XXX
 SG_ DutyCycle6 m550 : 56|8@1+ (0.787401575,0) [0|0] "%" Vector__XXX
 SG_ BswClosedLoopErr7 m551 : 32|8@1+ (1,0) [0|0] "" Vector__XXX
 SG_ BswControllerStateStatusFlg7 m551 : 40|8@1+ (1,0) [0|0] "" Vector__XXX
 SG_ FilteredResistance7 m551 : 48|8@1+ (50,0) [0|0] "" Vector__XXX
 SG_ DutyCycle7 m551 : 56|8@1+ (0.787401575,0) [0|0] "%" Vector__XXX
 SG_ BswClosedLoopErr8 m552 : 32|8@1+ (1,0) [0|0] "" Vector__XXX
 SG_ BswControllerStateStatusFlg8 m552 : 40|8@1+ (1,0) [0|0] "" Vector__XXX
 SG_ FilteredResistance8 m552 : 48|8@1+ (50,0) [0|0] "" Vector__XXX
 SG_ DutyCycle8 m552 : 56|8@1+ (0.787401575,0) [0|0] "%" Vector__XXX
 SG_ BswClosedLoopErr9 m553 : 32|8@1+ (1,0) [0|0] "" Vector__XXX
 SG_ BswControllerStateStatusFlg9 m553 : 40|8@1+ (1,0) [0|0] "" Vector__XXX
 SG_ FilteredResistance9 m553 : 48|8@1+ (50,0) [0|0] "" Vector__XXX
 SG_ DutyCycle9 m553 : 56|8@1+ (0.787401575,0) [0|0] "%" Vector__XXX
 SG_ BswClosedLoopErr10 m554 : 32|8@1+ (1,0) [0|0] "" Vector__XXX
 SG_ BswControllerStateStatusFlg10 m554 : 40|8@1+ (1,0) [0|0] "" Vector__XXX
 SG_ FilteredResistance10 m554 : 48|8@1+ (50,0) [0|0] "" Vector__XXX
 SG_ DutyCycle10 m554 : 56|8@1+ (0.787401575,0) [0|0] "%" Vector__XXX
 SG_ BswClosedLoopErr11 m555 : 32|8@1+ (1,0) [0|0] "" Vector__XXX
 SG_ BswControllerStateStatusFlg11 m555 : 40|8@1+ (1,0) [0|0] "" Vector__XXX
 SG_ FilteredResistance11 m555 : 48|8@1+ (50,0) [0|0] "" Vector__XXX
 SG_ DutyCycle11 m555 : 56|8@1+ (0.787401575,0) [0|0] "%" Vector__XXX
 SG_ BswClosedLoopErr12 m556 : 32|8@1+ (1,0) [0|0] "" Vector__XXX
 SG_ BswControllerStateStatusFlg12 m556 : 40|8@1+ (1,0) [0|0] "" Vector__XXX
 SG_ FilteredResistance12 m556 : 48|8@1+ (50,0) [0|0] "" Vector__XXX
 SG_ DutyCycle12 m556 : 56|8@1+ (0.787401575,0) [0|0] "%" Vector__XXX
 SG_ BswClosedLoopErr13 m557 : 32|8@1+ (1,0) [0|0] "" Vector__XXX
 SG_ BswControllerStateStatusFlg13 m557 : 40|8@1+ (1,0) [0|0] "" Vector__XXX
 SG_ FilteredResistance13 m557 : 48|8@1+ (50,0) [0|0] "" Vector__XXX
 SG_ DutyCycle13 m557 : 56|8@1+ (0.787401575,0) [0|0] "%" Vector__XXX
 SG_ BswClosedLoopErr14 m558 : 32|8@1+ (1,0) [0|0] "" Vector__XXX
 SG_ BswControllerStateStatusFlg14 m558 : 40|8@1+ (1,0) [0|0] "" Vector__XXX
 SG_ FilteredResistance14 m558 : 48|8@1+ (50,0) [0|0] "" Vector__XXX
 SG_ DutyCycle14 m558 : 56|8@1+ (0.787401575,0) [0|0] "%" Vector__XXX
 SG_ BswClosedLoopErr15 m559 : 32|8@1+ (1,0) [0|0] "" Vector__XXX
 SG_ BswControllerStateStatusFlg15 m559 : 40|8@1+ (1,0) [0|0] "" Vector__XXX
 SG_ FilteredResistance15 m559 : 48|8@1+ (50,0) [0|0] "" Vector__XXX
 SG_ DutyCycle15 m559 : 56|8@1+ (0.787401575,0) [0|0] "%" Vector__XXX
 SG_ PwrDiv m581 : 32|8@1+ (0.104,0) [0|0] "Volt" Vector__XXX
 SG_ PwrSwDiv m581 : 40|8@1+ (0.104,0) [0|0] "Volt" Vector__XXX
 SG_ TbcPwrDiv m581 : 48|8@1+ (0.104,0) [0|0] "Volt" Vector__XXX
 SG_ TbcGndDiv m581 : 56|8@1+ (0.03921568627451,-5) [0|0] "Volt" Vector__XXX
 SG_ Sens_SprayDrivingSpeed m608 : 32|8@1+ (0.03125,0) [0|0] "m/s" Vector__XXX
 SG_ Sens_SpraySectionsFlow m608 : 40|8@1+ (2,0) [0|0] "Liter/min" Vector__XXX
 SG_ ISO_SpApplicationRateActual m608 : 48|16@1+ (0.0625,0) [0|0] "l/ha" Vector__XXX
 SG_ Sens_SpraySectionsFlowPulse m659 : 32|16@1+ (1,0) [0|0] "Counts" Vector__XXX
 SG_ ParTaMainTaSegIdx m659 : 48|8@1+ (1,0) [0|0] "Counts" Vector__XXX
 SG_ Aux5 m659 : 56|1@1+ (1,0) [0|0] "" Vector__XXX
 SG_ Flt_TaObsMainTaWtrLvlRiseAlrt m659 : 57|1@1+ (1,0) [0|0] "" Vector__XXX
 SG_ Flt_TaObsMainTaFlowPPUInvld m659 : 58|1@1+ (1,0) [0|0] "" Vector__XXX
 SG_ Flt_TaObsMainTaCalibFlt m659 : 59|1@1+ (1,0) [0|0] "" Vector__XXX
 SG_ ParTaObsMainTaCalibSt m659 : 60|4@1+ (1,0) [0|0] "Counts" Vector__XXX
 SG_ TaskCounter m837 : 32|8@1+ (1,0) [0|0] "Counts" Vector__XXX
 SG_ CpuLoad m837 : 40|8@1+ (0.392156863,0) [0|0] "%" Vector__XXX
 SG_ CpuLoadFastTask m837 : 48|8@1+ (0.392156863,0) [0|0] "%" Vector__XXX
 SG_ Aux22 m837 : 56|8@1+ (1,0) [0|0] "" Vector__XXX
 SG_ ISO_SpNozFlow3BarLineAFromAsw m864 : 32|8@1+ (0.015625,0) [0|0] "l/min" Vector__XXX
 SG_ ISO_SpNozFlow3BarLineBFromAsw m864 : 40|8@1+ (0.015625,0) [0|0] "l/min" Vector__XXX
 SG_ ISO_SpNozFlow3BarLineABFromAsw m864 : 48|8@1+ (0.015625,0) [0|0] "l/min" Vector__XXX
 SG_ AuxSp1 m864 : 56|8@1+ (1,0) [0|0] "" Vector__XXX
 SG_ ISO_SpRegValveCalcFlow m1120 : 32|8@1+ (2,0) [0|0] "Liter/min" Vector__XXX
 SG_ ISO_SpAgitValveCalcFlow m1120 : 40|8@1+ (2,0) [0|0] "Liter/min" Vector__XXX
 SG_ ISO_SpPumpCalcFlow m1120 : 48|8@1+ (2,0) [0|0] "Liter/min" Vector__XXX
 SG_ AuxByte0 m1120 : 56|8@1+ (1,0) [0|0] "" Vector__XXX
 SG_ ISO_SpDf4CentPumpRegRpmSpt m1376 : 32|8@1+ (20,0) [0|0] "Rpm" Vector__XXX
 SG_ Sens_SprayPump1Speed1 m1376 : 40|8@1+ (20,0) [0|0] "Rpm" Vector__XXX
 SG_ Act_SprayPump3CentrifugalSpeed m1376 : 48|8@1+ (0.392156863,0) [0|0] "%" Vector__XXX
 SG_ AuxSp2 m1376 : 56|8@1+ (1,0) [0|0] "" Vector__XXX
 SG_ ISO_SpDf4CentPumpHyVlvOffs m1632 : 32|8@1+ (0.392156863,0) [0|0] "%" Vector__XXX
 SG_ ISO_SpDf4CentPumpHyVlvSlop m1632 : 40|8@1+ (4,0) [0|0] "Rpm" Vector__XXX
 SG_ ISO_SpDf4CentPumpHyVlvHys m1632 : 48|8@1+ (4,0) [0|0] "Rpm" Vector__XXX
 SG_ AuxSp3 m1632 : 56|8@1+ (1,0) [0|0] "" Vector__XXX
 SG_ ParSpRegVlvAngleSpt m1888 : 32|8@1+ (0.5,0) [0|0] "Degrees" Vector__XXX
 SG_ Sens_SprayRegValveAngle m1888 : 40|8@1+ (0.5,0) [0|0] "Degrees" Vector__XXX
 SG_ Act_SprayRegulation m1888 : 48|8@1+ (0.787401575,0) [0|0] "%" Vector__XXX
 SG_ AuxSp4 m1888 : 56|8@1+ (1,0) [0|0] "" Vector__XXX
 SG_ ISO_SpRegValveCalcPress m2144 : 32|8@1+ (0.0625,0) [0|0] "Bar" Vector__XXX
 SG_ ISO_SpAgitValveCalcPress m2144 : 40|8@1+ (0.0625,0) [0|0] "Bar" Vector__XXX
 SG_ ISO_SpKAAgitation m2144 : 48|8@1+ (2,0) [0|0] "Liter/min" Vector__XXX
 SG_ AuxByte1 m2144 : 56|8@1+ (1,0) [0|0] "" Vector__XXX
 SG_ ParSpRegistDateTiStrt0 m2400 : 32|32@1+ (1,0) [0|0] "UnixTimestamp" Vector__XXX
 SG_ ParSpRegistDateTiStop0 m2400 : 64|32@1+ (1,0) [0|0] "UnixTimestamp" Vector__XXX
 SG_ ParSpRegistDrvgSpeedAvgSprd0 m2400 : 96|32@1+ (0.00390625,0) [0|0] "m/s" Vector__XXX
 SG_ ParSpRegistDrvgSpeedMaxSprd0 m2400 : 128|16@1+ (0.00390625,0) [0|0] "m/s" Vector__XXX
 SG_ ParSpRegistDstTotSprd0 m2400 : 144|32@1+ (1,0) [0|0] "m" Vector__XXX
 SG_ ParSpRegistTiTotSprd0 m2400 : 176|32@1+ (1,0) [0|0] "s" Vector__XXX
 SG_ ParSpRegistAreaPerTiAvgSprd0 m2400 : 208|32@1+ (0.00140625,0) [0|0] "ha/h" Vector__XXX
 SG_ ParSpRegistFlowAvgSprd0 m2400 : 240|32@1+ (0.00390625,0) [0|0] "l/min" Vector__XXX
 SG_ ParSpRegistVolTotSprd0 m2400 : 272|32@1+ (1,0) [0|0] "l" Vector__XXX
 SG_ ParSpRegistAreaTotSprd0 m2400 : 304|32@1+ (1,0) [0|0] "m²" Vector__XXX
 SG_ ParSpRegistDateTiStrt1 m2656 : 32|32@1+ (1,0) [0|0] "UnixTimestamp" Vector__XXX
 SG_ ParSpRegistDateTiStop1 m2656 : 64|32@1+ (1,0) [0|0] "UnixTimestamp" Vector__XXX
 SG_ ParSpRegistDrvgSpeedAvgSprd1 m2656 : 96|32@1+ (0.00390625,0) [0|0] "m/s" Vector__XXX
 SG_ ParSpRegistDrvgSpeedMaxSprd1 m2656 : 128|16@1+ (0.00390625,0) [0|0] "m/s" Vector__XXX
 SG_ ParSpRegistDstTotSprd1 m2656 : 144|32@1+ (1,0) [0|0] "m" Vector__XXX
 SG_ ParSpRegistTiTotSprd1 m2656 : 176|32@1+ (1,0) [0|0] "s" Vector__XXX
 SG_ ParSpRegistAreaPerTiAvgSprd1 m2656 : 208|32@1+ (0.00140625,0) [0|0] "ha/h" Vector__XXX
 SG_ ParSpRegistFlowAvgSprd1 m2656 : 240|32@1+ (0.00390625,0) [0|0] "l/min" Vector__XXX
 SG_ ParSpRegistVolTotSprd1 m2656 : 272|32@1+ (1,0) [0|0] "l" Vector__XXX
 SG_ ParSpRegistAreaTotSprd1 m2656 : 304|32@1+ (1,0) [0|0] "m²" Vector__XXX
 SG_ Reserverd m45057 : 992|8@1+ (1,0) [0|0] "" Vector__XXX
 SG_ Type0 m45057 : 1000|8@1+ (1,0) [0|0] "" Vector__XXX
 SG_ ManufacturerPartNumber0 m45057 : 1008|8@1+ (1,0) [0|0] "" Vector__XXX
 SG_ SensorChannel m45057 : 1016|8@1+ (1,0) [0|0] "" Vector__XXX
 SG_ Deadband m45057 : 1024|16@1+ (1,0) [0|0] "" Vector__XXX
 SG_ Gain m45057 : 1040|16@1+ (1,0) [0|0] "" Vector__XXX
 SG_ Reserved0 m45057 : 1056|1@1+ (1,0) [0|0] "" Vector__XXX
 SG_ Type1 m45058 : 144|8@1+ (1,0) [0|0] "" Vector__XXX
 SG_ ManufacturerPartNumber1 m45058 : 152|8@1+ (1,0) [0|0] "" Vector__XXX
 SG_ Reserved1 m45058 : 160|1@1+ (1,0) [0|0] "" Vector__XXX
 SG_ Configuration0 m45059 : 32|3936@1+ (1,0) [0|0] "" Vector__XXX
 SG_ Configuration1 m45060 : 32|3936@1+ (1,0) [0|0] "" Vector__XXX
 SG_ Configuration2 m45061 : 32|864@1+ (1,0) [0|0] "" Vector__XXX
 SG_ NodeNumber m45062 : 32|8@1+ (1,0) [0|0] "" Vector__XXX
 SG_ Reserved2 m45062 : 40|8@1+ (1,0) [0|0] "" Vector__XXX
 SG_ Type2 m45312 : 32|8@1+ (1,0) [0|0] "" Vector__XXX
 SG_ Timestamp m45313 : 32|32@1+ (1,0) [0|0] "UnixTimestamp" Vector__XXX
 SG_ SoftwareStatus m61825 : 32|8@1+ (1,0) [0|0] "" Vector__XXX
 SG_ SoftwareMajorVersion m61825 : 40|24@1+ (1,0) [0|0] "" Vector__XXX
 SG_ SoftwareMinorVersion m61825 : 64|24@1+ (1,0) [0|0] "" Vector__XXX
 SG_ SoftwarePatchVersion m61825 : 88|24@1+ (1,0) [0|0] "" Vector__XXX
 SG_ NodeType m61825 : 112|48@1+ (1,0) [0|0] "" Vector__XXX
 SG_ DateTime m61825 : 160|160@1+ (1,0) [0|0] "" Vector__XXX
 SG_ HardwareID m61826 : 32|24@1+ (1,0) [0|0] "" Vector__XXX
 SG_ HardwareVersion0 m61826 : 56|8@1+ (1,0) [0|0] "" Vector__XXX
 SG_ HardwareProcessorID m61826 : 64|24@1+ (1,0) [0|0] "" Vector__XXX
 SG_ HardwareProcessorVersion m61826 : 88|24@1+ (1,0) [0|0] "" Vector__XXX
 SG_ CompileFlagDiag m61826 : 112|8@1+ (1,0) [0|0] "" Vector__XXX
 SG_ CompileFlagAppl m61826 : 120|8@1+ (1,0) [0|0] "" Vector__XXX
 SG_ CompileFlagHwTest m61826 : 128|8@1+ (1,0) [0|0] "" Vector__XXX
 SG_ SvnRevision m61826 : 136|168@1+ (1,0) [0|0] "" Vector__XXX
 SG_ Date0 m61835 : 32|32@1+ (1,0) [0|0] "UnixTimestamp" Vector__XXX
 SG_ SerialNumberPCB m61836 : 32|32@1+ (1,0) [0|0] "" Vector__XXX
 SG_ SprayerItemNumber m61838 : 32|160@1+ (1,0) [0|0] "" Vector__XXX
 SG_ SprayerProductNumber m61838 : 192|400@1+ (1,0) [0|0] "" Vector__XXX
 SG_ SprayerIdenditifcationNumber m61840 : 32|136@1+ (1,0) [0|0] "" Vector__XXX
 SG_ ItemNumber m61842 : 32|32@1+ (1,0) [0|0] "" Vector__XXX
 SG_ HardwareVersion1 m61843 : 32|32@1+ (1,0) [0|0] "" Vector__XXX
 SG_ Date1 m61853 : 32|32@1+ (1,0) [0|0] "UnixTimestamp" Vector__XXX
 SG_ SontheimLicenseCode m61857 : 32|32@1+ (1,0) [0|0] "" Vector__XXX
 SG_ Date2 m61858 : 32|32@1+ (1,0) [0|0] "UnixTimestamp" Vector__XXX
 SG_ PfSplyVoltgRght1 m45332 : 32|8@1+ (0.1198039215686274509803921569,0) [0|0] "Volt" Vector__XXX
 SG_ PfSplyVoltgLft1 m45332 : 40|8@1+ (0.1198039215686274509803921569,0) [0|0] "Volt" Vector__XXX
 SG_ PfRs485Voltg1A1 m45332 : 48|8@1+ (0.01953125,0) [0|0] "V" Vector__XXX
 SG_ PfRs485Voltg1B1 m45332 : 56|8@1+ (0.01953125,0) [0|0] "V" Vector__XXX
 SG_ Coding_String_SMCU_1 m45331 : 888|4@1+ (1,0) [0|0] "" Vector__XXX
 SG_ Coding_String_SMCU_2 m45331 : 892|4@1+ (1,0) [0|0] "" Vector__XXX
 SG_ SsvGroundVoltage m582 : 32|16@1+ (1,0) [0|0] "" Vector__XXX

VAL_ 1729 PrimeFlowActiveError 0 "NO ERROR" 1 "NO ANSWER" 2 "LINE BROKEN" 3 "LINE WEAK" 4 "WRONG MOTOR NUMBER" 5 "PROTOCOL" 6 "WRONG ID" 7 "LOW POWER" 8 "LOW CURRNE" 9 "NOZZLESTATE: STALL" 10 "NOZZLESTATE: SHORTED" 11 "NOZZLESTATE: DISCONNECTED" 12 "CRC ERROR" 13 "OVERFLOW ERROR" 14 "NOT IMPLEMENTED" 15 "NOT IMPLEMENTED" 16 "NOT IMPLEMENTED" 17 "NOT IMPLEMENTED" 18 "NOT IMPLEMENTED" 19 "NOT IMPLEMENTED" 20 "NOT IMPLEMENTED" 21 "NOT IMPLEMENTED" 22 "NOT IMPLEMENTED" 23 "NOT IMPLEMENTED" 24 "NOT IMPLEMENTED" 25 "NOT IMPLEMENTED" 26 "NOT IMPLEMENTED" 27 "NOT IMPLEMENTED" 28 "NOT IMPLEMENTED" 29 "NOT IMPLEMENTED" 30 "NOT IMPLEMENTED" 31 "NOT IMPLEMENTED";
VAL_ 1729 PfMainState 0 "INIT" 1 "CONFIG" 2 "OPERATIONAL" 3 "LINEBROKEN" 4 "SETUP" 5 "ERROR";
VAL_ 1729 PfOppStates 0 "NORMAL" 1 "REPORT" 2 "WAIT" 3 "ERROR" 4 "CHECK" 5 "MODE_CHECKLINE";
VAL_ 1729 PfConnection 0 "RINGMODE" 1 "LINEARMODE" 2 "DISCONNECTED";
VAL_ 1729 Sens_TaRinseFullSwt 0 "False" 1 "True";
VAL_ 1729 TaRinseTankEmptyFlg 0 "False" 1 "True";
VAL_ 1729 Flt_TaObsRinseFullSwtFlt 0 "False" 1 "True";
VAL_ 1729 Flt_TaObsRinseTankNotFull 0 "False" 1 "True";
VAL_ 1729 Flt_TaAWashFcPmpSetToStartAlrt 0 "False" 1 "True";
VAL_ 1729 Flt_TaAWashFcPmpSetToStopAlrt 0 "False" 1 "True";
VAL_ 1729 Flt_TaAWashFillHoseTiOutAlrt 0 "False" 1 "True";
VAL_ 1729 Flt_TaAWashFlushBoomAlrt 0 "False" 1 "True";
VAL_ 1729 Flt_TaAWashInvldPausePosn 0 "False" 1 "True";
VAL_ 1729 Flt_TaAWashMainPmpRPMTooHigh 0 "False" 1 "True";
VAL_ 1729 Flt_TaAWashMainPmpRPMTooLow 0 "False" 1 "True";
VAL_ 1729 Flt_TaAWashMainTaNotEmptyAlrt 0 "False" 1 "True";
VAL_ 1729 Flt_TaAWashNotEnghRinseWtrAlrt 0 "False" 1 "True";
VAL_ 1729 Flt_TaAWashPrimingAlrt 0 "False" 1 "True";
VAL_ 1729 Flt_TaAWashPushChemBackAlrt 0 "False" 1 "True";
VAL_ 1729 Flt_TaAWashSnsrFailrAlrt 0 "False" 1 "True";
VAL_ 1729 Flt_TaAWashTankEmptyTiOutAlrt 0 "False" 1 "True";
VAL_ 1729 Flt_TaAWashVlvMovmtTiOutAlrt 0 "False" 1 "True";
VAL_ 1729 Reserved_14 0 "False" 1 "True";
VAL_ 1729 Reserved_15 0 "False" 1 "True";
VAL_ 1729 TrHydrBypassEnadInCurve 0 "False" 1 "True";
VAL_ 1729 Flt_TrRearLinkgAgSnsrMeclDfct 0 "False" 1 "True";
VAL_ 1729 Flt_TrRearLinkgAgWrgDir 0 "False" 1 "True";
VAL_ 1729 Flt_TrAgOutOfLimitsForAuto 0 "False" 1 "True";
VAL_ 1729 Flt_TrFrontHitchAgChgTooHigh 0 "False" 1 "True";
VAL_ 1729 TrInitPhaseFinished 0 "False" 1 "True";
VAL_ 1729 RollOverRiskOverLimit 0 "False" 1 "True";
VAL_ 1729 TrStatemachineModeSts 0 "DISABLED" 1 "LOCKED" 2 "MANUAL" 3 "AUTO" 4 "LOCK" 5 "ROLLOVER";
VAL_ 1729 Aux_3 0 "False" 1 "True";
VAL_ 1729 Aux_2 0 "False" 1 "True";
VAL_ 1729 Aux_1 0 "False" 1 "True";
VAL_ 1729 Flt_TaObsPmpMainPmpSigImpy 0 "False" 1 "True";
VAL_ 1729 Flt_TaObsPmpFlexCapSigImpy 0 "False" 1 "True";
VAL_ 1729 Flt_TaObsMainTaSnsrFlt 0 "False" 1 "True";
VAL_ 1729 AwMainTankEmptyFlg 0 "False" 1 "True";
VAL_ 1729 Sens_TaMainTaFullSwt 0 "False" 1 "True";
VAL_ 1729 ParSpraySection01 0 "False" 1 "True";
VAL_ 1729 ParSpraySection02 0 "False" 1 "True";
VAL_ 1729 ParSpraySection03 0 "False" 1 "True";
VAL_ 1729 ParSpraySection04 0 "False" 1 "True";
VAL_ 1729 ParSpraySection05 0 "False" 1 "True";
VAL_ 1729 ParSpraySection06 0 "False" 1 "True";
VAL_ 1729 ParSpraySection07 0 "False" 1 "True";
VAL_ 1729 ParSpraySection08 0 "False" 1 "True";
VAL_ 1729 ParSpraySection09 0 "False" 1 "True";
VAL_ 1729 ParSpraySection10 0 "False" 1 "True";
VAL_ 1729 ParSpraySection11 0 "False" 1 "True";
VAL_ 1729 ParSpraySection12 0 "False" 1 "True";
VAL_ 1729 ParSpraySection13 0 "False" 1 "True";
VAL_ 1729 Act_SpraySectionBypass1 0 "False" 1 "True";
VAL_ 1729 ParSprayLine1 0 "False" 1 "True";
VAL_ 1729 ParSprayLine2 0 "False" 1 "True";
VAL_ 1729 ParSprayLine3 0 "False" 1 "True";
VAL_ 1729 ParSprayLine4 0 "False" 1 "True";
VAL_ 1729 ParSprayAdd50NozzleLeft 0 "False" 1 "True";
VAL_ 1729 ParSprayAdd50NozzleRight 0 "False" 1 "True";
VAL_ 1729 ParSprayFenceNozzleLeft 0 "False" 1 "True";
VAL_ 1729 ParSprayFenceNozzleRight 0 "False" 1 "True";
VAL_ 1729 ParSprayEdgeNozzleLeft 0 "False" 1 "True";
VAL_ 1729 ParSprayEdgeNozzleRight 0 "False" 1 "True";
VAL_ 1729 Flt_BmSlantAgSnsrMeclDfct 0 "False" 1 "True";
VAL_ 1729 Flt_BmSlantAgSnsrWrgDir 0 "False" 1 "True";
VAL_ 1729 AuxBit1 0 "False" 1 "True";
VAL_ 1729 AuxBit2 0 "False" 1 "True";
VAL_ 1729 AuxBit3 0 "False" 1 "True";
VAL_ 1729 AuxBit4 0 "False" 1 "True";
VAL_ 1729 AuxBit5 0 "False" 1 "True";
VAL_ 1729 AuxBit6 0 "False" 1 "True";
VAL_ 1729 AuxBit7 0 "False" 1 "True";
VAL_ 1729 AuxBit8 0 "False" 1 "True";
VAL_ 1729 Flt_BmLiftAgSnsrMeclDfct 0 "False" 1 "True";
VAL_ 1729 AuxBit_6 0 "False" 1 "True";
VAL_ 1729 AuxBit_5 0 "False" 1 "True";
VAL_ 1729 AuxBit_4 0 "False" 1 "True";
VAL_ 1729 AuxBit_3 0 "False" 1 "True";
VAL_ 1729 AuxBit_2 0 "False" 1 "True";
VAL_ 1729 AuxBit_1 0 "False" 1 "True";
VAL_ 1729 AuxBit 0 "False" 1 "True";
VAL_ 1729 FTB_SuctSrcVlvAct 0 "False" 1 "True";
VAL_ 1729 FTB_SuctSrcVlvSnsr 0 "False" 1 "True";
VAL_ 1729 FTB_PresDestVlvAct 0 "False" 1 "True";
VAL_ 1729 FTB_PresDestVlvSnsr 0 "False" 1 "True";
VAL_ 1729 FTB_FillVlvAct 0 "False" 1 "True";
VAL_ 1729 FTB_FillVlvSnsr_tbd 0 "False" 1 "True";
VAL_ 1729 FTB_AgitVlvAct 0 "False" 1 "True";
VAL_ 1729 FTB_AgitVlvAgSnsr 0 "False" 1 "True";
VAL_ 1729 Aux5 0 "False" 1 "True";
VAL_ 1729 Flt_TaObsMainTaWtrLvlRiseAlrt 0 "False" 1 "True";
VAL_ 1729 Flt_TaObsMainTaFlowPPUInvld 0 "False" 1 "True";
VAL_ 1729 Flt_TaObsMainTaCalibFlt 0 "False" 1 "True";
VAL_ 1729 Type0 0 "SolenoidOnOff" 1 "SolenoidProportionalValve" 2 "DcMotorBidirectionalWithStopSwitch" 3 "DcMotorRegulationValve" 4 "DcMotorUnidirectional" 5 "LinakPowerSupply" 6 "LinakPositionSignal" 7 "Lamp" 8 "DcMotorBidirectionalWithPoti" 9 "DcMotorBidirectionalWithHall" 128 "SolenoidOnOff (Inverted)" 129 "SolenoidProportionalValve (Inverted)" 130 "DcMotorBidirectionalWithStopSwitch (Inverted)" 131 "DcMotorBidirectionalWithSensor (Inverted)" 132 "DcMotorUnidirectional (Inverted)" 133 "TwinPowerSupply (Inverted)" 134 "TwinSignalDutyCycle (Inverted)" 135 "Lamp (Inverted)" 136 "DcMotorBidirectionalWithPoti (inverted)" 137 "DcMotorBidirectionalWithHall (inverted)" 255 "Undefined";
VAL_ 1729 SensorChannel 0 "Sensor01" 1 "Sensor02" 2 "Sensor03" 3 "Sensor04" 4 "Sensor05" 5 "Sensor06" 6 "Sensor07" 7 "Sensor08" 255 "Not Configured";
VAL_ 1729 Type1 0 "Analog Voltage Ubat" 1 "Analog Current Ubat" 2 "Analog Voltage 5V" 3 "Analog Current 5V" 5 "Digital Frequency with mechanic" 6 "Digital Frequency without mechanic" 7 "Digital Input" 8 "Digital Speed Forward Reverse" 255 "Undefined";
VAL_ 1729 NodeNumber 0 "Reserved" 1 "Bbc1 Base" 2 "Bbf1 Base" 3 "Bbc2 Base" 4 "Bbio L1 Base" 5 "Bbio R1 Base" 6 "Bbio L2 Base" 7 "Bbio R2 Base" 8 "Bbio FE1 Base" 9 "Bbio FE2 Base" 10 "Reserved" 11 "Bbc1 Output" 12 "Bbf1 Output" 13 "Bbc2 Output" 14 "Bbio L1 Output" 15 "Bbio R1 Output" 16 "Bbio L2 Output" 17 "Bbio R2 Output" 18 "Bbio FE1 Output" 19 "Bbio FE2 Output" 20 "Reserved" 21 "Bbc1 Input" 22 "Bbf1 Input" 23 "Bbc2 Input" 24 "Bbio L1 Input" 25 "Bbio R1 Input" 26 "Bbio L2 Input" 27 "Bbio R2 Input" 28 "Bbio FE1 Input" 29 "Bbio FE2 Input" 30 "Not Configured";
VAL_ 1729 Type2 1 "Output" 2 "Input" 3 "Bbc1" 4 "Bbc2" 5 "Bbf1" 6 "Bbio";
